[part 2 of 4: package /ActiveEcuC]
AUTOSAR XML (schema 3.0.2)
package /ActiveEcuC  (continued)
  module config Mcu: implementation-config-variant=VARIANT-POST-BUILD, module-description=Mcu_Impl
    McuGeneralConfiguration:
      McuBank0Pwr = ActiveMode
      McuBank1Pwr = ActiveMode
      McuBank{2..6}Pwr = SleepMode
      McuBank7Pwr = ActiveMode
      McuDevErrorDetect = false
      McuPerformResetApi = true
      McuVersionInfoApi = true
      McuDoParamCheck = true
      McuCheckParamConfig = true
      McuCheckParamMode = true
      McuCheckParamClock = true
      McuCheckParamRamSection = true
      McuCheckVersionInfo = true
      McuCheckUninit = true
      McuCheckPllStatus = true
      McuDevErrorReport = true
      McuErrorHook = Det_ReportError
      McuIncludeDet = Det.h
      McuProdErrorReport = true
      McuErrorRoutine = Dem_SetEventStatus
      McuIncludeDem = Dem.h
      McuUseInitRamApi = false
      McuCopyTrimFromOtp = true
      McuSraEnabled = true
      McuSraOnlyForWrite = true
      McuSraOnlyForPrivModeRegs = true
      McuSraNotInInit = false
      McuErrataFmzPll17Workaround = false
      McuIrqHandling = SuspendAllInterrupts
      McuMemInit:
        McuInitMibSpiP1Ram = true
        McuInitMibSpiP3Ram = true
        McuInitMibSpiP5Ram = true
        McuInitDcan{1..3}Ram = true
        McuInitMibAdc1Ram = true
        McuInitMibAdc2Ram = true
        McuInitNhet1Ram = true
        McuInitNhet2Ram = true
        McuInitHetTu1Ram = true
        McuInitHetTu2Ram = true
        McuInitDmaRam = true
        McuInitVimRam = false
        McuInitFlexRayTuRam = true
      McuPeripheralSelect:
        McuUseMibSpiP1 = true
        McuUseSpiP2 = true
        McuUseMibSpiP3 = true
        McuUseSpiP4 = true
        McuUseMibSpiP5 = true
        McuUseLin = true
        McuUseSci = true
        McuUseDcan{1..3} = true
        McuUseI2c = true
        McuUseFlexRay = true
        McuUseFlexRayTu = true
        McuUseMibAdc1 = true
        McuUseMibAdc2 = true
        McuUseGio = true
        McuUseNhet1 = true
        McuUseNhet2 = true
        McuUseHetTu1 = true
        McuUseHetTu2 = true
        McuUseDmm = false
    McuModuleConfiguration: McuClockSrcFailureNotification=DISABLED
      McuClockSettingConfig
        McuClockReferencePoint: McuClockReferencePointFrequency=20
        McuLpo:
          McuLpoEnableBias = true
          McuLpoTrimLow = Trim100Comma00Percent
          McuLpoTrimHigh = Trim100Comma00Percent
          McuLpoLowref = 80
          McuLpoHighref = 100
          McuLpoLowfreq = 0.08
          McuLpoHighfreq = 10
        PLL (McuPllConfig):
          McuPllRefClkDiv = 6
          McuPllOdDiv = 2
          McuPllRDiv = 1
          McuPllMul = 96
          McuPllIntClk = 2.5
          McuPllOutputClk = 320
          McuPllFreq = 160
          McuPllFmBwadj = 8
          McuPllFmMode = FM_Disabled
          McuPllFmNs = 1
          McuPllFmFs = 1.667
          McuPllFmNv = 1
          McuPllFmDepth = 0
          McuPllResetOnPllSlip = true
          McuPllBypassOnPllSlip = true
          McuPllResetOnOsciFail = true
        PLL2 (McuPll2Config): McuPll2RefClkDiv=5, McuPll2OdDiv=5, McuPll2RDiv=1, McuPll2Mul=100, McuPll2IntClk=4, McuPll2OutputClk=400, McuPll2Freq=80
        ExtClkIn (McuExtClocks): McuExtClk1Freq=80, McuExtClk2Freq=80
        McuClocks
          McuClockSrc:
            McuUseOsciClk = true
            McuUsePllClk = true
            McuUse32KhzOsciClk = false
            McuUseExtClk1 = false
            McuUseLpoLow = true
            McuUseLpoHigh = true
            McuUsePll2Clk = false
            McuUseExtClk2 = false
            McuUseGclk = true
            McuUseHclk = true
            McuUseVclkp = true
            McuUseVclk2 = true
            McuUseVclka1 = true
            McuUseVclka2 = true
            McuUseRtiClk1 = true
            McuUseVclk3 = true
            McuUseVclka4 = true
            McuUseVclka4Pre = false
            McuVclka1 = Vclk
            McuVclka2 = Vclk
            McuVclka4 = Vclk
            McuVclka4r = DivderbyOne
            McuRti1Div = DivderbyOne
            McuAVclk1Freq = 80
            McuAVclk2Freq = 80
            McuAVclk4sFreq = 80
            McuAVclk4divrFreq = 80
            McuRTI1Freq = 80
            McuRti1Src = Vclk
          ClockDomains (McuClockDomains):
            McuEclkSelector = VCLK
            McuEclkPrescaler = 0
            McuEclkSuspendMode = true
            McuGclkFreq = 160
            McuHclkFreq = 160
            McuVclkFreq = 80
            McuVclk2Freq = 80
            McuVclk3Freq = 80
            McuFrdCntlAswsten = 1
            McuFrdCntlRwait = 3
            McuGhvwake = PLL
            McuHvlpm = PLL
            McuGhvsrc = PLL
            McuTreeVclkDiv = 2
            McuTreeVclk2Div = 2
            McuTreeVclk3Div = 2
      McuModeConf (McuModeSettingConf): McuPowerMode=DozeMode, McuMode=0
      McuRamConf (McuRamSectorSettingConf): McuRamDefaultValue=0, McuRamBaseAddress=134217728, McuRamSectionSize=81920, McuCopyRomToRam=false, McuRomBaseAddress=0
  module config MemIf: implementation-config-variant=VARIANT-PRE-COMPILE, module-description=MemIf_Impl
    MemIfGeneral: MemIfDevErrorDetect=true, MemIfVersionInfoApi=true
    MemIfAdditional:
      MemIfCfgChkParamDevIndex = true
      MemIfCfgChkParamVInfo = true
      MemIfDebugReporting = true
      MemIfCfgIncludeDet = Det.h
      MemIfErrorhook = Det_ReportError
      MemIfCfgUseFctApi = true
  module config MtrDrvDiag: implementation-config-variant=VARIANT-POST-BUILD
    MtrDrvDiagGeneral
    CommonPublishedInformation: ArMajorVersion=3, ArMinorVersion=2, ArPatchVersion=0, SwMajorVersion=0, SwMinorVersion=0, SwPatchVersion=0, ModuleId=0, VendorId=0
  module config MtrTempEst: implementation-config-variant=VARIANT-POST-BUILD
    MtrTempEstGeneral
    CommonPublishedInformation: ArMajorVersion=3, ArMinorVersion=2, ArPatchVersion=0, SwMajorVersion=0, SwMinorVersion=0, SwPatchVersion=0, ModuleId=0, VendorId=0
  module config MtrVel: implementation-config-variant=VARIANT-POST-BUILD
    MtrVelGeneral
    CommonPublishedInformation: ArMajorVersion=3, ArMinorVersion=2, ArPatchVersion=0, SwMajorVersion=0, SwMinorVersion=0, SwPatchVersion=0, ModuleId=0, VendorId=0
  module config MtrVel2: implementation-config-variant=VARIANT-POST-BUILD
    MtrVel2General
    CommonPublishedInformation: ArMajorVersion=3, ArMinorVersion=2, ArPatchVersion=0, SwMajorVersion=0, SwMinorVersion=0, SwPatchVersion=0, ModuleId=0, VendorId=0
  module config NvM: implementation-config-variant=VARIANT-LINK-TIME, module-description=NvM_Impl
    109 x NvmBlockDescriptor, all with NvmDeviceName=Fee, NvmBlockManagementType=NVM_BLOCK_NATIVE, NvmBlockCRCType=NVM_CRC16, NvmBlockJobPriority=127, NvmNvBlockNum=1, NvmWriteBlockOnce=false, NvmBlockWriteProt=false, NvmUseInitCallback=false, NvmRequirementId=(unset):
      Rte_NvmBlock_Polarity_Polarity_Cnt_Str: NvmNvramBlockIdentifier=2, NvmBlockUseCrc=true, NvmBlockUsedCrcType=NVM_CRC16, NvmCalcRamBlockCrc=true, NvmNvBlockLength=2, NvmUseServicePorts=true, NvmResistantToChangedSw=true, NvmSelectBlockForReadall=true, NvmRamBlockDataAddress=Rte_Polarity_Polarity_Cnt_Str, NvmRomBlockDataAddress=(unset), NvmInitBlockCallback=Init_BootProgStatus, NvmUseJobendCallback=false, NvmJobendCbkAtReadAll=false, NvmSingleBlockCallback=NULL_PTR
        NvmTargetBlockReference
          NvmFeeRef: NvmNameOfFeeBlock=FeeBlockConfiguration4
      NVM_BLOCK_DIAGMGR_NTCSTRG: NvmNvramBlockIdentifier=3, NvmBlockUseCrc=false, NvmBlockUsedCrcType=NVM_NOCRC, NvmCalcRamBlockCrc=false, NvmNvBlockLength=60, NvmUseServicePorts=true, NvmResistantToChangedSw=true, NvmSelectBlockForReadall=true, NvmRamBlockDataAddress=NTCStrgArray_Cnt_str, NvmRomBlockDataAddress=(unset), NvmInitBlockCallback=NULL_PTR, NvmUseJobendCallback=false, NvmJobendCbkAtReadAll=false, NvmSingleBlockCallback=NULL_PTR
        NvmTargetBlockReference
          NvmFeeRef: NvmNameOfFeeBlock=FeeBlockConfiguration6
      NVM_BLOCK_EPSDEFEATS: NvmNvramBlockIdentifier=4, NvmBlockUseCrc=false, NvmBlockUsedCrcType=NVM_NOCRC, NvmCalcRamBlockCrc=false, NvmNvBlockLength=4, NvmUseServicePorts=true, NvmResistantToChangedSw=true, NvmSelectBlockForReadall=true, NvmRamBlockDataAddress=CDD_EOLSrlComSvcDft_Cnt_G_b32, NvmRomBlockDataAddress=(unset), NvmInitBlockCallback=NULL_PTR, NvmUseJobendCallback=false, NvmJobendCbkAtReadAll=false, NvmSingleBlockCallback=NULL_PTR
        NvmTargetBlockReference
          NvmFeeRef: NvmNameOfFeeBlock=FeeBlockConfiguration7
      NvM_NVM_BLOCK_DEM: NvmNvramBlockIdentifier=5, NvmBlockUseCrc=false, NvmBlockUsedCrcType=NVM_NOCRC, NvmCalcRamBlockCrc=false, NvmNvBlockLength=245, NvmUseServicePorts=true, NvmResistantToChangedSw=true, NvmSelectBlockForReadall=false, NvmRamBlockDataAddress=(unset), NvmRomBlockDataAddress=(unset), NvmInitBlockCallback=Dem_NvDataInit, NvmUseJobendCallback=false, NvmJobendCbkAtReadAll=false, NvmSingleBlockCallback=NULL_PTR
        NvmTargetBlockReference
          NvmFeeRef: NvmNameOfFeeBlock=FeeBlockConfiguration8
      Rte_NvmBlock_StaMd_TypeHRamBuffer: NvmNvramBlockIdentifier=6, NvmBlockUseCrc=false, NvmBlockUsedCrcType=NVM_NOCRC, NvmCalcRamBlockCrc=false, NvmNvBlockLength=100, NvmUseServicePorts=true, NvmResistantToChangedSw=true, NvmSelectBlockForReadall=true, NvmRamBlockDataAddress=TypeHData_Cnt_u08, NvmRomBlockDataAddress=(unset), NvmInitBlockCallback=NULL_PTR, NvmUseJobendCallback=false, NvmJobendCbkAtReadAll=false, NvmSingleBlockCallback=NULL_PTR
        NvmTargetBlockReference
          NvmFeeRef: NvmNameOfFeeBlock=FeeBlockConfiguration9
      Deprecated_NvmBlock_TrqCmdScl_TorqueCmdSF_Uls_f32: NvmNvramBlockIdentifier=7, NvmBlockUseCrc=false, NvmBlockUsedCrcType=NVM_NOCRC, NvmCalcRamBlockCrc=false, NvmNvBlockLength=4, NvmUseServicePorts=true, NvmResistantToChangedSw=true, NvmSelectBlockForReadall=false, NvmRamBlockDataAddress=(unset), NvmRomBlockDataAddress=(unset), NvmInitBlockCallback=NULL_PTR, NvmUseJobendCallback=false, NvmJobendCbkAtReadAll=false, NvmSingleBlockCallback=NULL_PTR
        NvmTargetBlockReference
          NvmFeeRef: NvmNameOfFeeBlock=FeeBlockConfiguration10
      Deprecated_NvmBlock_CmMtrCurr_CurrTempOffset: NvmNvramBlockIdentifier=8, NvmBlockUseCrc=false, NvmBlockUsedCrcType=NVM_NOCRC, NvmCalcRamBlockCrc=false, NvmNvBlockLength=98, NvmUseServicePorts=true, NvmResistantToChangedSw=true, NvmSelectBlockForReadall=false, NvmRamBlockDataAddress=(unset), NvmRomBlockDataAddress=(unset), NvmInitBlockCallback=NULL_PTR, NvmUseJobendCallback=false, NvmJobendCbkAtReadAll=false, NvmSingleBlockCallback=NULL_PTR
        NvmTargetBlockReference
          NvmFeeRef: NvmNameOfFeeBlock=FeeBlockConfiguration11
      Deprecated_NvmBlock_CmMtrCurr_ShCurrCal: NvmNvramBlockIdentifier=9, NvmBlockUseCrc=false, NvmBlockUsedCrcType=NVM_NOCRC, NvmCalcRamBlockCrc=false, NvmNvBlockLength=28, NvmUseServicePorts=true, NvmResistantToChangedSw=true, NvmSelectBlockForReadall=false, NvmRamBlockDataAddress=(unset), NvmRomBlockDataAddress=(unset), NvmInitBlockCallback=NULL_PTR, NvmUseJobendCallback=false, NvmJobendCbkAtReadAll=false, NvmSingleBlockCallback=NULL_PTR
        NvmTargetBlockReference
          NvmFeeRef: NvmNameOfFeeBlock=FeeBlockConfiguration12
      Rte_NvmBlock_CurrParamComp_EOLNomMtrParam: NvmNvramBlockIdentifier=10, NvmBlockUseCrc=false, NvmBlockUsedCrcType=NVM_NOCRC, NvmCalcRamBlockCrc=false, NvmNvBlockLength=8, NvmUseServicePorts=true, NvmResistantToChangedSw=true, NvmSelectBlockForReadall=true, NvmRamBlockDataAddress=Rte_CurrParamComp_EOLNomMtrParam, NvmRomBlockDataAddress=(unset), NvmInitBlockCallback=NULL_PTR, NvmUseJobendCallback=false, NvmJobendCbkAtReadAll=false, NvmSingleBlockCallback=NULL_PTR
        NvmTargetBlockReference
          NvmFeeRef: NvmNameOfFeeBlock=FeeBlockConfiguration13
      Deprecated_NvmBlock_LrnEOT_LearnedEOT: NvmNvramBlockIdentifier=11, NvmBlockUseCrc=false, NvmBlockUsedCrcType=NVM_NOCRC, NvmCalcRamBlockCrc=false, NvmNvBlockLength=10, NvmUseServicePorts=true, NvmResistantToChangedSw=true, NvmSelectBlockForReadall=false, NvmRamBlockDataAddress=(unset), NvmRomBlockDataAddress=(unset), NvmInitBlockCallback=NULL_PTR, NvmUseJobendCallback=false, NvmJobendCbkAtReadAll=false, NvmSingleBlockCallback=NULL_PTR
        NvmTargetBlockReference
          NvmFeeRef: NvmNameOfFeeBlock=FeeBlockConfiguration14
      Deprecated_NvmBlock_TrqCanc_CogTrqCal: NvmNvramBlockIdentifier=12, NvmBlockUseCrc=false, NvmBlockUsedCrcType=NVM_NOCRC, NvmCalcRamBlockCrc=false, NvmNvBlockLength=1024, NvmUseServicePorts=true, NvmResistantToChangedSw=true, NvmSelectBlockForReadall=false, NvmRamBlockDataAddress=(unset), NvmRomBlockDataAddress=(unset), NvmInitBlockCallback=NULL_PTR, NvmUseJobendCallback=false, NvmJobendCbkAtReadAll=false, NvmSingleBlockCallback=NULL_PTR
        NvmTargetBlockReference
          NvmFeeRef: NvmNameOfFeeBlock=FeeBlockConfiguration15
      NVM_BLOCK_CMS_NXTRMEC: NvmNvramBlockIdentifier=13, NvmBlockUseCrc=false, NvmBlockUsedCrcType=NVM_NOCRC, NvmCalcRamBlockCrc=false, NvmNvBlockLength=1, NvmUseServicePorts=true, NvmResistantToChangedSw=true, NvmSelectBlockForReadall=true, NvmRamBlockDataAddress=Nvm_NMEC_Cnt_u8, NvmRomBlockDataAddress=(unset), NvmInitBlockCallback=NULL_PTR, NvmUseJobendCallback=false, NvmJobendCbkAtReadAll=false, NvmSingleBlockCallback=NULL_PTR
        NvmTargetBlockReference
          NvmFeeRef: NvmNameOfFeeBlock=FeeBlockConfiguration33
      NVM_BLOCK_CMS_ECUSRLNUM: NvmNvramBlockIdentifier=14, NvmBlockUseCrc=false, NvmBlockUsedCrcType=NVM_NOCRC, NvmCalcRamBlockCrc=false, NvmNvBlockLength=4, NvmUseServicePorts=true, NvmResistantToChangedSw=true, NvmSelectBlockForReadall=true, NvmRamBlockDataAddress=Nvm_EcuSrlNum_Cnt_u8, NvmRomBlockDataAddress=(unset), NvmInitBlockCallback=NULL_PTR, NvmUseJobendCallback=false, NvmJobendCbkAtReadAll=false, NvmSingleBlockCallback=NULL_PTR
        NvmTargetBlockReference
          NvmFeeRef: NvmNameOfFeeBlock=FeeBlockConfiguration34
      NVM_BLOCK_CMS_EPSSRLNUM: NvmNvramBlockIdentifier=15, NvmBlockUseCrc=false, NvmBlockUsedCrcType=NVM_NOCRC, NvmCalcRamBlockCrc=false, NvmNvBlockLength=4, NvmUseServicePorts=true, NvmResistantToChangedSw=true, NvmSelectBlockForReadall=true, NvmRamBlockDataAddress=Nvm_EpsSrlNum_Cnt_u8, NvmRomBlockDataAddress=(unset), NvmInitBlockCallback=NULL_PTR, NvmUseJobendCallback=false, NvmJobendCbkAtReadAll=false, NvmSingleBlockCallback=NULL_PTR
        NvmTargetBlockReference
          NvmFeeRef: NvmNameOfFeeBlock=FeeBlockConfiguration35
      NVM_BLOCK_CMS_ECUHWPN: NvmNvramBlockIdentifier=16, NvmBlockUseCrc=false, NvmBlockUsedCrcType=NVM_NOCRC, NvmCalcRamBlockCrc=false, NvmNvBlockLength=12, NvmUseServicePorts=true, NvmResistantToChangedSw=true, NvmSelectBlockForReadall=true, NvmRamBlockDataAddress=Nvm_EcuHwPn_Cnt_u8, NvmRomBlockDataAddress=(unset), NvmInitBlockCallback=NULL_PTR, NvmUseJobendCallback=false, NvmJobendCbkAtReadAll=false, NvmSingleBlockCallback=NULL_PTR
        NvmTargetBlockReference
          NvmFeeRef: NvmNameOfFeeBlock=FeeBlockConfiguration36
      NVM_BLOCK_CMS_NXTRMANUFSCRATCHPAD: NvmNvramBlockIdentifier=17, NvmBlockUseCrc=false, NvmBlockUsedCrcType=NVM_NOCRC, NvmCalcRamBlockCrc=false, NvmNvBlockLength=64, NvmUseServicePorts=true, NvmResistantToChangedSw=true, NvmSelectBlockForReadall=true, NvmRamBlockDataAddress=Nvm_NxtrManfScrpd_Cnt_u8, NvmRomBlockDataAddress=(unset), NvmInitBlockCallback=NULL_PTR, NvmUseJobendCallback=false, NvmJobendCbkAtReadAll=false, NvmSingleBlockCallback=NULL_PTR
        NvmTargetBlockReference
          NvmFeeRef: NvmNameOfFeeBlock=FeeBlockConfiguration37
      NVM_BLOCK_CMS_IGNCNTR: NvmNvramBlockIdentifier=18, NvmBlockUseCrc=false, NvmBlockUsedCrcType=NVM_NOCRC, NvmCalcRamBlockCrc=false, NvmNvBlockLength=2, NvmUseServicePorts=true, NvmResistantToChangedSw=true, NvmSelectBlockForReadall=true, NvmRamBlockDataAddress=Nvm_IgnCntr_Cnt_u16, NvmRomBlockDataAddress=(unset), NvmInitBlockCallback=NULL_PTR, NvmUseJobendCallback=false, NvmJobendCbkAtReadAll=false, NvmSingleBlockCallback=NULL_PTR
        NvmTargetBlockReference
          NvmFeeRef: NvmNameOfFeeBlock=FeeBlockConfiguration38
      Rte_NvmBlock_StaMd_CloseCheckData: NvmNvramBlockIdentifier=19, NvmBlockUseCrc=false, NvmBlockUsedCrcType=NVM_NOCRC, NvmCalcRamBlockCrc=false, NvmNvBlockLength=4, NvmUseServicePorts=true, NvmResistantToChangedSw=true, NvmSelectBlockForReadall=true, NvmRamBlockDataAddress=NvMP_CloseCheck_Cnt_u32, NvmRomBlockDataAddress=(unset), NvmInitBlockCallback=NULL_PTR, NvmUseJobendCallback=false, NvmJobendCbkAtReadAll=false, NvmSingleBlockCallback=NULL_PTR
        NvmTargetBlockReference
          NvmFeeRef: NvmNameOfFeeBlock=FeeBlockConfiguration39
      NVM_BLOCK_DIAGMGR_BLACKBOX: NvmNvramBlockIdentifier=20, NvmBlockUseCrc=false, NvmBlockUsedCrcType=NVM_NOCRC, NvmCalcRamBlockCrc=false, NvmNvBlockLength=192, NvmUseServicePorts=true, NvmResistantToChangedSw=true, NvmSelectBlockForReadall=true, NvmRamBlockDataAddress=NTCBlackBoxData_Cnt_str, NvmRomBlockDataAddress=(unset), NvmInitBlockCallback=NULL_PTR, NvmUseJobendCallback=false, NvmJobendCbkAtReadAll=false, NvmSingleBlockCallback=NULL_PTR
        NvmTargetBlockReference
          NvmFeeRef: NvmNameOfFeeBlock=FeeBlockConfiguration40
      Deprecated_NvmBlock_AvgFricLrn_AvgFricLrnData: NvmNvramBlockIdentifier=21, NvmBlockUseCrc=false, NvmBlockUsedCrcType=NVM_NOCRC, NvmCalcRamBlockCrc=false, NvmNvBlockLength=203, NvmUseServicePorts=true, NvmResistantToChangedSw=true, NvmSelectBlockForReadall=true, NvmRamBlockDataAddress=Rte_AvgFricLrn_AvgFricLrnData, NvmRomBlockDataAddress=(unset), NvmInitBlockCallback=NULL_PTR, NvmUseJobendCallback=false, NvmJobendCbkAtReadAll=false, NvmSingleBlockCallback=NULL_PTR
        NvmTargetBlockReference
          NvmFeeRef: NvmNameOfFeeBlock=FeeBlockConfiguration41
      Rte_NvmBlock_BatteryVoltage_OvervoltageData: NvmNvramBlockIdentifier=22, NvmBlockUseCrc=false, NvmBlockUsedCrcType=NVM_NOCRC, NvmCalcRamBlockCrc=false, NvmNvBlockLength=6, NvmUseServicePorts=true, NvmResistantToChangedSw=true, NvmSelectBlockForReadall=true, NvmRamBlockDataAddress=Rte_BatteryVoltage_OvervoltageData, NvmRomBlockDataAddress=(unset), NvmInitBlockCallback=NULL_PTR, NvmUseJobendCallback=false, NvmJobendCbkAtReadAll=false, NvmSingleBlockCallback=NULL_PTR
        NvmTargetBlockReference
          NvmFeeRef: NvmNameOfFeeBlock=FeeBlockConfiguration43
      Rte_NvmBlock_DigMSB_DigMSBEOLData: NvmNvramBlockIdentifier=23, NvmBlockUseCrc=false, NvmBlockUsedCrcType=NVM_NOCRC, NvmCalcRamBlockCrc=false, NvmNvBlockLength=4102, NvmUseServicePorts=true, NvmResistantToChangedSw=true, NvmSelectBlockForReadall=true, NvmRamBlockDataAddress=Rte_DigMSB_DigMSBEOLData, NvmRomBlockDataAddress=(unset), NvmInitBlockCallback=NULL_PTR, NvmUseJobendCallback=false, NvmJobendCbkAtReadAll=false, NvmSingleBlockCallback=NULL_PTR
        NvmTargetBlockReference
          NvmFeeRef: NvmNameOfFeeBlock=FeeBlockConfiguration44
      Deprecated_NvmBlock_DigHwTrqSENT_DigTrqTrim: NvmNvramBlockIdentifier=24, NvmBlockUseCrc=false, NvmBlockUsedCrcType=NVM_NOCRC, NvmCalcRamBlockCrc=false, NvmNvBlockLength=5, NvmUseServicePorts=true, NvmResistantToChangedSw=true, NvmSelectBlockForReadall=false, NvmRamBlockDataAddress=(unset), NvmRomBlockDataAddress=(unset), NvmInitBlockCallback=NULL_PTR, NvmUseJobendCallback=false, NvmJobendCbkAtReadAll=false, NvmSingleBlockCallback=NULL_PTR
        NvmTargetBlockReference
          NvmFeeRef: NvmNameOfFeeBlock=FeeBlockConfiguration45
      Deprecated_NvmBlock_AbsHwPos_EOLVehCntrOffset: NvmNvramBlockIdentifier=25, NvmBlockUseCrc=false, NvmBlockUsedCrcType=NVM_NOCRC, NvmCalcRamBlockCrc=false, NvmNvBlockLength=5, NvmUseServicePorts=true, NvmResistantToChangedSw=true, NvmSelectBlockForReadall=false, NvmRamBlockDataAddress=(unset), NvmRomBlockDataAddress=(unset), NvmInitBlockCallback=NULL_PTR, NvmUseJobendCallback=false, NvmJobendCbkAtReadAll=false, NvmSingleBlockCallback=NULL_PTR
        NvmTargetBlockReference
          NvmFeeRef: NvmNameOfFeeBlock=FeeBlockConfiguration48
      Rte_NvmBlock_DiagSvc_TuningSetSelectData: NvmNvramBlockIdentifier=26, NvmBlockUseCrc=false, NvmBlockUsedCrcType=NVM_NOCRC, NvmCalcRamBlockCrc=false, NvmNvBlockLength=2, NvmUseServicePorts=true, NvmResistantToChangedSw=true, NvmSelectBlockForReadall=true, NvmRamBlockDataAddress=Rte_DiagSvc_TuningSetSelectData, NvmRomBlockDataAddress=(unset), NvmInitBlockCallback=NULL_PTR, NvmUseJobendCallback=false, NvmJobendCbkAtReadAll=false, NvmSingleBlockCallback=NULL_PTR
        NvmTargetBlockReference
          NvmFeeRef: NvmNameOfFeeBlock=FeeBlockConfiguration47
      Deprecated_NvmBlock_AbsHwPos_EOLVehCntrOffset1: NvmNvramBlockIdentifier=27, NvmBlockUseCrc=false, NvmBlockUsedCrcType=NVM_NOCRC, NvmCalcRamBlockCrc=false, NvmNvBlockLength=6, NvmUseServicePorts=true, NvmResistantToChangedSw=true, NvmSelectBlockForReadall=false, NvmRamBlockDataAddress=(unset), NvmRomBlockDataAddress=(unset), NvmInitBlockCallback=NULL_PTR, NvmUseJobendCallback=false, NvmJobendCbkAtReadAll=false, NvmSingleBlockCallback=NULL_PTR
        NvmTargetBlockReference
          NvmFeeRef: NvmNameOfFeeBlock=FeeBlockConfiguration46
      Deprecated_NvmBlock_TrqCanc_CogTrqRplComp: NvmNvramBlockIdentifier=28, NvmBlockUseCrc=false, NvmBlockUsedCrcType=NVM_NOCRC, NvmCalcRamBlockCrc=false, NvmNvBlockLength=18, NvmUseServicePorts=true, NvmResistantToChangedSw=true, NvmSelectBlockForReadall=false, NvmRamBlockDataAddress=(unset), NvmRomBlockDataAddress=(unset), NvmInitBlockCallback=NULL_PTR, NvmUseJobendCallback=false, NvmJobendCbkAtReadAll=false, NvmSingleBlockCallback=NULL_PTR
        NvmTargetBlockReference
          NvmFeeRef: NvmNameOfFeeBlock=FeeBlockConfiguration49
      Deprecated_NvmBlock_AstLmt_SteerAsstDefeat: NvmNvramBlockIdentifier=29, NvmBlockUseCrc=false, NvmBlockUsedCrcType=NVM_NOCRC, NvmCalcRamBlockCrc=false, NvmNvBlockLength=2, NvmUseServicePorts=true, NvmResistantToChangedSw=true, NvmSelectBlockForReadall=false, NvmRamBlockDataAddress=(unset), NvmRomBlockDataAddress=(unset), NvmInitBlockCallback=NULL_PTR, NvmUseJobendCallback=false, NvmJobendCbkAtReadAll=false, NvmSingleBlockCallback=NULL_PTR
        NvmTargetBlockReference
          NvmFeeRef: NvmNameOfFeeBlock=FeeBlockConfiguration50
      Rte_NvmBlock_ThrmlDutyCycle_ThrmlDutyCycle_FltStVal: NvmNvramBlockIdentifier=30, NvmBlockUseCrc=false, NvmBlockUsedCrcType=NVM_NOCRC, NvmCalcRamBlockCrc=false, NvmNvBlockLength=4, NvmUseServicePorts=true, NvmResistantToChangedSw=true, NvmSelectBlockForReadall=true, NvmRamBlockDataAddress=Rte_ThrmlDutyCycle_ThrmlDutyCycle_FltStVal, NvmRomBlockDataAddress=(unset), NvmInitBlockCallback=NULL_PTR, NvmUseJobendCallback=false, NvmJobendCbkAtReadAll=false, NvmSingleBlockCallback=NULL_PTR
        NvmTargetBlockReference
          NvmFeeRef: NvmNameOfFeeBlock=FeeBlockConfiguration51
      NVM_BLOCK_DIAGMGR_LATCHCNTRS: NvmNvramBlockIdentifier=31, NvmBlockUseCrc=false, NvmBlockUsedCrcType=NVM_NOCRC, NvmCalcRamBlockCrc=false, NvmNvBlockLength=16, NvmUseServicePorts=true, NvmResistantToChangedSw=true, NvmSelectBlockForReadall=true, NvmRamBlockDataAddress=LatchCounter_Cnt_u16, NvmRomBlockDataAddress=(unset), NvmInitBlockCallback=NULL_PTR, NvmUseJobendCallback=false, NvmJobendCbkAtReadAll=false, NvmSingleBlockCallback=NULL_PTR
        NvmTargetBlockReference
          NvmFeeRef: NvmNameOfFeeBlock=FeeBlockConfiguration52
      Rte_NvmBlock_LrnEOT_LearnedEOT: NvmNvramBlockIdentifier=32, NvmBlockUseCrc=true, NvmBlockUsedCrcType=NVM_CRC16, NvmCalcRamBlockCrc=false, NvmNvBlockLength=10, NvmUseServicePorts=true, NvmResistantToChangedSw=true, NvmSelectBlockForReadall=true, NvmRamBlockDataAddress=Rte_LrnEOT_LearnedEOT, NvmRomBlockDataAddress=T_LearnedEOTInit_Cnt_str, NvmInitBlockCallback=NULL_PTR, NvmUseJobendCallback=false, NvmJobendCbkAtReadAll=false, NvmSingleBlockCallback=NULL_PTR
        NvmTargetBlockReference
          NvmFeeRef: NvmNameOfFeeBlock=FeeBlockConfiguration60
      Rte_NvmBlock_AvgFricLrn_AvgFricLrnData: NvmNvramBlockIdentifier=33, NvmBlockUseCrc=true, NvmBlockUsedCrcType=NVM_CRC16, NvmCalcRamBlockCrc=false, NvmNvBlockLength=203, NvmUseServicePorts=true, NvmResistantToChangedSw=true, NvmSelectBlockForReadall=true, NvmRamBlockDataAddress=Rte_AvgFricLrn_AvgFricLrnData, NvmRomBlockDataAddress=T_AvgFricLrnDataInit_Cnt_str, NvmInitBlockCallback=NULL_PTR, NvmUseJobendCallback=false, NvmJobendCbkAtReadAll=false, NvmSingleBlockCallback=NULL_PTR
        NvmTargetBlockReference
          NvmFeeRef: NvmNameOfFeeBlock=FeeBlockConfiguration61
      Rte_NvmBlock_DigHwTrqSENT_DigTrqTrim: NvmNvramBlockIdentifier=34, NvmBlockUseCrc=false, NvmBlockUsedCrcType=NVM_NOCRC, NvmCalcRamBlockCrc=false, NvmNvBlockLength=5, NvmUseServicePorts=true, NvmResistantToChangedSw=true, NvmSelectBlockForReadall=true, NvmRamBlockDataAddress=Rte_DigHwTrqSENT_DigTrqTrim, NvmRomBlockDataAddress=(unset), NvmInitBlockCallback=NULL_PTR, NvmUseJobendCallback=false, NvmJobendCbkAtReadAll=false, NvmSingleBlockCallback=NULL_PTR
        NvmTargetBlockReference
          NvmFeeRef: NvmNameOfFeeBlock=FeeBlockConfiguration53
      Rte_NvmBlock_CmMtrCurr_CurrTempOffset: NvmNvramBlockIdentifier=35, NvmBlockUseCrc=false, NvmBlockUsedCrcType=NVM_NOCRC, NvmCalcRamBlockCrc=false, NvmNvBlockLength=96, NvmUseServicePorts=true, NvmResistantToChangedSw=true, NvmSelectBlockForReadall=true, NvmRamBlockDataAddress=Rte_CmMtrCurr_CurrTempOffset, NvmRomBlockDataAddress=(unset), NvmInitBlockCallback=NULL_PTR, NvmUseJobendCallback=false, NvmJobendCbkAtReadAll=false, NvmSingleBlockCallback=NULL_PTR
        NvmTargetBlockReference
          NvmFeeRef: NvmNameOfFeeBlock=FeeBlockConfiguration54
      Rte_NvmBlock_CmMtrCurr_ShCurrCal: NvmNvramBlockIdentifier=36, NvmBlockUseCrc=false, NvmBlockUsedCrcType=NVM_NOCRC, NvmCalcRamBlockCrc=false, NvmNvBlockLength=28, NvmUseServicePorts=true, NvmResistantToChangedSw=true, NvmSelectBlockForReadall=true, NvmRamBlockDataAddress=Rte_CmMtrCurr_ShCurrCal, NvmRomBlockDataAddress=(unset), NvmInitBlockCallback=NULL_PTR, NvmUseJobendCallback=false, NvmJobendCbkAtReadAll=false, NvmSingleBlockCallback=NULL_PTR
        NvmTargetBlockReference
          NvmFeeRef: NvmNameOfFeeBlock=FeeBlockConfiguration55
      Rte_NvmBlock_TrqCanc_CogTrqCal: NvmNvramBlockIdentifier=37, NvmBlockUseCrc=false, NvmBlockUsedCrcType=NVM_NOCRC, NvmCalcRamBlockCrc=false, NvmNvBlockLength=1024, NvmUseServicePorts=true, NvmResistantToChangedSw=true, NvmSelectBlockForReadall=true, NvmRamBlockDataAddress=Rte_TrqCanc_CogTrqCal, NvmRomBlockDataAddress=(unset), NvmInitBlockCallback=NULL_PTR, NvmUseJobendCallback=false, NvmJobendCbkAtReadAll=false, NvmSingleBlockCallback=NULL_PTR
        NvmTargetBlockReference
          NvmFeeRef: NvmNameOfFeeBlock=FeeBlockConfiguration56
      Rte_NvmBlock_TrqCanc_CogTrqRplComp: NvmNvramBlockIdentifier=38, NvmBlockUseCrc=false, NvmBlockUsedCrcType=NVM_NOCRC, NvmCalcRamBlockCrc=false, NvmNvBlockLength=18, NvmUseServicePorts=true, NvmResistantToChangedSw=true, NvmSelectBlockForReadall=true, NvmRamBlockDataAddress=Rte_TrqCanc_CogTrqRplComp, NvmRomBlockDataAddress=(unset), NvmInitBlockCallback=NULL_PTR, NvmUseJobendCallback=false, NvmJobendCbkAtReadAll=false, NvmSingleBlockCallback=NULL_PTR
        NvmTargetBlockReference
          NvmFeeRef: NvmNameOfFeeBlock=FeeBlockConfiguration57
      Rte_NvmBlock_AstLmt_SteerAsstDefeat: NvmNvramBlockIdentifier=39, NvmBlockUseCrc=false, NvmBlockUsedCrcType=NVM_NOCRC, NvmCalcRamBlockCrc=false, NvmNvBlockLength=1, NvmUseServicePorts=true, NvmResistantToChangedSw=true, NvmSelectBlockForReadall=true, NvmRamBlockDataAddress=Rte_AstLmt_SteerAsstDefeat, NvmRomBlockDataAddress=(unset), NvmInitBlockCallback=NULL_PTR, NvmUseJobendCallback=false, NvmJobendCbkAtReadAll=false, NvmSingleBlockCallback=NULL_PTR
        NvmTargetBlockReference
          NvmFeeRef: NvmNameOfFeeBlock=FeeBlockConfiguration58
      Rte_NvmBlock_TrqCmdScl_TorqueCmdSF_Uls_f32: NvmNvramBlockIdentifier=40, NvmBlockUseCrc=false, NvmBlockUsedCrcType=NVM_NOCRC, NvmCalcRamBlockCrc=false, NvmNvBlockLength=4, NvmUseServicePorts=true, NvmResistantToChangedSw=true, NvmSelectBlockForReadall=true, NvmRamBlockDataAddress=Rte_TrqCmdScl_TorqueCmdSF_Uls_f32, NvmRomBlockDataAddress=(unset), NvmInitBlockCallback=NULL_PTR, NvmUseJobendCallback=false, NvmJobendCbkAtReadAll=false, NvmSingleBlockCallback=NULL_PTR
        NvmTargetBlockReference
          NvmFeeRef: NvmNameOfFeeBlock=FeeBlockConfiguration59
      Rte_NvmBlock_AbsHwPos_EOLVehCntrOffset: NvmNvramBlockIdentifier=41, NvmBlockUseCrc=false, NvmBlockUsedCrcType=NVM_NOCRC, NvmCalcRamBlockCrc=false, NvmNvBlockLength=6, NvmUseServicePorts=true, NvmResistantToChangedSw=true, NvmSelectBlockForReadall=true, NvmRamBlockDataAddress=Rte_AbsHwPos_EOLVehCntrOffset, NvmRomBlockDataAddress=(unset), NvmInitBlockCallback=NULL_PTR, NvmUseJobendCallback=false, NvmJobendCbkAtReadAll=false, NvmSingleBlockCallback=NULL_PTR
        NvmTargetBlockReference
          NvmFeeRef: NvmNameOfFeeBlock=FeeBlockConfiguration62
      Rte_NvmBlock_Boot_SupplierIdentifierData: NvmNvramBlockIdentifier=42, NvmBlockUseCrc=false, NvmBlockUsedCrcType=NVM_NOCRC, NvmCalcRamBlockCrc=false, NvmNvBlockLength=10, NvmUseServicePorts=false, NvmResistantToChangedSw=false, NvmSelectBlockForReadall=false, NvmRamBlockDataAddress=(unset), NvmRomBlockDataAddress=(unset), NvmInitBlockCallback=NULL_PTR, NvmUseJobendCallback=false, NvmJobendCbkAtReadAll=true, NvmSingleBlockCallback=NULL_PTR
        NvmTargetBlockReference
          NvmFeeRef: NvmNameOfFeeBlock=FeeBlockConfiguration63
      Rte_NvmBlock_Boot_SparePartNumberData: NvmNvramBlockIdentifier=43, NvmBlockUseCrc=false, NvmBlockUsedCrcType=NVM_NOCRC, NvmCalcRamBlockCrc=false, NvmNvBlockLength=10, NvmUseServicePorts=false, NvmResistantToChangedSw=false, NvmSelectBlockForReadall=false, NvmRamBlockDataAddress=(unset), NvmRomBlockDataAddress=(unset), NvmInitBlockCallback=NULL_PTR, NvmUseJobendCallback=false, NvmJobendCbkAtReadAll=true, NvmSingleBlockCallback=NULL_PTR
        NvmTargetBlockReference
          NvmFeeRef: NvmNameOfFeeBlock=FeeBlockConfiguration64
      Rte_NvmBlock_VehDyn_MotPosReset: NvmNvramBlockIdentifier=44, NvmBlockUseCrc=false, NvmBlockUsedCrcType=NVM_NOCRC, NvmCalcRamBlockCrc=false, NvmNvBlockLength=5, NvmUseServicePorts=true, NvmResistantToChangedSw=true, NvmSelectBlockForReadall=true, NvmRamBlockDataAddress=Rte_VehDyn_MotPosReset, NvmRomBlockDataAddress=(unset), NvmInitBlockCallback=NULL_PTR, NvmUseJobendCallback=false, NvmJobendCbkAtReadAll=false, NvmSingleBlockCallback=NULL_PTR
        NvmTargetBlockReference
          NvmFeeRef: NvmNameOfFeeBlock=FeeBlockConfiguration65
      Rte_NvmBlock_DiagSvc_BootSwFingerPrint: NvmNvramBlockIdentifier=45, NvmBlockUseCrc=false, NvmBlockUsedCrcType=NVM_NOCRC, NvmCalcRamBlockCrc=false, NvmNvBlockLength=14, NvmUseServicePorts=true, NvmResistantToChangedSw=true, NvmSelectBlockForReadall=true, NvmRamBlockDataAddress=Rte_DiagSvc_BootSwFingerPrintData, NvmRomBlockDataAddress=(unset), NvmInitBlockCallback=NULL_PTR, NvmUseJobendCallback=false, NvmJobendCbkAtReadAll=false, NvmSingleBlockCallback=NULL_PTR
        NvmTargetBlockReference
          NvmFeeRef: NvmNameOfFeeBlock=FeeBlockConfiguration66
      Rte_NvmBlock_DiagSvc_AppSwFingerPrint: NvmNvramBlockIdentifier=46, NvmBlockUseCrc=false, NvmBlockUsedCrcType=NVM_NOCRC, NvmCalcRamBlockCrc=false, NvmNvBlockLength=14, NvmUseServicePorts=true, NvmResistantToChangedSw=true, NvmSelectBlockForReadall=true, NvmRamBlockDataAddress=Rte_DiagSvc_AppSwFingerPrintData, NvmRomBlockDataAddress=(unset), NvmInitBlockCallback=NULL_PTR, NvmUseJobendCallback=false, NvmJobendCbkAtReadAll=false, NvmSingleBlockCallback=NULL_PTR
        NvmTargetBlockReference
          NvmFeeRef: NvmNameOfFeeBlock=FeeBlockConfiguration67
      Rte_NvmBlock_DiagSvc_SupplierIdentification: NvmNvramBlockIdentifier=47, NvmBlockUseCrc=false, NvmBlockUsedCrcType=NVM_NOCRC, NvmCalcRamBlockCrc=false, NvmNvBlockLength=2, NvmUseServicePorts=false, NvmResistantToChangedSw=false, NvmSelectBlockForReadall=false, NvmRamBlockDataAddress=(unset), NvmRomBlockDataAddress=(unset), NvmInitBlockCallback=NULL_PTR, NvmUseJobendCallback=false, NvmJobendCbkAtReadAll=true, NvmSingleBlockCallback=NULL_PTR
        NvmTargetBlockReference
          NvmFeeRef: NvmNameOfFeeBlock=FeeBlockConfiguration68
      Rte_NvmBlock_DiagSvc_ECUSparePartNo: NvmNvramBlockIdentifier=48, NvmBlockUseCrc=false, NvmBlockUsedCrcType=NVM_NOCRC, NvmCalcRamBlockCrc=false, NvmNvBlockLength=11, NvmUseServicePorts=true, NvmResistantToChangedSw=true, NvmSelectBlockForReadall=true, NvmRamBlockDataAddress=Rte_DiagSvc_ECUSparePartNoData, NvmRomBlockDataAddress=(unset), NvmInitBlockCallback=NULL_PTR, NvmUseJobendCallback=false, NvmJobendCbkAtReadAll=false, NvmSingleBlockCallback=NULL_PTR
        NvmTargetBlockReference
          NvmFeeRef: NvmNameOfFeeBlock=FeeBlockConfiguration69
      Rte_NvmBlock_Boot_VehicleManfSwNo: NvmNvramBlockIdentifier=49, NvmBlockUseCrc=false, NvmBlockUsedCrcType=NVM_NOCRC, NvmCalcRamBlockCrc=false, NvmNvBlockLength=11, NvmUseServicePorts=false, NvmResistantToChangedSw=false, NvmSelectBlockForReadall=false, NvmRamBlockDataAddress=(unset), NvmRomBlockDataAddress=(unset), NvmInitBlockCallback=NULL_PTR, NvmUseJobendCallback=false, NvmJobendCbkAtReadAll=true, NvmSingleBlockCallback=NULL_PTR
        NvmTargetBlockReference
          NvmFeeRef: NvmNameOfFeeBlock=FeeBlockConfiguration70
      Rte_NvmBlock_Boot_VehicleManfHwNo: NvmNvramBlockIdentifier=50, NvmBlockUseCrc=false, NvmBlockUsedCrcType=NVM_NOCRC, NvmCalcRamBlockCrc=false, NvmNvBlockLength=11, NvmUseServicePorts=false, NvmResistantToChangedSw=false, NvmSelectBlockForReadall=false, NvmRamBlockDataAddress=(unset), NvmRomBlockDataAddress=(unset), NvmInitBlockCallback=NULL_PTR, NvmUseJobendCallback=false, NvmJobendCbkAtReadAll=true, NvmSingleBlockCallback=NULL_PTR
        NvmTargetBlockReference
          NvmFeeRef: NvmNameOfFeeBlock=FeeBlockConfiguration71
      Rte_NvmBlock_DiagSvc_VINCurrent: NvmNvramBlockIdentifier=51, NvmBlockUseCrc=false, NvmBlockUsedCrcType=NVM_NOCRC, NvmCalcRamBlockCrc=false, NvmNvBlockLength=17, NvmUseServicePorts=true, NvmResistantToChangedSw=true, NvmSelectBlockForReadall=true, NvmRamBlockDataAddress=Rte_DiagSvc_VINCurrentData, NvmRomBlockDataAddress=(unset), NvmInitBlockCallback=NULL_PTR, NvmUseJobendCallback=false, NvmJobendCbkAtReadAll=false, NvmSingleBlockCallback=NULL_PTR
        NvmTargetBlockReference
          NvmFeeRef: NvmNameOfFeeBlock=FeeBlockConfiguration72
      Rte_NvmBlock_Boot_VehicleIdentificationNo: NvmNvramBlockIdentifier=52, NvmBlockUseCrc=false, NvmBlockUsedCrcType=NVM_NOCRC, NvmCalcRamBlockCrc=false, NvmNvBlockLength=4, NvmUseServicePorts=false, NvmResistantToChangedSw=false, NvmSelectBlockForReadall=false, NvmRamBlockDataAddress=(unset), NvmRomBlockDataAddress=(unset), NvmInitBlockCallback=NULL_PTR, NvmUseJobendCallback=false, NvmJobendCbkAtReadAll=true, NvmSingleBlockCallback=NULL_PTR
        NvmTargetBlockReference
          NvmFeeRef: NvmNameOfFeeBlock=FeeBlockConfiguration73
      Rte_NvmBlock_Boot_DiagnosticIdentificationNo: NvmNvramBlockIdentifier=53, NvmBlockUseCrc=false, NvmBlockUsedCrcType=NVM_NOCRC, NvmCalcRamBlockCrc=false, NvmNvBlockLength=7, NvmUseServicePorts=false, NvmResistantToChangedSw=false, NvmSelectBlockForReadall=false, NvmRamBlockDataAddress=(unset), NvmRomBlockDataAddress=(unset), NvmInitBlockCallback=NULL_PTR, NvmUseJobendCallback=false, NvmJobendCbkAtReadAll=true, NvmSingleBlockCallback=NULL_PTR
        NvmTargetBlockReference
          NvmFeeRef: NvmNameOfFeeBlock=FeeBlockConfiguration74
      Rte_NvmBlock_Boot_ExhaustRegNo: NvmNvramBlockIdentifier=54, NvmBlockUseCrc=false, NvmBlockUsedCrcType=NVM_NOCRC, NvmCalcRamBlockCrc=false, NvmNvBlockLength=6, NvmUseServicePorts=false, NvmResistantToChangedSw=false, NvmSelectBlockForReadall=false, NvmRamBlockDataAddress=(unset), NvmRomBlockDataAddress=(unset), NvmInitBlockCallback=NULL_PTR, NvmUseJobendCallback=false, NvmJobendCbkAtReadAll=true, NvmSingleBlockCallback=NULL_PTR
        NvmTargetBlockReference
          NvmFeeRef: NvmNameOfFeeBlock=FeeBlockConfiguration75
      Rte_NvmBlock_Boot_SwVersionNo: NvmNvramBlockIdentifier=55, NvmBlockUseCrc=false, NvmBlockUsedCrcType=NVM_NOCRC, NvmCalcRamBlockCrc=false, NvmNvBlockLength=13, NvmUseServicePorts=false, NvmResistantToChangedSw=false, NvmSelectBlockForReadall=false, NvmRamBlockDataAddress=(unset), NvmRomBlockDataAddress=(unset), NvmInitBlockCallback=NULL_PTR, NvmUseJobendCallback=false, NvmJobendCbkAtReadAll=true, NvmSingleBlockCallback=NULL_PTR
        NvmTargetBlockReference
          NvmFeeRef: NvmNameOfFeeBlock=FeeBlockConfiguration76
      Rte_NvmBlock_Boot_FeeInitFlag: NvmNvramBlockIdentifier=56, NvmBlockUseCrc=false, NvmBlockUsedCrcType=NVM_NOCRC, NvmCalcRamBlockCrc=false, NvmNvBlockLength=1, NvmUseServicePorts=false, NvmResistantToChangedSw=false, NvmSelectBlockForReadall=false, NvmRamBlockDataAddress=(unset), NvmRomBlockDataAddress=(unset), NvmInitBlockCallback=NULL_PTR, NvmUseJobendCallback=false, NvmJobendCbkAtReadAll=true, NvmSingleBlockCallback=NULL_PTR
        NvmTargetBlockReference
          NvmFeeRef: NvmNameOfFeeBlock=FeeBlockConfiguration77
      Rte_NvmBlock_DiagSvc_EraseRoutineStatus: NvmNvramBlockIdentifier=57, NvmBlockUseCrc=false, NvmBlockUsedCrcType=NVM_NOCRC, NvmCalcRamBlockCrc=false, NvmNvBlockLength=1, NvmUseServicePorts=true, NvmResistantToChangedSw=true, NvmSelectBlockForReadall=true, NvmRamBlockDataAddress=Rte_DiagSvc_EraseRoutineStatusData, NvmRomBlockDataAddress=(unset), NvmInitBlockCallback=NULL_PTR, NvmUseJobendCallback=false, NvmJobendCbkAtReadAll=false, NvmSingleBlockCallback=NULL_PTR
        NvmTargetBlockReference
          NvmFeeRef: NvmNameOfFeeBlock=FeeBlockConfiguration78
      Rte_NvmBlock_DiagSvc_ProgrammingStatus: NvmNvramBlockIdentifier=58, NvmBlockUseCrc=false, NvmBlockUsedCrcType=NVM_NOCRC, NvmCalcRamBlockCrc=false, NvmNvBlockLength=1, NvmUseServicePorts=true, NvmResistantToChangedSw=true, NvmSelectBlockForReadall=true, NvmRamBlockDataAddress=Rte_DiagSvc_ProgrammingStatusData, NvmRomBlockDataAddress=(unset), NvmInitBlockCallback=NULL_PTR, NvmUseJobendCallback=false, NvmJobendCbkAtReadAll=false, NvmSingleBlockCallback=NULL_PTR
        NvmTargetBlockReference
          NvmFeeRef: NvmNameOfFeeBlock=FeeBlockConfiguration79
      Rte_NvmBlock_Boot_NvValidityFlag: NvmNvramBlockIdentifier=59, NvmBlockUseCrc=false, NvmBlockUsedCrcType=NVM_NOCRC, NvmCalcRamBlockCrc=false, NvmNvBlockLength=1, NvmUseServicePorts=false, NvmResistantToChangedSw=false, NvmSelectBlockForReadall=false, NvmRamBlockDataAddress=(unset), NvmRomBlockDataAddress=(unset), NvmInitBlockCallback=NULL_PTR, NvmUseJobendCallback=false, NvmJobendCbkAtReadAll=true, NvmSingleBlockCallback=NULL_PTR
        NvmTargetBlockReference
          NvmFeeRef: NvmNameOfFeeBlock=FeeBlockConfiguration80
      Rte_NvmBlock_Boot_ApplValidityFlag: NvmNvramBlockIdentifier=60, NvmBlockUseCrc=false, NvmBlockUsedCrcType=NVM_NOCRC, NvmCalcRamBlockCrc=false, NvmNvBlockLength=1, NvmUseServicePorts=false, NvmResistantToChangedSw=false, NvmSelectBlockForReadall=false, NvmRamBlockDataAddress=(unset), NvmRomBlockDataAddress=(unset), NvmInitBlockCallback=NULL_PTR, NvmUseJobendCallback=false, NvmJobendCbkAtReadAll=true, NvmSingleBlockCallback=NULL_PTR
        NvmTargetBlockReference
          NvmFeeRef: NvmNameOfFeeBlock=FeeBlockConfiguration81
      Rte_NvmBlock_Boot_UpdateFlag: NvmNvramBlockIdentifier=61, NvmBlockUseCrc=false, NvmBlockUsedCrcType=NVM_NOCRC, NvmCalcRamBlockCrc=false, NvmNvBlockLength=1, NvmUseServicePorts=false, NvmResistantToChangedSw=false, NvmSelectBlockForReadall=false, NvmRamBlockDataAddress=(unset), NvmRomBlockDataAddress=(unset), NvmInitBlockCallback=NULL_PTR, NvmUseJobendCallback=false, NvmJobendCbkAtReadAll=true, NvmSingleBlockCallback=NULL_PTR
        NvmTargetBlockReference
          NvmFeeRef: NvmNameOfFeeBlock=FeeBlockConfiguration82
      Deprecated_Boot_ProgAttemptsCounter: NvmNvramBlockIdentifier=62, NvmBlockUseCrc=false, NvmBlockUsedCrcType=NVM_NOCRC, NvmCalcRamBlockCrc=false, NvmNvBlockLength=2, NvmUseServicePorts=false, NvmResistantToChangedSw=false, NvmSelectBlockForReadall=false, NvmRamBlockDataAddress=Rte_DiagSvc_ProgrammingAttemptCounterData, NvmRomBlockDataAddress=(unset), NvmInitBlockCallback=NULL_PTR, NvmUseJobendCallback=false, NvmJobendCbkAtReadAll=true, NvmSingleBlockCallback=NULL_PTR
        NvmTargetBlockReference
          NvmFeeRef: NvmNameOfFeeBlock=FeeBlockConfiguration83
      Rte_NvmBlock_Boot_ResetResponse: NvmNvramBlockIdentifier=63, NvmBlockUseCrc=false, NvmBlockUsedCrcType=NVM_NOCRC, NvmCalcRamBlockCrc=false, NvmNvBlockLength=2, NvmUseServicePorts=false, NvmResistantToChangedSw=false, NvmSelectBlockForReadall=false, NvmRamBlockDataAddress=(unset), NvmRomBlockDataAddress=(unset), NvmInitBlockCallback=NULL_PTR, NvmUseJobendCallback=false, NvmJobendCbkAtReadAll=true, NvmSingleBlockCallback=NULL_PTR
        NvmTargetBlockReference
          NvmFeeRef: NvmNameOfFeeBlock=FeeBlockConfiguration84
      Rte_NvmBlock_Boot_LbAddress: NvmNvramBlockIdentifier=64, NvmBlockUseCrc=false, NvmBlockUsedCrcType=NVM_NOCRC, NvmCalcRamBlockCrc=false, NvmNvBlockLength=4, NvmUseServicePorts=false, NvmResistantToChangedSw=false, NvmSelectBlockForReadall=false, NvmRamBlockDataAddress=(unset), NvmRomBlockDataAddress=(unset), NvmInitBlockCallback=NULL_PTR, NvmUseJobendCallback=false, NvmJobendCbkAtReadAll=true, NvmSingleBlockCallback=NULL_PTR
        NvmTargetBlockReference
          NvmFeeRef: NvmNameOfFeeBlock=FeeBlockConfiguration85
      Rte_NvmBlock_Boot_LbLength: NvmNvramBlockIdentifier=65, NvmBlockUseCrc=false, NvmBlockUsedCrcType=NVM_NOCRC, NvmCalcRamBlockCrc=false, NvmNvBlockLength=4, NvmUseServicePorts=false, NvmResistantToChangedSw=false, NvmSelectBlockForReadall=false, NvmRamBlockDataAddress=(unset), NvmRomBlockDataAddress=(unset), NvmInitBlockCallback=NULL_PTR, NvmUseJobendCallback=false, NvmJobendCbkAtReadAll=true, NvmSingleBlockCallback=NULL_PTR
        NvmTargetBlockReference
          NvmFeeRef: NvmNameOfFeeBlock=FeeBlockConfiguration86
      Rte_NvmBlock_Boot_NvCrc: NvmNvramBlockIdentifier=66, NvmBlockUseCrc=false, NvmBlockUsedCrcType=NVM_NOCRC, NvmCalcRamBlockCrc=false, NvmNvBlockLength=4, NvmUseServicePorts=false, NvmResistantToChangedSw=false, NvmSelectBlockForReadall=false, NvmRamBlockDataAddress=(unset), NvmRomBlockDataAddress=(unset), NvmInitBlockCallback=NULL_PTR, NvmUseJobendCallback=false, NvmJobendCbkAtReadAll=true, NvmSingleBlockCallback=NULL_PTR
        NvmTargetBlockReference
          NvmFeeRef: NvmNameOfFeeBlock=FeeBlockConfiguration87
      Rte_NvmBlock_Sa_DigColPs_DigColPsEOL: NvmNvramBlockIdentifier=67, NvmBlockUseCrc=false, NvmBlockUsedCrcType=NVM_NOCRC, NvmCalcRamBlockCrc=false, NvmNvBlockLength=20, NvmUseServicePorts=true, NvmResistantToChangedSw=true, NvmSelectBlockForReadall=true, NvmRamBlockDataAddress=Rte_Sa_DigColPs_DigColPsEOL, NvmRomBlockDataAddress=(unset), NvmInitBlockCallback=NULL_PTR, NvmUseJobendCallback=false, NvmJobendCbkAtReadAll=false, NvmSingleBlockCallback=NULL_PTR
        NvmTargetBlockReference
          NvmFeeRef: NvmNameOfFeeBlock=FeeBlockConfiguration88
      Rte_NvmBlock_Boot: NvmNvramBlockIdentifier=68, NvmBlockUseCrc=false, NvmBlockUsedCrcType=NVM_NOCRC, NvmCalcRamBlockCrc=false, NvmNvBlockLength=4, NvmUseServicePorts=false, NvmResistantToChangedSw=false, NvmSelectBlockForReadall=false, NvmRamBlockDataAddress=(unset), NvmRomBlockDataAddress=(unset), NvmInitBlockCallback=NULL_PTR, NvmUseJobendCallback=false, NvmJobendCbkAtReadAll=true, NvmSingleBlockCallback=NULL_PTR
        NvmTargetBlockReference
          NvmFeeRef: NvmNameOfFeeBlock=FeeBlockConfiguration111
      Deprecated_Dem_NvBlock_AdminData: NvmNvramBlockIdentifier=69, NvmBlockUseCrc=false, NvmBlockUsedCrcType=NVM_NOCRC, NvmCalcRamBlockCrc=false, NvmNvBlockLength=1, NvmUseServicePorts=false, NvmResistantToChangedSw=true, NvmSelectBlockForReadall=false, NvmRamBlockDataAddress=(unset), NvmRomBlockDataAddress=(unset), NvmInitBlockCallback=Dem_NvM_InitAdminData, NvmUseJobendCallback=true, NvmJobendCbkAtReadAll=true, NvmSingleBlockCallback=(unset)
        NvmTargetBlockReference
          NvmFeeRef: NvmNameOfFeeBlock=FeeBlockConfiguration101
      Deprecated_Dem_NvBlock_EventData: NvmNvramBlockIdentifier=70, NvmBlockUseCrc=false, NvmBlockUsedCrcType=NVM_NOCRC, NvmCalcRamBlockCrc=false, NvmNvBlockLength=1, NvmUseServicePorts=false, NvmResistantToChangedSw=true, NvmSelectBlockForReadall=false, NvmRamBlockDataAddress=(unset), NvmRomBlockDataAddress=(unset), NvmInitBlockCallback=Dem_NvM_InitEventStatusData, NvmUseJobendCallback=true, NvmJobendCbkAtReadAll=true, NvmSingleBlockCallback=(unset)
        NvmTargetBlockReference
          NvmFeeRef: NvmNameOfFeeBlock=FeeBlockConfiguration102
      Deprecated_Dem_NvBlock_PrimaryEntry1: NvmNvramBlockIdentifier=71, NvmBlockUseCrc=false, NvmBlockUsedCrcType=NVM_NOCRC, NvmCalcRamBlockCrc=false, NvmNvBlockLength=1, NvmUseServicePorts=false, NvmResistantToChangedSw=true, NvmSelectBlockForReadall=false, NvmRamBlockDataAddress=(unset), NvmRomBlockDataAddress=(unset), NvmInitBlockCallback=(unset), NvmUseJobendCallback=true, NvmJobendCbkAtReadAll=true, NvmSingleBlockCallback=Dem_NvM_JobFinished
        NvmTargetBlockReference
          NvmFeeRef: NvmNameOfFeeBlock=FeeBlockConfiguration103
      Deprecated_Dem_NvBlock_PrimaryEntry2: NvmNvramBlockIdentifier=72, NvmBlockUseCrc=false, NvmBlockUsedCrcType=NVM_NOCRC, NvmCalcRamBlockCrc=false, NvmNvBlockLength=1, NvmUseServicePorts=false, NvmResistantToChangedSw=true, NvmSelectBlockForReadall=false, NvmRamBlockDataAddress=(unset), NvmRomBlockDataAddress=Dem_Cfg_NvPrimaryEntry_Zero, NvmInitBlockCallback=(unset), NvmUseJobendCallback=true, NvmJobendCbkAtReadAll=true, NvmSingleBlockCallback=Dem_NvM_JobFinished
        NvmTargetBlockReference
          NvmFeeRef: NvmNameOfFeeBlock=FeeBlockConfiguration104
      Deprecated_Dem_NvBlock_PrimaryEntry3: NvmNvramBlockIdentifier=73, NvmBlockUseCrc=false, NvmBlockUsedCrcType=NVM_NOCRC, NvmCalcRamBlockCrc=false, NvmNvBlockLength=1, NvmUseServicePorts=false, NvmResistantToChangedSw=true, NvmSelectBlockForReadall=false, NvmRamBlockDataAddress=(unset), NvmRomBlockDataAddress=Dem_Cfg_NvPrimaryEntry_Zero, NvmInitBlockCallback=(unset), NvmUseJobendCallback=true, NvmJobendCbkAtReadAll=true, NvmSingleBlockCallback=Dem_NvM_JobFinished
        NvmTargetBlockReference
          NvmFeeRef: NvmNameOfFeeBlock=FeeBlockConfiguration105
      Deprecated_Dem_NvBlock_PrimaryEntry4: NvmNvramBlockIdentifier=74, NvmBlockUseCrc=false, NvmBlockUsedCrcType=NVM_NOCRC, NvmCalcRamBlockCrc=false, NvmNvBlockLength=1, NvmUseServicePorts=false, NvmResistantToChangedSw=true, NvmSelectBlockForReadall=false, NvmRamBlockDataAddress=(unset), NvmRomBlockDataAddress=Dem_Cfg_NvPrimaryEntry_Zero, NvmInitBlockCallback=(unset), NvmUseJobendCallback=true, NvmJobendCbkAtReadAll=true, NvmSingleBlockCallback=Dem_NvM_JobFinished
        NvmTargetBlockReference
          NvmFeeRef: NvmNameOfFeeBlock=FeeBlockConfiguration106
      Deprecated_Dem_NvBlock_PrimaryEntry5: NvmNvramBlockIdentifier=75, NvmBlockUseCrc=false, NvmBlockUsedCrcType=NVM_NOCRC, NvmCalcRamBlockCrc=false, NvmNvBlockLength=1, NvmUseServicePorts=false, NvmResistantToChangedSw=true, NvmSelectBlockForReadall=false, NvmRamBlockDataAddress=(unset), NvmRomBlockDataAddress=Dem_Cfg_NvPrimaryEntry_Zero, NvmInitBlockCallback=(unset), NvmUseJobendCallback=true, NvmJobendCbkAtReadAll=true, NvmSingleBlockCallback=Dem_NvM_JobFinished
        NvmTargetBlockReference
          NvmFeeRef: NvmNameOfFeeBlock=FeeBlockConfiguration107
      Deprecated_Dem_NvBlock_PrimaryEntry6: NvmNvramBlockIdentifier=76, NvmBlockUseCrc=false, NvmBlockUsedCrcType=NVM_NOCRC, NvmCalcRamBlockCrc=false, NvmNvBlockLength=1, NvmUseServicePorts=false, NvmResistantToChangedSw=true, NvmSelectBlockForReadall=false, NvmRamBlockDataAddress=(unset), NvmRomBlockDataAddress=Dem_Cfg_NvPrimaryEntry_Zero, NvmInitBlockCallback=(unset), NvmUseJobendCallback=true, NvmJobendCbkAtReadAll=true, NvmSingleBlockCallback=Dem_NvM_JobFinished
        NvmTargetBlockReference
          NvmFeeRef: NvmNameOfFeeBlock=FeeBlockConfiguration108
      Deprecated_Dem_NvBlock_PrimaryEntry7: NvmNvramBlockIdentifier=77, NvmBlockUseCrc=false, NvmBlockUsedCrcType=NVM_NOCRC, NvmCalcRamBlockCrc=false, NvmNvBlockLength=1, NvmUseServicePorts=false, NvmResistantToChangedSw=true, NvmSelectBlockForReadall=false, NvmRamBlockDataAddress=(unset), NvmRomBlockDataAddress=Dem_Cfg_NvPrimaryEntry_Zero, NvmInitBlockCallback=(unset), NvmUseJobendCallback=true, NvmJobendCbkAtReadAll=true, NvmSingleBlockCallback=Dem_NvM_JobFinished
        NvmTargetBlockReference
          NvmFeeRef: NvmNameOfFeeBlock=FeeBlockConfiguration109
      Deprecated_Dem_NvBlock_PrimaryEntry8: NvmNvramBlockIdentifier=78, NvmBlockUseCrc=false, NvmBlockUsedCrcType=NVM_NOCRC, NvmCalcRamBlockCrc=false, NvmNvBlockLength=1, NvmUseServicePorts=false, NvmResistantToChangedSw=true, NvmSelectBlockForReadall=false, NvmRamBlockDataAddress=(unset), NvmRomBlockDataAddress=Dem_Cfg_NvPrimaryEntry_Zero, NvmInitBlockCallback=(unset), NvmUseJobendCallback=true, NvmJobendCbkAtReadAll=true, NvmSingleBlockCallback=Dem_NvM_JobFinished
        NvmTargetBlockReference
          NvmFeeRef: NvmNameOfFeeBlock=FeeBlockConfiguration110
      Deprecated_Rte_NvmBlock_DiagSvc_ProxiConfigurationData: NvmNvramBlockIdentifier=79, NvmBlockUseCrc=false, NvmBlockUsedCrcType=NVM_NOCRC, NvmCalcRamBlockCrc=false, NvmNvBlockLength=6, NvmUseServicePorts=true, NvmResistantToChangedSw=true, NvmSelectBlockForReadall=false, NvmRamBlockDataAddress=(unset), NvmRomBlockDataAddress=(unset), NvmInitBlockCallback=NULL_PTR, NvmUseJobendCallback=false, NvmJobendCbkAtReadAll=false, NvmSingleBlockCallback=NULL_PTR
        NvmTargetBlockReference
          NvmFeeRef: NvmNameOfFeeBlock=FeeBlockConfiguration89
      Dem_NvBlock_AdminData: NvmNvramBlockIdentifier=80, NvmBlockUseCrc=false, NvmBlockUsedCrcType=NVM_NOCRC, NvmCalcRamBlockCrc=false, NvmNvBlockLength=12, NvmUseServicePorts=false, NvmResistantToChangedSw=true, NvmUseJobendCallback=true, NvmJobendCbkAtReadAll=true, NvmSelectBlockForReadall=true, NvmRamBlockDataAddress=Dem_Cfg_NvAdminData, NvmRomBlockDataAddress=, NvmInitBlockCallback=Dem_NvM_InitAdminData, NvmSingleBlockCallback=
        NvmTargetBlockReference
          NvmFeeRef: NvmNameOfFeeBlock=FeeBlockConfiguration90
      Dem_NvBlock_EventData: NvmNvramBlockIdentifier=81, NvmBlockUseCrc=false, NvmBlockUsedCrcType=NVM_NOCRC, NvmCalcRamBlockCrc=false, NvmNvBlockLength=72, NvmUseServicePorts=false, NvmResistantToChangedSw=true, NvmUseJobendCallback=true, NvmJobendCbkAtReadAll=true, NvmSelectBlockForReadall=true, NvmRamBlockDataAddress=Dem_Cfg_NvEventStatusData, NvmRomBlockDataAddress=, NvmInitBlockCallback=Dem_NvM_InitEventStatusData, NvmSingleBlockCallback=
        NvmTargetBlockReference
          NvmFeeRef: NvmNameOfFeeBlock=FeeBlockConfiguration91
      Dem_NvBlock_PrimaryEntry1: NvmNvramBlockIdentifier=82, NvmBlockUseCrc=false, NvmBlockUsedCrcType=NVM_NOCRC, NvmCalcRamBlockCrc=false, NvmNvBlockLength=40, NvmUseServicePorts=false, NvmResistantToChangedSw=true, NvmUseJobendCallback=true, NvmJobendCbkAtReadAll=true, NvmSelectBlockForReadall=true, NvmRamBlockDataAddress=Dem_Cfg_NvPrimaryEntry_1, NvmRomBlockDataAddress=Dem_Cfg_NvPrimaryEntry_Zero, NvmInitBlockCallback=, NvmSingleBlockCallback=Dem_NvM_JobFinished
        NvmTargetBlockReference
          NvmFeeRef: NvmNameOfFeeBlock=FeeBlockConfiguration92
      Dem_NvBlock_PrimaryEntry2: NvmNvramBlockIdentifier=83, NvmBlockUseCrc=false, NvmBlockUsedCrcType=NVM_NOCRC, NvmCalcRamBlockCrc=false, NvmNvBlockLength=40, NvmUseServicePorts=false, NvmResistantToChangedSw=true, NvmUseJobendCallback=true, NvmJobendCbkAtReadAll=true, NvmSelectBlockForReadall=true, NvmRamBlockDataAddress=Dem_Cfg_NvPrimaryEntry_2, NvmRomBlockDataAddress=Dem_Cfg_NvPrimaryEntry_Zero, NvmInitBlockCallback=, NvmSingleBlockCallback=Dem_NvM_JobFinished
        NvmTargetBlockReference
          NvmFeeRef: NvmNameOfFeeBlock=FeeBlockConfiguration93
      Dem_NvBlock_PrimaryEntry3: NvmNvramBlockIdentifier=84, NvmBlockUseCrc=false, NvmBlockUsedCrcType=NVM_NOCRC, NvmCalcRamBlockCrc=false, NvmNvBlockLength=40, NvmUseServicePorts=false, NvmResistantToChangedSw=true, NvmUseJobendCallback=true, NvmJobendCbkAtReadAll=true, NvmSelectBlockForReadall=true, NvmRamBlockDataAddress=Dem_Cfg_NvPrimaryEntry_3, NvmRomBlockDataAddress=Dem_Cfg_NvPrimaryEntry_Zero, NvmInitBlockCallback=, NvmSingleBlockCallback=Dem_NvM_JobFinished
        NvmTargetBlockReference
          NvmFeeRef: NvmNameOfFeeBlock=FeeBlockConfiguration94
      Dem_NvBlock_PrimaryEntry4: NvmNvramBlockIdentifier=85, NvmBlockUseCrc=false, NvmBlockUsedCrcType=NVM_NOCRC, NvmCalcRamBlockCrc=false, NvmNvBlockLength=40, NvmUseServicePorts=false, NvmResistantToChangedSw=true, NvmUseJobendCallback=true, NvmJobendCbkAtReadAll=true, NvmSelectBlockForReadall=true, NvmRamBlockDataAddress=Dem_Cfg_NvPrimaryEntry_4, NvmRomBlockDataAddress=Dem_Cfg_NvPrimaryEntry_Zero, NvmInitBlockCallback=, NvmSingleBlockCallback=Dem_NvM_JobFinished
        NvmTargetBlockReference
          NvmFeeRef: NvmNameOfFeeBlock=FeeBlockConfiguration95
      Dem_NvBlock_PrimaryEntry5: NvmNvramBlockIdentifier=86, NvmBlockUseCrc=false, NvmBlockUsedCrcType=NVM_NOCRC, NvmCalcRamBlockCrc=false, NvmNvBlockLength=40, NvmUseServicePorts=false, NvmResistantToChangedSw=true, NvmUseJobendCallback=true, NvmJobendCbkAtReadAll=true, NvmSelectBlockForReadall=true, NvmRamBlockDataAddress=Dem_Cfg_NvPrimaryEntry_5, NvmRomBlockDataAddress=Dem_Cfg_NvPrimaryEntry_Zero, NvmInitBlockCallback=, NvmSingleBlockCallback=Dem_NvM_JobFinished
        NvmTargetBlockReference
          NvmFeeRef: NvmNameOfFeeBlock=FeeBlockConfiguration96
      Dem_NvBlock_PrimaryEntry6: NvmNvramBlockIdentifier=87, NvmBlockUseCrc=false, NvmBlockUsedCrcType=NVM_NOCRC, NvmCalcRamBlockCrc=false, NvmNvBlockLength=40, NvmUseServicePorts=false, NvmResistantToChangedSw=true, NvmUseJobendCallback=true, NvmJobendCbkAtReadAll=true, NvmSelectBlockForReadall=true, NvmRamBlockDataAddress=Dem_Cfg_NvPrimaryEntry_6, NvmRomBlockDataAddress=Dem_Cfg_NvPrimaryEntry_Zero, NvmInitBlockCallback=, NvmSingleBlockCallback=Dem_NvM_JobFinished
        NvmTargetBlockReference
          NvmFeeRef: NvmNameOfFeeBlock=FeeBlockConfiguration97
      Dem_NvBlock_PrimaryEntry7: NvmNvramBlockIdentifier=88, NvmBlockUseCrc=false, NvmBlockUsedCrcType=NVM_NOCRC, NvmCalcRamBlockCrc=false, NvmNvBlockLength=40, NvmUseServicePorts=false, NvmResistantToChangedSw=true, NvmUseJobendCallback=true, NvmJobendCbkAtReadAll=true, NvmSelectBlockForReadall=true, NvmRamBlockDataAddress=Dem_Cfg_NvPrimaryEntry_7, NvmRomBlockDataAddress=Dem_Cfg_NvPrimaryEntry_Zero, NvmInitBlockCallback=, NvmSingleBlockCallback=Dem_NvM_JobFinished
        NvmTargetBlockReference
          NvmFeeRef: NvmNameOfFeeBlock=FeeBlockConfiguration98
      Dem_NvBlock_PrimaryEntry8: NvmNvramBlockIdentifier=89, NvmBlockUseCrc=false, NvmBlockUsedCrcType=NVM_NOCRC, NvmCalcRamBlockCrc=false, NvmNvBlockLength=40, NvmUseServicePorts=false, NvmResistantToChangedSw=true, NvmUseJobendCallback=true, NvmJobendCbkAtReadAll=true, NvmSelectBlockForReadall=true, NvmRamBlockDataAddress=Dem_Cfg_NvPrimaryEntry_8, NvmRomBlockDataAddress=Dem_Cfg_NvPrimaryEntry_Zero, NvmInitBlockCallback=, NvmSingleBlockCallback=Dem_NvM_JobFinished
        NvmTargetBlockReference
          NvmFeeRef: NvmNameOfFeeBlock=FeeBlockConfiguration99
      Dem_NvBlock_PrimaryEntry9: NvmNvramBlockIdentifier=90, NvmBlockUseCrc=false, NvmBlockUsedCrcType=NVM_NOCRC, NvmCalcRamBlockCrc=false, NvmNvBlockLength=40, NvmUseServicePorts=false, NvmResistantToChangedSw=true, NvmUseJobendCallback=true, NvmJobendCbkAtReadAll=true, NvmSelectBlockForReadall=true, NvmRamBlockDataAddress=Dem_Cfg_NvPrimaryEntry_9, NvmRomBlockDataAddress=Dem_Cfg_NvPrimaryEntry_Zero, NvmInitBlockCallback=, NvmSingleBlockCallback=Dem_NvM_JobFinished
        NvmTargetBlockReference
          NvmFeeRef: NvmNameOfFeeBlock=FeeBlockConfiguration100
      Dem_NvBlock_PrimaryEntry10: NvmNvramBlockIdentifier=91, NvmBlockUseCrc=false, NvmBlockUsedCrcType=NVM_NOCRC, NvmCalcRamBlockCrc=false, NvmNvBlockLength=40, NvmUseServicePorts=false, NvmResistantToChangedSw=true, NvmUseJobendCallback=true, NvmJobendCbkAtReadAll=true, NvmSelectBlockForReadall=true, NvmRamBlockDataAddress=Dem_Cfg_NvPrimaryEntry_10, NvmRomBlockDataAddress=Dem_Cfg_NvPrimaryEntry_Zero, NvmInitBlockCallback=, NvmSingleBlockCallback=Dem_NvM_JobFinished
        NvmTargetBlockReference
          NvmFeeRef: NvmNameOfFeeBlock=FeeBlockConfiguration112
      Rte_NvmBlock_DiagSvc_ProxiConfigurationData: NvmNvramBlockIdentifier=92, NvmBlockUseCrc=false, NvmBlockUsedCrcType=NVM_NOCRC, NvmCalcRamBlockCrc=false, NvmNvBlockLength=255, NvmUseServicePorts=true, NvmResistantToChangedSw=true, NvmSelectBlockForReadall=true, NvmRamBlockDataAddress=Rte_DiagSvc_ProxiConfigurationData, NvmRomBlockDataAddress=(unset), NvmInitBlockCallback=NULL_PTR, NvmUseJobendCallback=false, NvmJobendCbkAtReadAll=false, NvmSingleBlockCallback=NULL_PTR
        NvmTargetBlockReference
          NvmFeeRef: NvmNameOfFeeBlock=FeeBlockConfiguration113
      Rte_NvmBlock_DiagSvc_ProxiCounter: NvmNvramBlockIdentifier=93, NvmBlockUseCrc=false, NvmBlockUsedCrcType=NVM_NOCRC, NvmCalcRamBlockCrc=false, NvmNvBlockLength=1, NvmUseServicePorts=true, NvmResistantToChangedSw=true, NvmSelectBlockForReadall=true, NvmRamBlockDataAddress=Rte_DiagSvc_ProxiCounterData, NvmRomBlockDataAddress=(unset), NvmInitBlockCallback=NULL_PTR, NvmUseJobendCallback=false, NvmJobendCbkAtReadAll=false, NvmSingleBlockCallback=NULL_PTR
        NvmTargetBlockReference
          NvmFeeRef: NvmNameOfFeeBlock=FeeBlockConfiguration114
      Rte_NvmBlock_DiagSvc_CalSwFingerPrint: NvmNvramBlockIdentifier=94, NvmBlockUseCrc=false, NvmBlockUsedCrcType=NVM_NOCRC, NvmCalcRamBlockCrc=false, NvmNvBlockLength=14, NvmUseServicePorts=true, NvmResistantToChangedSw=true, NvmSelectBlockForReadall=true, NvmRamBlockDataAddress=Rte_DiagSvc_CalSwFingerPrintData, NvmRomBlockDataAddress=(unset), NvmInitBlockCallback=NULL_PTR, NvmUseJobendCallback=false, NvmJobendCbkAtReadAll=false, NvmSingleBlockCallback=NULL_PTR
        NvmTargetBlockReference
          NvmFeeRef: NvmNameOfFeeBlock=FeeBlockConfiguration115
      Rte_NvmBlock_DiagSvc_ECULifeTimeMins: NvmNvramBlockIdentifier=95, NvmBlockUseCrc=false, NvmBlockUsedCrcType=NVM_NOCRC, NvmCalcRamBlockCrc=false, NvmNvBlockLength=4, NvmUseServicePorts=true, NvmResistantToChangedSw=true, NvmSelectBlockForReadall=true, NvmRamBlockDataAddress=Rte_DiagSvc_ECULifeTimeMinsData, NvmRomBlockDataAddress=(unset), NvmInitBlockCallback=NULL_PTR, NvmUseJobendCallback=false, NvmJobendCbkAtReadAll=false, NvmSingleBlockCallback=NULL_PTR
        NvmTargetBlockReference
          NvmFeeRef: NvmNameOfFeeBlock=FeeBlockConfiguration116
      Rte_NvmBlock_DiagSvc_FirstDTCDetectMins: NvmNvramBlockIdentifier=96, NvmBlockUseCrc=false, NvmBlockUsedCrcType=NVM_NOCRC, NvmCalcRamBlockCrc=false, NvmNvBlockLength=4, NvmUseServicePorts=true, NvmResistantToChangedSw=true, NvmSelectBlockForReadall=true, NvmRamBlockDataAddress=Rte_DiagSvc_FirstDTCDetectMinsData, NvmRomBlockDataAddress=(unset), NvmInitBlockCallback=NULL_PTR, NvmUseJobendCallback=false, NvmJobendCbkAtReadAll=false, NvmSingleBlockCallback=NULL_PTR
        NvmTargetBlockReference
          NvmFeeRef: NvmNameOfFeeBlock=FeeBlockConfiguration117
      Rte_NvmBlock_DiagSvc_FirstDTCDetectSecs: NvmNvramBlockIdentifier=97, NvmBlockUseCrc=false, NvmBlockUsedCrcType=NVM_NOCRC, NvmCalcRamBlockCrc=false, NvmNvBlockLength=2, NvmUseServicePorts=true, NvmResistantToChangedSw=true, NvmSelectBlockForReadall=true, NvmRamBlockDataAddress=Rte_DiagSvc_FirstDTCDetectSecsData, NvmRomBlockDataAddress=(unset), NvmInitBlockCallback=NULL_PTR, NvmUseJobendCallback=false, NvmJobendCbkAtReadAll=false, NvmSingleBlockCallback=NULL_PTR
        NvmTargetBlockReference
          NvmFeeRef: NvmNameOfFeeBlock=FeeBlockConfiguration118
      Rte_NvmBlock_DiagSvc_EOLConfigData: NvmNvramBlockIdentifier=98, NvmBlockUseCrc=false, NvmBlockUsedCrcType=NVM_NOCRC, NvmCalcRamBlockCrc=false, NvmNvBlockLength=9, NvmUseServicePorts=true, NvmResistantToChangedSw=true, NvmSelectBlockForReadall=true, NvmRamBlockDataAddress=Rte_DiagSvc_EOLConfigurationData, NvmRomBlockDataAddress=(unset), NvmInitBlockCallback=NULL_PTR, NvmUseJobendCallback=false, NvmJobendCbkAtReadAll=false, NvmSingleBlockCallback=NULL_PTR
        NvmTargetBlockReference
          NvmFeeRef: NvmNameOfFeeBlock=FeeBlockConfiguration119
      Rte_NvmBlock_DiagSvc_ProgAttemptsCounter: NvmNvramBlockIdentifier=99, NvmBlockUseCrc=false, NvmBlockUsedCrcType=NVM_NOCRC, NvmCalcRamBlockCrc=false, NvmNvBlockLength=8, NvmUseServicePorts=true, NvmResistantToChangedSw=true, NvmSelectBlockForReadall=true, NvmRamBlockDataAddress=Rte_DiagSvc_ProgrammingAttemptCounterData, NvmRomBlockDataAddress=(unset), NvmInitBlockCallback=NULL_PTR, NvmUseJobendCallback=false, NvmJobendCbkAtReadAll=false, NvmSingleBlockCallback=NULL_PTR
        NvmTargetBlockReference
          NvmFeeRef: NvmNameOfFeeBlock=FeeBlockConfiguration120
      Rte_NvmBlock_DiagSvc_VINOriginal: NvmNvramBlockIdentifier=100, NvmBlockUseCrc=false, NvmBlockUsedCrcType=NVM_NOCRC, NvmCalcRamBlockCrc=false, NvmNvBlockLength=17, NvmUseServicePorts=true, NvmResistantToChangedSw=true, NvmSelectBlockForReadall=true, NvmRamBlockDataAddress=Rte_DiagSvc_VINOriginalData, NvmRomBlockDataAddress=(unset), NvmInitBlockCallback=NULL_PTR, NvmUseJobendCallback=false, NvmJobendCbkAtReadAll=false, NvmSingleBlockCallback=NULL_PTR
        NvmTargetBlockReference
          NvmFeeRef: NvmNameOfFeeBlock=FeeBlockConfiguration121
      Rte_NvmBlock_DiagSvc_ECUSerialNumber: NvmNvramBlockIdentifier=101, NvmBlockUseCrc=false, NvmBlockUsedCrcType=NVM_NOCRC, NvmCalcRamBlockCrc=false, NvmNvBlockLength=16, NvmUseServicePorts=true, NvmResistantToChangedSw=true, NvmSelectBlockForReadall=true, NvmRamBlockDataAddress=Rte_DiagSvc_ECUSerialNumberData, NvmRomBlockDataAddress=(unset), NvmInitBlockCallback=NULL_PTR, NvmUseJobendCallback=false, NvmJobendCbkAtReadAll=false, NvmSingleBlockCallback=NULL_PTR
        NvmTargetBlockReference
          NvmFeeRef: NvmNameOfFeeBlock=FeeBlockConfiguration122
      Rte_NvmBlock_DiagSvc_TotalOdometer: NvmNvramBlockIdentifier=102, NvmBlockUseCrc=false, NvmBlockUsedCrcType=NVM_NOCRC, NvmCalcRamBlockCrc=false, NvmNvBlockLength=2, NvmUseServicePorts=true, NvmResistantToChangedSw=true, NvmSelectBlockForReadall=true, NvmRamBlockDataAddress=Rte_DiagSvc_TotalOdometerData, NvmRomBlockDataAddress=(unset), NvmInitBlockCallback=NULL_PTR, NvmUseJobendCallback=false, NvmJobendCbkAtReadAll=false, NvmSingleBlockCallback=NULL_PTR
        NvmTargetBlockReference
          NvmFeeRef: NvmNameOfFeeBlock=FeeBlockConfiguration123
      Rte_NvmBlock_DiagSvc_OdometerFlashProg: NvmNvramBlockIdentifier=103, NvmBlockUseCrc=false, NvmBlockUsedCrcType=NVM_NOCRC, NvmCalcRamBlockCrc=false, NvmNvBlockLength=2, NvmUseServicePorts=true, NvmResistantToChangedSw=true, NvmSelectBlockForReadall=true, NvmRamBlockDataAddress=Rte_DiagSvc_OdometerFlashProgData, NvmRomBlockDataAddress=(unset), NvmInitBlockCallback=NULL_PTR, NvmUseJobendCallback=false, NvmJobendCbkAtReadAll=false, NvmSingleBlockCallback=NULL_PTR
        NvmTargetBlockReference
          NvmFeeRef: NvmNameOfFeeBlock=FeeBlockConfiguration124
      Rte_NvmBlock_Boot_DIDF100: NvmNvramBlockIdentifier=104, NvmBlockUseCrc=false, NvmBlockUsedCrcType=NVM_NOCRC, NvmCalcRamBlockCrc=false, NvmNvBlockLength=7, NvmUseServicePorts=false, NvmResistantToChangedSw=false, NvmSelectBlockForReadall=false, NvmRamBlockDataAddress=(unset), NvmRomBlockDataAddress=(unset), NvmInitBlockCallback=NULL_PTR, NvmUseJobendCallback=false, NvmJobendCbkAtReadAll=true, NvmSingleBlockCallback=NULL_PTR
        NvmTargetBlockReference
          NvmFeeRef: NvmNameOfFeeBlock=FeeBlockConfiguration125
      Rte_NvmBlock_Boot_DIDF181: NvmNvramBlockIdentifier=105, NvmBlockUseCrc=false, NvmBlockUsedCrcType=NVM_NOCRC, NvmCalcRamBlockCrc=false, NvmNvBlockLength=14, NvmUseServicePorts=false, NvmResistantToChangedSw=false, NvmSelectBlockForReadall=false, NvmRamBlockDataAddress=(unset), NvmRomBlockDataAddress=(unset), NvmInitBlockCallback=NULL_PTR, NvmUseJobendCallback=false, NvmJobendCbkAtReadAll=true, NvmSingleBlockCallback=NULL_PTR
        NvmTargetBlockReference
          NvmFeeRef: NvmNameOfFeeBlock=FeeBlockConfiguration126
      Rte_NvmBlock_Boot_DIDF182: NvmNvramBlockIdentifier=106, NvmBlockUseCrc=false, NvmBlockUsedCrcType=NVM_NOCRC, NvmCalcRamBlockCrc=false, NvmNvBlockLength=14, NvmUseServicePorts=false, NvmResistantToChangedSw=false, NvmSelectBlockForReadall=false, NvmRamBlockDataAddress=(unset), NvmRomBlockDataAddress=(unset), NvmInitBlockCallback=NULL_PTR, NvmUseJobendCallback=false, NvmJobendCbkAtReadAll=true, NvmSingleBlockCallback=NULL_PTR
        NvmTargetBlockReference
          NvmFeeRef: NvmNameOfFeeBlock=FeeBlockConfiguration127
      Rte_NvmBlock_Boot_DIDF187: NvmNvramBlockIdentifier=107, NvmBlockUseCrc=false, NvmBlockUsedCrcType=NVM_NOCRC, NvmCalcRamBlockCrc=false, NvmNvBlockLength=11, NvmUseServicePorts=false, NvmResistantToChangedSw=false, NvmSelectBlockForReadall=false, NvmRamBlockDataAddress=(unset), NvmRomBlockDataAddress=(unset), NvmInitBlockCallback=NULL_PTR, NvmUseJobendCallback=false, NvmJobendCbkAtReadAll=true, NvmSingleBlockCallback=NULL_PTR
        NvmTargetBlockReference
          NvmFeeRef: NvmNameOfFeeBlock=FeeBlockConfiguration128
      Rte_NvmBlock_Boot_DIDF188: NvmNvramBlockIdentifier=108, NvmBlockUseCrc=false, NvmBlockUsedCrcType=NVM_NOCRC, NvmCalcRamBlockCrc=false, NvmNvBlockLength=11, NvmUseServicePorts=false, NvmResistantToChangedSw=false, NvmSelectBlockForReadall=false, NvmRamBlockDataAddress=(unset), NvmRomBlockDataAddress=(unset), NvmInitBlockCallback=NULL_PTR, NvmUseJobendCallback=false, NvmJobendCbkAtReadAll=true, NvmSingleBlockCallback=NULL_PTR
        NvmTargetBlockReference
          NvmFeeRef: NvmNameOfFeeBlock=FeeBlockConfiguration129
      Rte_NvmBlock_Boot_DIDF191: NvmNvramBlockIdentifier=109, NvmBlockUseCrc=false, NvmBlockUsedCrcType=NVM_NOCRC, NvmCalcRamBlockCrc=false, NvmNvBlockLength=11, NvmUseServicePorts=false, NvmResistantToChangedSw=false, NvmSelectBlockForReadall=false, NvmRamBlockDataAddress=(unset), NvmRomBlockDataAddress=(unset), NvmInitBlockCallback=NULL_PTR, NvmUseJobendCallback=false, NvmJobendCbkAtReadAll=true, NvmSingleBlockCallback=NULL_PTR
        NvmTargetBlockReference
          NvmFeeRef: NvmNameOfFeeBlock=FeeBlockConfiguration130
      Rte_NvmBlock_Boot_DIDF192: NvmNvramBlockIdentifier=110, NvmBlockUseCrc=false, NvmBlockUsedCrcType=NVM_NOCRC, NvmCalcRamBlockCrc=false, NvmNvBlockLength=11, NvmUseServicePorts=false, NvmResistantToChangedSw=false, NvmSelectBlockForReadall=false, NvmRamBlockDataAddress=(unset), NvmRomBlockDataAddress=(unset), NvmInitBlockCallback=NULL_PTR, NvmUseJobendCallback=false, NvmJobendCbkAtReadAll=true, NvmSingleBlockCallback=NULL_PTR
        NvmTargetBlockReference
          NvmFeeRef: NvmNameOfFeeBlock=FeeBlockConfiguration131
    NvmCommon:
      NvmDevErrorDetect = true
      NvmApiConfigClass = NvmApiConfigClass3
      NvmVersionInfoApi = false
      NvmSetRamBlockStatusApi = true
      NvmDrvModeSwitch = true
      NvmPollingMode = true
      NvmDynamicConfiguration = true
      NvmJobPrioritization = false
      NvmCrcNumOfBytes = 65535
      NvmDatasetSelectionBits = 5
      NvmSizeImmediateJobQueue = 1
      NvmSizeStandardJobQueue = 8
      NvmMaxNoOfWriteRetries = 3
      NvmTotalNumOfNvramBlocks = 2
      NvmCompiledConfigId = 1
      NvmMultiBlockCallback = EcuM_CB_NfyNvMJobEnd
    Nvm_30_CommonVendorParams:
      NvmDebugReporting = true
      NvmCfgIncludeDet = Det.h
      NvmErrorhook = Det_ReportError
      NvmCfgChkStatusUninit = true
      NvmCfgChkRamBlockLengths = false
      NvmCfgChkRomBlockLengths = false
      NvmCfgChkBlockLengthStrict = true
      NvmCfgChkMngmtType = true
      NvmCfgChkBlockProtection = true
      NvmCfgChkBlockPending = false
      NvmCfgChkDoParamChk = true
      NvmCfgChkParamBlockid = true
      NvmCfgChkParamDataIndex = true
      NvmCfgChkParamPointer = true
      NvmCfgIncludeDem = Dem.h
      NvmSeterror = Dem_ReportErrorStatus
      NvmCfgCbkIncludeList = EcuM_Cbk.h
      NvmCfgCbkIncludeList = CDD_Data.h
      NvmCfgCbkIncludeList = Ap_StaMd_Cfg.h
      NvmCfgCbkIncludeList = Ap_DiagMgr.h
      NvmCfgCbkIncludeList = Dem.h
      NvmCfgCbkIncludeList = Dem_Lcfg.h
      NvmCfgCbkIncludeList = ApplCallbacks.h
      NvmCfgCbkIncludeList = Ap_DfltConfigData.h
      NvmCfgCbkIncludeList = EPS_DiagSrvcs_SrvcLUTbl.h
      NvmCfgCbkIncludeList = Crc.h
      NvmCfgCbkIncludeList = Cd_NvMProxy.h
      NvmCfgCbkIncludeList = Dem_Cbk.h
      NvmMultiblockId = MultiBlockRequest
      NvmServiceComponentName = NvM
      Nvm_UseLongSwcNames = true
      NvmSrvPortInitBlockPrefix = Nvm_RpNotifyInit_
      NvmSrvPortJobEndPrefix = NvM_RpNotifyJobEnd_
      NvmCrcIntBuffer = true
      NvmCrcPreserveValue = true
      NvmKillWriteAllApi = true
      NvmLockSet = SuspendAllInterrupts
    ConfigBlock (NvmConfigBlockDescriptor):
      NvmNvramBlockIdentifier = 1
      NvmDeviceName = Fee
      NvmBlockManagementType = NVM_BLOCK_REDUNDANT
      NvmBlockUseCrc = true
      NvmBlockCRCType = NVM_CRC16
      NvmCalcRamBlockCrc = true
      NvmBlockJobPriority = 127
      NvmNvBlockLength = 2
      NvmNvBlockNum = 2
      NvmUseServicePorts = true
      NvmWriteBlockOnce = false
      NvmBlockWriteProt = false
      NvmResistantToChangedSw = true
      NvmSelectBlockForReadall = true
      NvmRomBlockDataAddress = NULL_PTR
      NvmUseInitCallback = false
      NvmInitBlockCallback = NULL_PTR
      NvmUseJobendCallback = false
      NvmJobendCbkAtReadAll = false
      NvmSingleBlockCallback = (unset)
      NvmRequirementId = (unset)
      NvmTargetBlockReference
        NvmFeeRef: NvmNameOfFeeBlock=FeeBlockConfiguration42
  module config NvMMgr: implementation-config-variant=VARIANT-POST-BUILD
    NvMMgrGeneral: EcuStartupApp=Ap_9, NvMandMemIfApp=Ap_9
    CommonPublishedInformation: ArMajorVersion=3, ArMinorVersion=2, ArPatchVersion=0, SwMajorVersion=0, SwMinorVersion=0, SwPatchVersion=0, ModuleId=0, VendorId=0
  module config NvMProxy: implementation-config-variant=VARIANT-PRE-COMPILE
    NvMProxyConfigSet
      16 x NvMProxyBlock:
        ShCurrCal: NvmRamBlockDataAddressSecure=Rte_CmMtrCurr_ShCurrCal, InitBlockHandling=CRC16, InitCheckFailResponse=SetNTC_0x07_LoadROMDefaults, ROMDefault_Or_NotificationFunction_Symbol=T_ShCurrCalInit_Cnt_str, NvMRamGlobalShared=false, NvmBlockDescriptorRef=Rte_NvmBlock_CmMtrCurr_ShCurrCal
        TorqueCmdSF: NvmRamBlockDataAddressSecure=Rte_TrqCmdScl_TorqueCmdSF_Uls_f32, InitBlockHandling=Redundant, InitCheckFailResponse=N/A, ROMDefault_Or_NotificationFunction_Symbol=NULL_PTR, NvMRamGlobalShared=false, NvmBlockDescriptorRef=Rte_NvmBlock_TrqCmdScl_TorqueCmdSF_Uls_f32
        Polarity: NvmRamBlockDataAddressSecure=Rte_Polarity_Polarity_Cnt_Str, InitBlockHandling=None, InitCheckFailResponse=N/A, ROMDefault_Or_NotificationFunction_Symbol=NULL_PTR, NvMRamGlobalShared=false, NvmBlockDescriptorRef=Rte_NvmBlock_Polarity_Polarity_Cnt_Str
        CloseCheckData: NvmRamBlockDataAddressSecure=CloseCheck_Cnt_u32, InitBlockHandling=None, InitCheckFailResponse=N/A, ROMDefault_Or_NotificationFunction_Symbol=NULL_PTR, NvMRamGlobalShared=false, NvmBlockDescriptorRef=Rte_NvmBlock_StaMd_CloseCheckData
        TypeHRamBuffer: NvmRamBlockDataAddressSecure=TypeHData_Cnt_u08, InitBlockHandling=None, InitCheckFailResponse=N/A, ROMDefault_Or_NotificationFunction_Symbol=NULL_PTR, NvMRamGlobalShared=true, NvmBlockDescriptorRef=Rte_NvmBlock_StaMd_TypeHRamBuffer
        CogTrqCal: NvmRamBlockDataAddressSecure=Rte_TrqCanc_CogTrqCal, InitBlockHandling=CRC16, InitCheckFailResponse=SetNTC_0x07_LoadROMDefaults, ROMDefault_Or_NotificationFunction_Symbol=T_CogTrqCalInit_Cnt_u16, NvMRamGlobalShared=false, NvmBlockDescriptorRef=Rte_NvmBlock_TrqCanc_CogTrqCal
        EOLNomMtrParam: NvmRamBlockDataAddressSecure=Rte_CurrParamComp_EOLNomMtrParam, InitBlockHandling=None, InitCheckFailResponse=N/A, ROMDefault_Or_NotificationFunction_Symbol=NULL_PTR, NvMRamGlobalShared=false, NvmBlockDescriptorRef=Rte_NvmBlock_CurrParamComp_EOLNomMtrParam
        DigTrqTrim: NvmRamBlockDataAddressSecure=Rte_DigHwTrqSENT_DigTrqTrim, InitBlockHandling=CRC16, InitCheckFailResponse=SetNTC_0x0A, ROMDefault_Or_NotificationFunction_Symbol=NULL_PTR, NvMRamGlobalShared=false, NvmBlockDescriptorRef=Rte_NvmBlock_DigHwTrqSENT_DigTrqTrim
        DigMSBEOLData: NvmRamBlockDataAddressSecure=Rte_DigMSB_DigMSBEOLData, InitBlockHandling=None, InitCheckFailResponse=N/A, ROMDefault_Or_NotificationFunction_Symbol=NULL_PTR, NvMRamGlobalShared=false, NvmBlockDescriptorRef=Rte_NvmBlock_DigMSB_DigMSBEOLData
        EOLVehCntrOffset: NvmRamBlockDataAddressSecure=Rte_AbsHwPos_EOLVehCntrOffset, InitBlockHandling=CRC16, InitCheckFailResponse=SetNTC_0x08_LoadROMDefaults, ROMDefault_Or_NotificationFunction_Symbol=T_EOLVehCntrOffsetInit_Cnt_str, NvMRamGlobalShared=false, NvmBlockDescriptorRef=Rte_NvmBlock_AbsHwPos_EOLVehCntrOffset
        CogTrqRplComp: NvmRamBlockDataAddressSecure=Rte_TrqCanc_CogTrqRplComp, InitBlockHandling=CRC16, InitCheckFailResponse=SetNTC_0x07_LoadROMDefaults, ROMDefault_Or_NotificationFunction_Symbol=T_CogTrqRplCompInit_Cnt_u16, NvMRamGlobalShared=false, NvmBlockDescriptorRef=Rte_NvmBlock_TrqCanc_CogTrqRplComp
        CurrTempOffset: NvmRamBlockDataAddressSecure=Rte_CmMtrCurr_CurrTempOffset, InitBlockHandling=ZeroData, InitCheckFailResponse=N/A, ROMDefault_Or_NotificationFunction_Symbol=NULL_PTR, NvMRamGlobalShared=false, NvmBlockDescriptorRef=Rte_NvmBlock_CmMtrCurr_CurrTempOffset
        SteerAsstDefeat: NvmRamBlockDataAddressSecure=Rte_AstLmt_SteerAsstDefeat, InitBlockHandling=ZeroData, InitCheckFailResponse=N/A, ROMDefault_Or_NotificationFunction_Symbol=NULL_PTR, NvMRamGlobalShared=false, NvmBlockDescriptorRef=Rte_NvmBlock_AstLmt_SteerAsstDefeat
        MotPosReset: NvmRamBlockDataAddressSecure=Rte_VehDyn_MotPosReset, InitBlockHandling=None, InitCheckFailResponse=N/A, ROMDefault_Or_NotificationFunction_Symbol=NULL_PTR, NvMRamGlobalShared=false, NvmBlockDescriptorRef=Rte_NvmBlock_VehDyn_MotPosReset
        DigColPsEOL: NvmRamBlockDataAddressSecure=Rte_Sa_DigColPs_DigColPsEOL, InitBlockHandling=None, InitCheckFailResponse=N/A, ROMDefault_Or_NotificationFunction_Symbol=NULL_PTR, NvMRamGlobalShared=false, NvmBlockDescriptorRef=Rte_NvmBlock_Sa_DigColPs_DigColPsEOL
        BatteryOvervoltageData: NvmRamBlockDataAddressSecure=Rte_BatteryVoltage_OvervoltageData, InitBlockHandling=None, InitCheckFailResponse=N/A, ROMDefault_Or_NotificationFunction_Symbol=NULL_PTR, NvMRamGlobalShared=false, NvmBlockDescriptorRef=Rte_NvmBlock_BatteryVoltage_OvervoltageData
    NvMProxyGeneral: NvMProxyIncludes=Ap_StaMd_Cfg.h, FailureAPI=NxtrDiagMgr10_ReportNTCStatus, NvMProxyDevErrorDetect=false
    CommonPublishedInformation: ArMajorVersion=1, ArMinorVersion=2, ArPatchVersion=0, SwMajorVersion=1, SwMinorVersion=0, SwPatchVersion=0, ModuleId=104, VendorId=0
  module config OvrVoltMon: implementation-config-variant=VARIANT-POST-BUILD
    OvrVoltMonGeneral
    CommonPublishedInformation: ArMajorVersion=3, ArMinorVersion=2, ArPatchVersion=0, SwMajorVersion=0, SwMinorVersion=0, SwPatchVersion=0, ModuleId=0, VendorId=0
  module config PeakCurrEst: implementation-config-variant=VARIANT-POST-BUILD
    PeakCurrEstGeneral
    CommonPublishedInformation: ArMajorVersion=3, ArMinorVersion=2, ArPatchVersion=0, SwMajorVersion=0, SwMinorVersion=0, SwPatchVersion=0, ModuleId=0, VendorId=0
  module config PICurrCntrl: implementation-config-variant=VARIANT-POST-BUILD
    PICurrCntrlGeneral
    CommonPublishedInformation: ArMajorVersion=3, ArMinorVersion=2, ArPatchVersion=0, SwMajorVersion=0, SwMinorVersion=0, SwPatchVersion=0, ModuleId=0, VendorId=0
  module config Polarity: implementation-config-variant=VARIANT-POST-BUILD
    PolarityGeneral
    CommonPublishedInformation: ArMajorVersion=3, ArMinorVersion=2, ArPatchVersion=0, SwMajorVersion=0, SwMinorVersion=0, SwPatchVersion=0, ModuleId=0, VendorId=0
  module config Port: implementation-config-variant=VARIANT-POST-BUILD, module-description=Port_Impl
    Port_Runtime (PortConfigSet)
      20 x PortContainer, all with PortAvailablePackage1=true:
        GIOA: PortNumberOfPortPins=8, PortUse=false, PortName=GIO A, PortRegPostfix=GIOA, PortAvailablePackage0=false, PortAvailablePackage2=true, PortAvailablePackage3=false, PortAvailablePackage4=false, PortRegBaseAddr=4294425648, PortRegStructure=PORT_REG_STRUCT_REGULAR_NO_FUNC, PortContainsPrivReg=false
          8 x PortPin, all with PortPinDirection=PORT_PIN_IN, PortPinDirectionChangeable=false, PortPinInitialMode=PORT_PIN_MODE_DIO, PortPinLevelValue=PORT_PIN_LEVEL_LOW, PortPinMode=PORT_PIN_MODE_DIO, PortPinOpenDrain=PORT_PUSH_PULL, PortPinPullSelect=PORT_PULL_DOWN, PortPinRefresh=false, PortPinAvailablePackage0=false, PortPinAvailablePackage1=true, PortPinAvailablePackage2=true, PortPinAvailablePackage3=false, PortPinAvailablePackage4=false, PortPinSlewRate=PORT_PIN_SLEW_RATE_NA:
            PortPinGioA_{0..4}: PortPinId={0..4}, PortPinChannelName=(unset), PortPinName=GIOA{0..4}
            PortPinGioA_5: PortPinId=5, PortPinChannelName=GA_UPPER, PortPinName=GIOA5
            PortPinGioA_6: PortPinId=6, PortPinChannelName=GA_LOWER, PortPinName=GIOA6
            PortPinGioA_7: PortPinId=7, PortPinChannelName=GB_UPPER, PortPinName=GIOA7
        GIOB: PortNumberOfPortPins=8, PortUse=false, PortName=GIO B, PortRegPostfix=GIOB, PortAvailablePackage0=true, PortAvailablePackage2=true, PortAvailablePackage3=false, PortAvailablePackage4=false, PortRegBaseAddr=4294425680, PortRegStructure=PORT_REG_STRUCT_REGULAR_NO_FUNC, PortContainsPrivReg=false
          8 x PortPin, all with PortPinDirection=PORT_PIN_IN, PortPinDirectionChangeable=false, PortPinInitialMode=PORT_PIN_MODE_DIO, PortPinLevelValue=PORT_PIN_LEVEL_LOW, PortPinMode=PORT_PIN_MODE_DIO, PortPinOpenDrain=PORT_PUSH_PULL, PortPinPullSelect=PORT_PULL_UP, PortPinRefresh=false, PortPinChannelName=(unset), PortPinAvailablePackage0=true, PortPinAvailablePackage1=true, PortPinAvailablePackage2=true, PortPinAvailablePackage3=false, PortPinAvailablePackage4=false, PortPinSlewRate=PORT_PIN_SLEW_RATE_NA:
            PortPinGioB_{0..7}: PortPinId={0..7}, PortPinName=GIOB{0..7}
        CAN1: PortNumberOfPortPins=2, PortUse=false, PortName=CAN 1, PortRegPostfix=CAN1, PortAvailablePackage0=false, PortAvailablePackage2=true, PortAvailablePackage3=false, PortAvailablePackage4=false, PortRegBaseAddr=4294434272, PortRegStructure=PORT_REG_STRUCT_SHORT, PortContainsPrivReg=true
          PortPinCan1_0 (PortPin):
            PortPinDirection = PORT_PIN_IN
            PortPinDirectionChangeable = false
            PortPinId = 0
            PortPinInitialMode = PORT_PIN_MODE_CAN
            PortPinLevelValue = PORT_PIN_LEVEL_LOW
            PortPinMode = PORT_PIN_MODE_DIO
            PortPinOpenDrain = PORT_PUSH_PULL
            PortPinPullSelect = PORT_PULL_UP
            PortPinRefresh = true
            PortPinChannelName = (unset)
            PortPinAvailablePackage0 = false
            PortPinAvailablePackage1 = true
            PortPinAvailablePackage2 = true
            PortPinAvailablePackage3 = false
            PortPinAvailablePackage4 = false
            PortPinSlewRate = PORT_PIN_SLEW_RATE_NA
            PortPinName = CAN1TX
          PortPinCan1_1 (PortPin):
            PortPinDirection = PORT_PIN_IN
            PortPinDirectionChangeable = false
            PortPinId = 1
            PortPinInitialMode = PORT_PIN_MODE_CAN
            PortPinLevelValue = PORT_PIN_LEVEL_LOW
            PortPinMode = PORT_PIN_MODE_DIO
            PortPinOpenDrain = PORT_PUSH_PULL
            PortPinPullSelect = PORT_PULL_UP
            PortPinRefresh = false
            PortPinChannelName = (unset)
            PortPinAvailablePackage0 = false
            PortPinAvailablePackage1 = true
            PortPinAvailablePackage2 = true
            PortPinAvailablePackage3 = false
            PortPinAvailablePackage4 = false
            PortPinSlewRate = PORT_PIN_SLEW_RATE_NA
            PortPinName = CAN1RX
        CAN2: PortNumberOfPortPins=2, PortUse=false, PortName=CAN 2, PortRegPostfix=CAN2, PortAvailablePackage0=false, PortAvailablePackage2=true, PortAvailablePackage3=false, PortAvailablePackage4=false, PortRegBaseAddr=4294434784, PortRegStructure=PORT_REG_STRUCT_SHORT, PortContainsPrivReg=true
          PortPinCan2_0 (PortPin):
            PortPinDirection = PORT_PIN_IN
            PortPinDirectionChangeable = false
            PortPinId = 0
            PortPinInitialMode = PORT_PIN_MODE_CAN
            PortPinLevelValue = PORT_PIN_LEVEL_LOW
            PortPinMode = PORT_PIN_MODE_DIO
            PortPinOpenDrain = PORT_PUSH_PULL
            PortPinPullSelect = PORT_PULL_UP
            PortPinRefresh = false
            PortPinChannelName = (unset)
            PortPinAvailablePackage0 = false
            PortPinAvailablePackage1 = true
            PortPinAvailablePackage2 = true
            PortPinAvailablePackage3 = false
            PortPinAvailablePackage4 = false
            PortPinSlewRate = PORT_PIN_SLEW_RATE_NA
            PortPinName = CAN2TX
          PortPinCan2_1 (PortPin):
            PortPinDirection = PORT_PIN_IN
            PortPinDirectionChangeable = false
            PortPinId = 1
            PortPinInitialMode = PORT_PIN_MODE_CAN
            PortPinLevelValue = PORT_PIN_LEVEL_LOW
            PortPinMode = PORT_PIN_MODE_DIO
            PortPinOpenDrain = PORT_PUSH_PULL
            PortPinPullSelect = PORT_PULL_UP
            PortPinRefresh = false
            PortPinChannelName = (unset)
            PortPinAvailablePackage0 = false
            PortPinAvailablePackage1 = true
            PortPinAvailablePackage2 = true
            PortPinAvailablePackage3 = false
            PortPinAvailablePackage4 = false
            PortPinSlewRate = PORT_PIN_SLEW_RATE_NA
            PortPinName = CAN2RX
        CAN3: PortNumberOfPortPins=2, PortUse=true, PortName=CAN 3, PortRegPostfix=CAN3, PortAvailablePackage0=false, PortAvailablePackage2=true, PortAvailablePackage3=false, PortAvailablePackage4=false, PortRegBaseAddr=4294435296, PortRegStructure=PORT_REG_STRUCT_SHORT, PortContainsPrivReg=true
          PortPinCan3_0 (PortPin):
            PortPinDirection = PORT_PIN_OUT
            PortPinDirectionChangeable = false
            PortPinId = 0
            PortPinInitialMode = PORT_PIN_MODE_DIO
            PortPinLevelValue = PORT_PIN_LEVEL_LOW
            PortPinMode = PORT_PIN_MODE_DIO
            PortPinOpenDrain = PORT_PUSH_PULL
            PortPinPullSelect = PORT_PULL_UP
            PortPinRefresh = false
            PortPinChannelName = WdReset
            PortPinAvailablePackage0 = false
            PortPinAvailablePackage1 = true
            PortPinAvailablePackage2 = true
            PortPinAvailablePackage3 = false
            PortPinAvailablePackage4 = false
            PortPinSlewRate = PORT_PIN_SLEW_RATE_NA
            PortPinName = CAN3TX
          PortPinCan3_1 (PortPin):
            PortPinDirection = PORT_PIN_OUT
            PortPinDirectionChangeable = false
            PortPinId = 1
            PortPinInitialMode = PORT_PIN_MODE_DIO
            PortPinLevelValue = PORT_PIN_LEVEL_LOW
            PortPinMode = PORT_PIN_MODE_DIO
            PortPinOpenDrain = PORT_PUSH_PULL
            PortPinPullSelect = PORT_PULL_UP
            PortPinRefresh = false
            PortPinChannelName = WdMonitor
            PortPinAvailablePackage0 = false
            PortPinAvailablePackage1 = true
            PortPinAvailablePackage2 = true
            PortPinAvailablePackage3 = false
            PortPinAvailablePackage4 = false
            PortPinSlewRate = PORT_PIN_SLEW_RATE_NA
            PortPinName = CAN3RX
        LIN: PortNumberOfPortPins=2, PortUse=false, PortName=LIN, PortRegPostfix=LIN, PortAvailablePackage0=false, PortAvailablePackage2=true, PortAvailablePackage3=false, PortAvailablePackage4=false, PortRegBaseAddr=4294435900, PortRegStructure=PORT_REG_STRUCT_REGULAR_SLEW_1, PortContainsPrivReg=false
          PortPinLin1_0 (PortPin):
            PortPinDirection = PORT_PIN_IN
            PortPinDirectionChangeable = false
            PortPinId = 1
            PortPinInitialMode = PORT_PIN_MODE_DIO
            PortPinLevelValue = PORT_PIN_LEVEL_LOW
            PortPinMode = PORT_PIN_MODE_DIO
            PortPinOpenDrain = PORT_PUSH_PULL
            PortPinPullSelect = PORT_PULL_UP
            PortPinRefresh = false
            PortPinChannelName = (unset)
            PortPinAvailablePackage0 = false
            PortPinAvailablePackage1 = true
            PortPinAvailablePackage2 = true
            PortPinAvailablePackage3 = false
            PortPinAvailablePackage4 = false
            PortPinSlewRate = PORT_PIN_SLEW_RATE_NA
            PortPinName = LINRX
          PortPinLin1_1 (PortPin):
            PortPinDirection = PORT_PIN_IN
            PortPinDirectionChangeable = false
            PortPinId = 2
            PortPinInitialMode = PORT_PIN_MODE_DIO
            PortPinLevelValue = PORT_PIN_LEVEL_LOW
            PortPinMode = PORT_PIN_MODE_DIO
            PortPinOpenDrain = PORT_PUSH_PULL
            PortPinPullSelect = PORT_PULL_UP
            PortPinRefresh = false
            PortPinChannelName = (unset)
            PortPinAvailablePackage0 = false
            PortPinAvailablePackage1 = true
            PortPinAvailablePackage2 = true
            PortPinAvailablePackage3 = false
            PortPinAvailablePackage4 = false
            PortPinSlewRate = PORT_PIN_SLEW_RATE_NA
            PortPinName = LINTX
        SCI: PortNumberOfPortPins=2, PortUse=false, PortName=SCI, PortRegPostfix=SCI, PortAvailablePackage0=false, PortAvailablePackage2=true, PortAvailablePackage3=false, PortAvailablePackage4=false, PortRegBaseAddr=4294436156, PortRegStructure=PORT_REG_STRUCT_REGULAR_SLEW_1, PortContainsPrivReg=false
          PortPinSci1_0 (PortPin):
            PortPinDirection = PORT_PIN_IN
            PortPinDirectionChangeable = false
            PortPinId = 1
            PortPinInitialMode = PORT_PIN_MODE_DIO
            PortPinLevelValue = PORT_PIN_LEVEL_LOW
            PortPinMode = PORT_PIN_MODE_DIO
            PortPinOpenDrain = PORT_PUSH_PULL
            PortPinPullSelect = PORT_PULL_UP
            PortPinRefresh = false
            PortPinChannelName = (unset)
            PortPinAvailablePackage0 = false
            PortPinAvailablePackage1 = true
            PortPinAvailablePackage2 = true
            PortPinAvailablePackage3 = false
            PortPinAvailablePackage4 = false
            PortPinSlewRate = PORT_PIN_SLEW_RATE_NA
            PortPinName = SCIRX
          PortPinSci1_1 (PortPin):
            PortPinDirection = PORT_PIN_IN
            PortPinDirectionChangeable = false
            PortPinId = 2
            PortPinInitialMode = PORT_PIN_MODE_DIO
            PortPinLevelValue = PORT_PIN_LEVEL_LOW
            PortPinMode = PORT_PIN_MODE_DIO
            PortPinOpenDrain = PORT_PUSH_PULL
            PortPinPullSelect = PORT_PULL_UP
            PortPinRefresh = false
            PortPinChannelName = (unset)
            PortPinAvailablePackage0 = false
            PortPinAvailablePackage1 = true
            PortPinAvailablePackage2 = true
            PortPinAvailablePackage3 = false
            PortPinAvailablePackage4 = false
            PortPinSlewRate = PORT_PIN_SLEW_RATE_NA
            PortPinName = SCITX
        I2C: PortNumberOfPortPins=2, PortUse=false, PortName=I2C, PortRegPostfix=IIC, PortAvailablePackage0=false, PortAvailablePackage2=true, PortAvailablePackage3=false, PortAvailablePackage4=false, PortRegBaseAddr=4294431816, PortRegStructure=PORT_REG_STRUCT_REGULAR_SLEW_1, PortContainsPrivReg=false
          PortPinIic_0 (PortPin):
            PortPinDirection = PORT_PIN_OUT
            PortPinDirectionChangeable = false
            PortPinId = 0
            PortPinInitialMode = PORT_PIN_MODE_DIO
            PortPinLevelValue = PORT_PIN_LEVEL_LOW
            PortPinMode = PORT_PIN_MODE_DIO
            PortPinOpenDrain = PORT_OPEN_DRAIN
            PortPinPullSelect = PORT_PULL_UP
            PortPinRefresh = false
            PortPinChannelName = (unset)
            PortPinAvailablePackage0 = false
            PortPinAvailablePackage1 = true
            PortPinAvailablePackage2 = true
            PortPinAvailablePackage3 = false
            PortPinAvailablePackage4 = false
            PortPinSlewRate = PORT_PIN_SLEW_RATE_NA
            PortPinName = I2C_SCL
          PortPinIic_1 (PortPin):
            PortPinDirection = PORT_PIN_OUT
            PortPinDirectionChangeable = false
            PortPinId = 1
            PortPinInitialMode = PORT_PIN_MODE_DIO
            PortPinLevelValue = PORT_PIN_LEVEL_LOW
            PortPinMode = PORT_PIN_MODE_DIO
            PortPinOpenDrain = PORT_OPEN_DRAIN
            PortPinPullSelect = PORT_PULL_UP
            PortPinRefresh = false
            PortPinChannelName = (unset)
            PortPinAvailablePackage0 = false
            PortPinAvailablePackage1 = true
            PortPinAvailablePackage2 = true
            PortPinAvailablePackage3 = false
            PortPinAvailablePackage4 = false
            PortPinSlewRate = PORT_PIN_SLEW_RATE_NA
            PortPinName = I2C_SDA
        SPI1: PortNumberOfPortPins=16, PortUse=false, PortName=MBSPI 1, PortRegPostfix=SPI1, PortAvailablePackage0=true, PortAvailablePackage2=true, PortAvailablePackage3=true, PortAvailablePackage4=true, PortRegBaseAddr=4294439956, PortRegStructure=PORT_REG_STRUCT_REGULAR_SLEW_2, PortContainsPrivReg=false
          12 x PortPin, all with PortPinDirection=PORT_PIN_IN, PortPinDirectionChangeable=false, PortPinInitialMode=PORT_PIN_MODE_SPI, PortPinLevelValue=PORT_PIN_LEVEL_LOW, PortPinMode=PORT_PIN_MODE_DIO, PortPinOpenDrain=PORT_PUSH_PULL, PortPinPullSelect=PORT_PULL_UP, PortPinRefresh=false, PortPinChannelName=(unset), PortPinAvailablePackage0=true, PortPinAvailablePackage1=true, PortPinAvailablePackage2=true, PortPinAvailablePackage3=true, PortPinSlewRate=PORT_PIN_SLEW_RATE_NA:
            PortPinSpi1_0: PortPinId=9, PortPinAvailablePackage4=true, PortPinName=SPI1CLK
            PortPinSpi1_1: PortPinId=0, PortPinAvailablePackage4=true, PortPinName=SPI1NCS0
            PortPinSpi1_2: PortPinId=1, PortPinAvailablePackage4=true, PortPinName=SPI1NCS1
            PortPinSpi1_3: PortPinId=2, PortPinAvailablePackage4=false, PortPinName=SPI1NCS2
            PortPinSpi1_4: PortPinId=3, PortPinAvailablePackage4=false, PortPinName=SPI1NCS3
            PortPinSpi1_5: PortPinId=4, PortPinAvailablePackage4=false, PortPinName=SPI1NCS4
            PortPinSpi1_6: PortPinId=5, PortPinAvailablePackage4=false, PortPinName=SPI1NCS5
            PortPinSpi1_7: PortPinId=8, PortPinAvailablePackage4=true, PortPinName=SPI1NENA
            PortPinSpi1_8: PortPinId=10, PortPinAvailablePackage4=true, PortPinName=SPI1SIMO0
            PortPinSpi1_9: PortPinId=17, PortPinAvailablePackage4=true, PortPinName=SPI1SIMO1
            PortPinSpi1_10: PortPinId=11, PortPinAvailablePackage4=true, PortPinName=SPI1SOMI0
            PortPinSpi1_11: PortPinId=25, PortPinAvailablePackage4=true, PortPinName=SPI1SOMI1
        SPI2: PortNumberOfPortPins=8, PortUse=false, PortName=SPI 2, PortRegPostfix=SPI2, PortAvailablePackage0=false, PortAvailablePackage2=true, PortAvailablePackage3=false, PortAvailablePackage4=false, PortRegBaseAddr=4294440468, PortRegStructure=PORT_REG_STRUCT_REGULAR_SLEW_2, PortContainsPrivReg=false
          6 x PortPin, all with PortPinDirection=PORT_PIN_IN, PortPinDirectionChangeable=false, PortPinInitialMode=PORT_PIN_MODE_DIO, PortPinLevelValue=PORT_PIN_LEVEL_LOW, PortPinMode=PORT_PIN_MODE_DIO, PortPinOpenDrain=PORT_PUSH_PULL, PortPinPullSelect=PORT_PULL_UP, PortPinRefresh=false, PortPinChannelName=(unset), PortPinAvailablePackage0=false, PortPinAvailablePackage1=true, PortPinAvailablePackage2=true, PortPinAvailablePackage3=false, PortPinAvailablePackage4=false, PortPinSlewRate=PORT_PIN_SLEW_RATE_NA:
            PortPinSpi2_0: PortPinId=9, PortPinName=SPI2CLK
            PortPinSpi2_1: PortPinId=0, PortPinName=SPI2NCS0
            PortPinSpi2_2: PortPinId=1, PortPinName=SPI2NCS1
            PortPinSpi2_5: PortPinId=8, PortPinName=SPI2NENA
            PortPinSpi2_6: PortPinId=10, PortPinName=SPI2SIMO
            PortPinSpi2_7: PortPinId=11, PortPinName=SPI2SOMI
        SPI3: PortNumberOfPortPins=16, PortUse=true, PortName=MBSPI 3, PortRegPostfix=SPI3, PortAvailablePackage0=true, PortAvailablePackage2=true, PortAvailablePackage3=true, PortAvailablePackage4=true, PortRegBaseAddr=4294440980, PortRegStructure=PORT_REG_STRUCT_REGULAR_SLEW_2, PortContainsPrivReg=false
          10 x PortPin, all with PortPinDirectionChangeable=false, PortPinLevelValue=PORT_PIN_LEVEL_LOW, PortPinMode=PORT_PIN_MODE_DIO, PortPinOpenDrain=PORT_PUSH_PULL, PortPinPullSelect=PORT_PULL_UP, PortPinRefresh=false, PortPinAvailablePackage0=true, PortPinAvailablePackage1=true, PortPinAvailablePackage2=true, PortPinAvailablePackage3=true, PortPinSlewRate=PORT_PIN_SLEW_RATE_NA:
            PortPinSpi3_0: PortPinDirection=PORT_PIN_OUT, PortPinId=9, PortPinInitialMode=PORT_PIN_MODE_SPI, PortPinChannelName=MS_SCLK1, PortPinAvailablePackage4=true, PortPinName=SPI3CLK
            PortPinSpi3_1: PortPinDirection=PORT_PIN_OUT, PortPinId=0, PortPinInitialMode=PORT_PIN_MODE_SPI, PortPinChannelName=MS_CSN1, PortPinAvailablePackage4=true, PortPinName=SPI3NCS0
            PortPinSpi3_2: PortPinDirection=PORT_PIN_OUT, PortPinId=1, PortPinInitialMode=PORT_PIN_MODE_DIO, PortPinChannelName=FetDrvReset, PortPinAvailablePackage4=true, PortPinName=SPI3NCS1
            PortPinSpi3_3: PortPinDirection=PORT_PIN_IN, PortPinId=2, PortPinInitialMode=PORT_PIN_MODE_SPI, PortPinChannelName=(unset), PortPinAvailablePackage4=false, PortPinName=SPI3NCS2
            PortPinSpi3_4: PortPinDirection=PORT_PIN_IN, PortPinId=3, PortPinInitialMode=PORT_PIN_MODE_SPI, PortPinChannelName=(unset), PortPinAvailablePackage4=false, PortPinName=SPI3NCS3
            PortPinSpi3_7: PortPinDirection=PORT_PIN_IN, PortPinId=8, PortPinInitialMode=PORT_PIN_MODE_SPI, PortPinChannelName=(unset), PortPinAvailablePackage4=true, PortPinName=SPI3NENA
            PortPinSpi3_8: PortPinDirection=PORT_PIN_OUT, PortPinId=10, PortPinInitialMode=PORT_PIN_MODE_SPI, PortPinChannelName=MS_MOSI1, PortPinAvailablePackage4=true, PortPinName=SPI3SIMO
            PortPinSpi3_10: PortPinDirection=PORT_PIN_IN, PortPinId=11, PortPinInitialMode=PORT_PIN_MODE_SPI, PortPinChannelName=MS_MISO1, PortPinAvailablePackage4=true, PortPinName=SPI3SOMI
            PortPinSpi3_5: PortPinDirection=PORT_PIN_IN, PortPinId=4, PortPinInitialMode=PORT_PIN_MODE_SPI, PortPinChannelName=(unset), PortPinAvailablePackage4=true, PortPinName=SPI3NCS4
            PortPinSpi3_6: PortPinDirection=PORT_PIN_IN, PortPinId=5, PortPinInitialMode=PORT_PIN_MODE_SPI, PortPinChannelName=(unset), PortPinAvailablePackage4=true, PortPinName=SPI3NCS5
        SPI4: PortNumberOfPortPins=8, PortUse=false, PortName=SPI 4, PortRegPostfix=SPI4, PortAvailablePackage0=false, PortAvailablePackage2=true, PortAvailablePackage3=false, PortAvailablePackage4=false, PortRegBaseAddr=4294441492, PortRegStructure=PORT_REG_STRUCT_REGULAR_SLEW_2, PortContainsPrivReg=false
          5 x PortPin, all with PortPinDirection=PORT_PIN_IN, PortPinDirectionChangeable=false, PortPinInitialMode=PORT_PIN_MODE_DIO, PortPinLevelValue=PORT_PIN_LEVEL_LOW, PortPinMode=PORT_PIN_MODE_DIO, PortPinOpenDrain=PORT_PUSH_PULL, PortPinPullSelect=PORT_PULL_UP, PortPinRefresh=false, PortPinChannelName=(unset), PortPinAvailablePackage0=false, PortPinAvailablePackage1=true, PortPinAvailablePackage2=true, PortPinAvailablePackage3=false, PortPinAvailablePackage4=false, PortPinSlewRate=PORT_PIN_SLEW_RATE_NA:
            PortPinSpi4_0: PortPinId=9, PortPinName=SPI4CLK
            PortPinSpi4_1: PortPinId=0, PortPinName=SPI4NCS0
            PortPinSpi4_5: PortPinId=8, PortPinName=SPI4NENA
            PortPinSpi4_6: PortPinId=10, PortPinName=SPI4SIMO
            PortPinSpi4_7: PortPinId=11, PortPinName=SPI4SOMI
        SPI5: PortNumberOfPortPins=16, PortUse=true, PortName=MBSPI 5, PortRegPostfix=SPI5, PortAvailablePackage0=true, PortAvailablePackage2=true, PortAvailablePackage3=true, PortAvailablePackage4=true, PortRegBaseAddr=4294442004, PortRegStructure=PORT_REG_STRUCT_REGULAR_SLEW_2, PortContainsPrivReg=false
          14 x PortPin, all with PortPinDirectionChangeable=false, PortPinInitialMode=PORT_PIN_MODE_SPI, PortPinLevelValue=PORT_PIN_LEVEL_LOW, PortPinMode=PORT_PIN_MODE_DIO, PortPinOpenDrain=PORT_PUSH_PULL, PortPinRefresh=false, PortPinAvailablePackage0=true, PortPinAvailablePackage1=true, PortPinAvailablePackage2=true, PortPinAvailablePackage3=true, PortPinSlewRate=PORT_PIN_SLEW_RATE_NA:
            PortPinSpi5_0: PortPinDirection=PORT_PIN_OUT, PortPinId=9, PortPinPullSelect=PORT_PULL_UP, PortPinChannelName=MS_SCLK2, PortPinAvailablePackage4=true, PortPinName=SPI5CLK
            PortPinSpi5_1: PortPinDirection=PORT_PIN_OUT, PortPinId=0, PortPinPullSelect=PORT_PULL_UP, PortPinChannelName=MS_CSN2, PortPinAvailablePackage4=true, PortPinName=SPI5NCS0
            PortPinSpi5_2: PortPinDirection=PORT_PIN_IN, PortPinId=1, PortPinPullSelect=PORT_PULL_UP, PortPinChannelName=(unset), PortPinAvailablePackage4=true, PortPinName=SPI5NCS1
            PortPinSpi5_3: PortPinDirection=PORT_PIN_IN, PortPinId=2, PortPinPullSelect=PORT_PULL_UP, PortPinChannelName=(unset), PortPinAvailablePackage4=false, PortPinName=SPI5NCS2
            PortPinSpi5_4: PortPinDirection=PORT_PIN_IN, PortPinId=3, PortPinPullSelect=PORT_PULL_UP, PortPinChannelName=(unset), PortPinAvailablePackage4=false, PortPinName=SPI5NCS3
            PortPinSpi5_5: PortPinDirection=PORT_PIN_IN, PortPinId=8, PortPinPullSelect=PORT_PULL_DOWN, PortPinChannelName=(unset), PortPinAvailablePackage4=true, PortPinName=SPI5NENA
            PortPinSpi5_6: PortPinDirection=PORT_PIN_OUT, PortPinId=10, PortPinPullSelect=PORT_PULL_UP, PortPinChannelName=MS_MOSI2, PortPinAvailablePackage4=true, PortPinName=SPI5SIMO0
            PortPinSpi5_7: PortPinDirection=PORT_PIN_IN, PortPinId=17, PortPinPullSelect=PORT_PULL_UP, PortPinChannelName=(unset), PortPinAvailablePackage4=true, PortPinName=SPI5SIMO1
            PortPinSpi5_8: PortPinDirection=PORT_PIN_IN, PortPinId=18, PortPinPullSelect=PORT_PULL_UP, PortPinChannelName=(unset), PortPinAvailablePackage4=true, PortPinName=SPI5SIMO2
            PortPinSpi5_9: PortPinDirection=PORT_PIN_IN, PortPinId=19, PortPinPullSelect=PORT_PULL_UP, PortPinChannelName=(unset), PortPinAvailablePackage4=true, PortPinName=SPI5SIMO3
            PortPinSpi5_10: PortPinDirection=PORT_PIN_IN, PortPinId=11, PortPinPullSelect=PORT_PULL_UP, PortPinChannelName=MS_MISO2, PortPinAvailablePackage4=true, PortPinName=SPI5SOMI0
            PortPinSpi5_11: PortPinDirection=PORT_PIN_IN, PortPinId=25, PortPinPullSelect=PORT_PULL_UP, PortPinChannelName=(unset), PortPinAvailablePackage4=true, PortPinName=SPI5SOMI1
            PortPinSpi5_12: PortPinDirection=PORT_PIN_IN, PortPinId=26, PortPinPullSelect=PORT_PULL_UP, PortPinChannelName=(unset), PortPinAvailablePackage4=true, PortPinName=SPI5SOMI2
            PortPinSpi5_13: PortPinDirection=PORT_PIN_IN, PortPinId=27, PortPinPullSelect=PORT_PULL_UP, PortPinChannelName=(unset), PortPinAvailablePackage4=true, PortPinName=SPI5SOMI3
        NHET1: PortNumberOfPortPins=32, PortUse=true, PortName=NHET1, PortRegPostfix=NHET1, PortAvailablePackage0=false, PortAvailablePackage2=true, PortAvailablePackage3=false, PortAvailablePackage4=false, PortRegBaseAddr=4294424648, PortRegStructure=PORT_REG_STRUCT_REGULAR_NO_FUNC, PortContainsPrivReg=false
          32 x PortPin, all with PortPinDirectionChangeable=false, PortPinInitialMode=PORT_PIN_MODE_DIO, PortPinMode=PORT_PIN_MODE_DIO, PortPinPullSelect=PORT_PULL_DOWN, PortPinRefresh=false, PortPinAvailablePackage0=false, PortPinAvailablePackage1=true, PortPinAvailablePackage2=true, PortPinAvailablePackage3=false, PortPinAvailablePackage4=false, PortPinSlewRate=PORT_PIN_SLEW_RATE_NA:
            PortPinNHet1_0: PortPinDirection=PORT_PIN_IN, PortPinId=0, PortPinLevelValue=PORT_PIN_LEVEL_LOW, PortPinOpenDrain=PORT_PUSH_PULL, PortPinChannelName=GB_LOWER, PortPinName=NHET1_0
            PortPinNHet1_1: PortPinDirection=PORT_PIN_IN, PortPinId=1, PortPinLevelValue=PORT_PIN_LEVEL_LOW, PortPinOpenDrain=PORT_PUSH_PULL, PortPinChannelName=(unset), PortPinName=NHET1_1
            PortPinNHet1_2: PortPinDirection=PORT_PIN_IN, PortPinId=2, PortPinLevelValue=PORT_PIN_LEVEL_LOW, PortPinOpenDrain=PORT_PUSH_PULL, PortPinChannelName=GC_UPPER, PortPinName=NHET1_2
            PortPinNHet1_3: PortPinDirection=PORT_PIN_IN, PortPinId=3, PortPinLevelValue=PORT_PIN_LEVEL_LOW, PortPinOpenDrain=PORT_PUSH_PULL, PortPinChannelName=(unset), PortPinName=NHET1_3
            PortPinNHet1_4: PortPinDirection=PORT_PIN_IN, PortPinId=4, PortPinLevelValue=PORT_PIN_LEVEL_LOW, PortPinOpenDrain=PORT_PUSH_PULL, PortPinChannelName=FetDrvCntl, PortPinName=NHET1_4
            PortPinNHet1_5: PortPinDirection=PORT_PIN_IN, PortPinId=5, PortPinLevelValue=PORT_PIN_LEVEL_LOW, PortPinOpenDrain=PORT_PUSH_PULL, PortPinChannelName=GC_LOWER, PortPinName=NHET1_5
            PortPinNHet1_6: PortPinDirection=PORT_PIN_IN, PortPinId=6, PortPinLevelValue=PORT_PIN_LEVEL_LOW, PortPinOpenDrain=PORT_PUSH_PULL, PortPinChannelName=(unset), PortPinName=NHET1_6
            PortPinNHet1_7: PortPinDirection=PORT_PIN_IN, PortPinId=7, PortPinLevelValue=PORT_PIN_LEVEL_LOW, PortPinOpenDrain=PORT_PUSH_PULL, PortPinChannelName=(unset), PortPinName=NHET1_7
            PortPinNHet1_8: PortPinDirection=PORT_PIN_IN, PortPinId=8, PortPinLevelValue=PORT_PIN_LEVEL_LOW, PortPinOpenDrain=PORT_PUSH_PULL, PortPinChannelName=PwrSwitchEn, PortPinName=NHET1_8
            PortPinNHet1_9: PortPinDirection=PORT_PIN_IN, PortPinId=9, PortPinLevelValue=PORT_PIN_LEVEL_LOW, PortPinOpenDrain=PORT_PUSH_PULL, PortPinChannelName=(unset), PortPinName=NHET1_9
            PortPinNHet1_10: PortPinDirection=PORT_PIN_IN, PortPinId=10, PortPinLevelValue=PORT_PIN_LEVEL_LOW, PortPinOpenDrain=PORT_PUSH_PULL, PortPinChannelName=T1_SENT, PortPinName=NHET1_10
            PortPinNHet1_11: PortPinDirection=PORT_PIN_IN, PortPinId=11, PortPinLevelValue=PORT_PIN_LEVEL_LOW, PortPinOpenDrain=PORT_PUSH_PULL, PortPinChannelName=(unset), PortPinName=NHET1_11
            PortPinNHet1_12: PortPinDirection=PORT_PIN_OUT, PortPinId=12, PortPinLevelValue=PORT_PIN_LEVEL_LOW, PortPinOpenDrain=PORT_OPEN_DRAIN, PortPinChannelName=T1_SENT_Sync, PortPinName=NHET1_12
            PortPinNHet1_13: PortPinDirection=PORT_PIN_IN, PortPinId=13, PortPinLevelValue=PORT_PIN_LEVEL_LOW, PortPinOpenDrain=PORT_PUSH_PULL, PortPinChannelName=(unset), PortPinName=NHET1_13
            PortPinNHet1_14: PortPinDirection=PORT_PIN_OUT, PortPinId=14, PortPinLevelValue=PORT_PIN_LEVEL_LOW, PortPinOpenDrain=PORT_PUSH_PULL, PortPinChannelName=SPI_50us_Trigger, PortPinName=NHET1_14
            PortPinNHet1_15: PortPinDirection=PORT_PIN_OUT, PortPinId=15, PortPinLevelValue=PORT_PIN_LEVEL_LOW, PortPinOpenDrain=PORT_PUSH_PULL, PortPinChannelName=SysFault2, PortPinName=NHET1_15
            PortPinNHet1_16: PortPinDirection=PORT_PIN_OUT, PortPinId=16, PortPinLevelValue=PORT_PIN_LEVEL_LOW, PortPinOpenDrain=PORT_PUSH_PULL, PortPinChannelName=ePWM_Sync, PortPinName=NHET1_16
            PortPinNHet1_17: PortPinDirection=PORT_PIN_IN, PortPinId=17, PortPinLevelValue=PORT_PIN_LEVEL_LOW, PortPinOpenDrain=PORT_PUSH_PULL, PortPinChannelName=(unset), PortPinName=NHET1_17
            PortPinNHet1_18: PortPinDirection=PORT_PIN_OUT, PortPinId=18, PortPinLevelValue=PORT_PIN_LEVEL_LOW, PortPinOpenDrain=PORT_PUSH_PULL, PortPinChannelName=SPI_2m_Trigger, PortPinName=NHET1_18
            PortPinNHet1_19: PortPinDirection=PORT_PIN_IN, PortPinId=19, PortPinLevelValue=PORT_PIN_LEVEL_LOW, PortPinOpenDrain=PORT_PUSH_PULL, PortPinChannelName=(unset), PortPinName=NHET1_19
            PortPinNHet1_20: PortPinDirection=PORT_PIN_OUT, PortPinId=20, PortPinLevelValue=PORT_PIN_LEVEL_HIGH, PortPinOpenDrain=PORT_PUSH_PULL, PortPinChannelName=TODReset, PortPinName=NHET1_20
            PortPinNHet1_21: PortPinDirection=PORT_PIN_IN, PortPinId=21, PortPinLevelValue=PORT_PIN_LEVEL_LOW, PortPinOpenDrain=PORT_PUSH_PULL, PortPinChannelName=(unset), PortPinName=NHET1_21
            PortPinNHet1_22: PortPinDirection=PORT_PIN_IN, PortPinId=22, PortPinLevelValue=PORT_PIN_LEVEL_LOW, PortPinOpenDrain=PORT_PUSH_PULL, PortPinChannelName=OvrVoltFdbk, PortPinName=NHET1_22
            PortPinNHet1_23: PortPinDirection=PORT_PIN_IN, PortPinId=23, PortPinLevelValue=PORT_PIN_LEVEL_LOW, PortPinOpenDrain=PORT_PUSH_PULL, PortPinChannelName=(unset), PortPinName=NHET1_23
            PortPinNHet1_24: PortPinDirection=PORT_PIN_IN, PortPinId=24, PortPinLevelValue=PORT_PIN_LEVEL_LOW, PortPinOpenDrain=PORT_PUSH_PULL, PortPinChannelName=FetFlt1Data, PortPinName=NHET1_24
            PortPinNHet1_25: PortPinDirection=PORT_PIN_IN, PortPinId=25, PortPinLevelValue=PORT_PIN_LEVEL_LOW, PortPinOpenDrain=PORT_PUSH_PULL, PortPinChannelName=(unset), PortPinName=NHET1_25
            PortPinNHet1_26: PortPinDirection=PORT_PIN_IN, PortPinId=26, PortPinLevelValue=PORT_PIN_LEVEL_LOW, PortPinOpenDrain=PORT_PUSH_PULL, PortPinChannelName=FetFlt2Clk, PortPinName=NHET1_26
            PortPinNHet1_27: PortPinDirection=PORT_PIN_IN, PortPinId=27, PortPinLevelValue=PORT_PIN_LEVEL_LOW, PortPinOpenDrain=PORT_PUSH_PULL, PortPinChannelName=(unset), PortPinName=NHET1_27
            PortPinNHet1_28: PortPinDirection=PORT_PIN_IN, PortPinId=28, PortPinLevelValue=PORT_PIN_LEVEL_LOW, PortPinOpenDrain=PORT_PUSH_PULL, PortPinChannelName=T2_SENT, PortPinName=NHET1_28
            PortPinNHet1_29: PortPinDirection=PORT_PIN_IN, PortPinId=29, PortPinLevelValue=PORT_PIN_LEVEL_LOW, PortPinOpenDrain=PORT_PUSH_PULL, PortPinChannelName=(unset), PortPinName=NHET1_29
            PortPinNHet1_30: PortPinDirection=PORT_PIN_OUT, PortPinId=30, PortPinLevelValue=PORT_PIN_LEVEL_LOW, PortPinOpenDrain=PORT_OPEN_DRAIN, PortPinChannelName=T2_SENT_Sync, PortPinName=NHET1_30
            PortPinNHet1_31: PortPinDirection=PORT_PIN_IN, PortPinId=31, PortPinLevelValue=PORT_PIN_LEVEL_LOW, PortPinOpenDrain=PORT_PUSH_PULL, PortPinChannelName=(unset), PortPinName=NHET1_31
        NHET2: PortNumberOfPortPins=32, PortUse=true, PortName=NHET2, PortRegPostfix=NHET2, PortAvailablePackage0=false, PortAvailablePackage2=true, PortAvailablePackage3=false, PortAvailablePackage4=false, PortRegBaseAddr=4294424904, PortRegStructure=PORT_REG_STRUCT_REGULAR_NO_FUNC, PortContainsPrivReg=false
          18 x PortPin, all with PortPinDirection=PORT_PIN_IN, PortPinDirectionChangeable=false, PortPinInitialMode=PORT_PIN_MODE_DIO, PortPinLevelValue=PORT_PIN_LEVEL_LOW, PortPinMode=PORT_PIN_MODE_DIO, PortPinOpenDrain=PORT_PUSH_PULL, PortPinRefresh=false, PortPinAvailablePackage0=false, PortPinAvailablePackage1=true, PortPinAvailablePackage2=true, PortPinAvailablePackage3=false, PortPinAvailablePackage4=false, PortPinSlewRate=PORT_PIN_SLEW_RATE_NA:
            PortPinNHet2_{0..7}: PortPinId={0..7}, PortPinPullSelect=PORT_PULL_DOWN, PortPinChannelName=(unset), PortPinName=NHET2_{0..7}
            PortPinNHet2_8: PortPinId=8, PortPinPullSelect=PORT_PULL_DOWN, PortPinChannelName=PhaseC, PortPinName=NHET2_8
            PortPinNHet2_9: PortPinId=9, PortPinPullSelect=PORT_PULL_DOWN, PortPinChannelName=(unset), PortPinName=NHET2_9
            PortPinNHet2_10: PortPinId=10, PortPinPullSelect=PORT_PULL_DOWN, PortPinChannelName=PhaseA, PortPinName=NHET2_10
            PortPinNHet2_{11..15}: PortPinId={11..15}, PortPinPullSelect=PORT_PULL_DOWN, PortPinChannelName=(unset), PortPinName=NHET2_{11..15}
            PortPinNHet2_16: PortPinId=16, PortPinPullSelect=PORT_PULL_UP, PortPinChannelName=(unset), PortPinName=NHET2_16
            PortPinNHet2_18: PortPinId=18, PortPinPullSelect=PORT_PULL_DOWN, PortPinChannelName=PhaseB, PortPinName=NHET2_18
        SYS: PortNumberOfPortPins=1, PortUse=false, PortName=ECLK, PortRegPostfix=SYS, PortAvailablePackage0=false, PortAvailablePackage2=true, PortAvailablePackage3=false, PortAvailablePackage4=false, PortRegBaseAddr=4294967040, PortRegStructure=PORT_REG_STRUCT_REGULAR_SLEW_1, PortContainsPrivReg=false
          PortPinEcp_0 (PortPin):
            PortPinDirection = PORT_PIN_IN
            PortPinDirectionChangeable = false
            PortPinId = 0
            PortPinInitialMode = PORT_PIN_MODE_DIO
            PortPinLevelValue = PORT_PIN_LEVEL_LOW
            PortPinMode = PORT_PIN_MODE_DIO
            PortPinOpenDrain = PORT_PUSH_PULL
            PortPinPullSelect = PORT_PULL_DOWN
            PortPinRefresh = false
            PortPinChannelName = (unset)
            PortPinAvailablePackage0 = false
            PortPinAvailablePackage1 = true
            PortPinAvailablePackage2 = true
            PortPinAvailablePackage3 = false
            PortPinAvailablePackage4 = false
            PortPinSlewRate = PORT_PIN_SLEW_RATE_SLOW
            PortPinName = ECLK
        ADC1: PortNumberOfPortPins=1, PortUse=true, PortName=MibADC 1, PortRegPostfix=ADC1, PortAvailablePackage0=false, PortAvailablePackage2=true, PortAvailablePackage3=false, PortAvailablePackage4=false, PortRegBaseAddr=4294426872, PortRegStructure=PORT_REG_STRUCT_REGULAR_PERMUTED, PortContainsPrivReg=false
          PortPinADC1_0 (PortPin):
            PortPinDirection = PORT_PIN_IN
            PortPinDirectionChangeable = false
            PortPinId = 0
            PortPinInitialMode = PORT_PIN_MODE_DIO
            PortPinLevelValue = PORT_PIN_LEVEL_LOW
            PortPinMode = PORT_PIN_MODE_DIO
            PortPinOpenDrain = PORT_PUSH_PULL
            PortPinPullSelect = PORT_PULL_DOWN
            PortPinRefresh = false
            PortPinChannelName = EpsEn
            PortPinAvailablePackage0 = false
            PortPinAvailablePackage1 = true
            PortPinAvailablePackage2 = true
            PortPinAvailablePackage3 = false
            PortPinAvailablePackage4 = false
            PortPinSlewRate = PORT_PIN_SLEW_RATE_NA
            PortPinName = AD1EVT
        ADC2: PortNumberOfPortPins=1, PortUse=false, PortName=MibADC 2, PortRegPostfix=ADC2, PortAvailablePackage0=false, PortAvailablePackage2=true, PortAvailablePackage3=false, PortAvailablePackage4=false, PortRegBaseAddr=4294427384, PortRegStructure=PORT_REG_STRUCT_REGULAR_PERMUTED, PortContainsPrivReg=false
          PortPinADC2_0 (PortPin):
            PortPinDirection = PORT_PIN_IN
            PortPinDirectionChangeable = false
            PortPinId = 0
            PortPinInitialMode = PORT_PIN_MODE_DIO
            PortPinLevelValue = PORT_PIN_LEVEL_LOW
            PortPinMode = PORT_PIN_MODE_DIO
            PortPinOpenDrain = PORT_PUSH_PULL
            PortPinPullSelect = PORT_PULL_DOWN
            PortPinRefresh = false
            PortPinChannelName = (unset)
            PortPinAvailablePackage0 = false
            PortPinAvailablePackage1 = true
            PortPinAvailablePackage2 = true
            PortPinAvailablePackage3 = false
            PortPinAvailablePackage4 = false
            PortPinSlewRate = PORT_PIN_SLEW_RATE_NA
            PortPinName = AD2EVT
        RTP: PortNumberOfPortPins=19, PortUse=false, PortName=RTP, PortRegPostfix=RTP, PortAvailablePackage0=false, PortAvailablePackage2=true, PortAvailablePackage3=false, PortAvailablePackage4=false, PortRegBaseAddr=4294965812, PortRegStructure=PORT_REG_STRUCT_REGULAR_NO_SLEW, PortContainsPrivReg=false
          19 x PortPin, all with PortPinDirection=PORT_PIN_IN, PortPinDirectionChangeable=false, PortPinInitialMode=PORT_PIN_MODE_DIO, PortPinLevelValue=PORT_PIN_LEVEL_LOW, PortPinMode=PORT_PIN_MODE_DIO, PortPinOpenDrain=PORT_PUSH_PULL, PortPinPullSelect=PORT_PULL_UP, PortPinRefresh=false, PortPinChannelName=(unset), PortPinAvailablePackage0=false, PortPinAvailablePackage1=true, PortPinAvailablePackage2=true, PortPinAvailablePackage3=false, PortPinAvailablePackage4=false, PortPinSlewRate=PORT_PIN_SLEW_RATE_NA:
            PortPinRtp_{0..15}: PortPinId={0..15}, PortPinName=RPTDATA{0..15}
            PortPinRtp_16: PortPinId=16, PortPinName=RPTSYNC
            PortPinRtp_17: PortPinId=17, PortPinName=RPTCLK
            PortPinRtp_18: PortPinId=18, PortPinName=RPTENA
        DMM: PortNumberOfPortPins=19, PortUse=false, PortName=DMM, PortRegPostfix=DMM, PortAvailablePackage0=true, PortAvailablePackage2=false, PortAvailablePackage3=false, PortAvailablePackage4=false, PortRegBaseAddr=4294965100, PortRegStructure=PORT_REG_STRUCT_REGULAR_NO_SLEW, PortContainsPrivReg=false
          19 x PortPin, all with PortPinDirection=PORT_PIN_IN, PortPinDirectionChangeable=false, PortPinInitialMode=PORT_PIN_MODE_DIO, PortPinLevelValue=PORT_PIN_LEVEL_LOW, PortPinMode=PORT_PIN_MODE_DIO, PortPinOpenDrain=PORT_PUSH_PULL, PortPinPullSelect=PORT_PULL_UP, PortPinRefresh=false, PortPinChannelName=(unset), PortPinAvailablePackage0=true, PortPinAvailablePackage1=true, PortPinAvailablePackage2=false, PortPinAvailablePackage3=false, PortPinAvailablePackage4=false, PortPinSlewRate=PORT_PIN_SLEW_RATE_NA:
            PortPinDmm_0: PortPinId=0, PortPinName=DMMSYNC
            PortPinDmm_1: PortPinId=1, PortPinName=DMMCLK
            PortPinDmm_2: PortPinId=2, PortPinName=DMMDATA0
            PortPinDmm_3: PortPinId=3, PortPinName=DMMDATA1
            PortPinDmm_4: PortPinId=4, PortPinName=DMMDATA2
            PortPinDmm_5: PortPinId=5, PortPinName=DMMDATA3
            PortPinDmm_6: PortPinId=6, PortPinName=DMMDATA4
            PortPinDmm_7: PortPinId=7, PortPinName=DMMDATA5
            PortPinDmm_8: PortPinId=8, PortPinName=DMMDATA6
            PortPinDmm_9: PortPinId=9, PortPinName=DMMDATA7
            PortPinDmm_10: PortPinId=10, PortPinName=DMMDATA8
            PortPinDmm_11: PortPinId=11, PortPinName=DMMDATA9
            PortPinDmm_12: PortPinId=12, PortPinName=DMMDATA10
            PortPinDmm_13: PortPinId=13, PortPinName=DMMDATA11
            PortPinDmm_14: PortPinId=14, PortPinName=DMMDATA12
            PortPinDmm_15: PortPinId=15, PortPinName=DMMDATA13
            PortPinDmm_16: PortPinId=16, PortPinName=DMMDATA14
            PortPinDmm_17: PortPinId=17, PortPinName=DMMDATA15
            PortPinDmm_18: PortPinId=18, PortPinName=DMMnENA
      PortDefaultSettings:
        PortUseDefaultSettings = false
        PortDefaultDirection = PORT_PIN_IN
        PortDefaultLevelValue = PORT_PIN_LEVEL_LOW
        PortDefaultOpenDrain = PORT_PUSH_PULL
        PortDefaultPullSelect = PORT_PULL_UP
        PortDefaultSlewRate = PORT_PIN_SLEW_RATE_NORMAL
      Multiplexing (PortMux):
        PortMuxName = Port Pin Multiplexing
        PortMuxNumberOfPins = 9
        PortMuxNumberOfRegs = 31
        PortMuxRegPostfix = PINMUX
        PortMuxRegBaseAddr = 4294961936
        PortUseMux = true
        PortMuxEmifClkOutput = false
        PortMuxDisableNhet2OutputByGiob2 = false
        PortMuxSelMiiOrRmii = PORT_MUX_SEL_RMII
        PortMuxSelAdcTriggerTable = PORT_MUX_SEL_ADC_TRIG_TABLE_2
        109 x PortMuxPin, all with PortMuxPinId=0, PortMuxPinNumberPackage0=-, PortMuxPinNumberPackage3=-, PortMuxPinNumberPackage4=-:
          Pin_N19_86: PortMuxPinName=AD1EVT, MII_RX_ER, RMII_RX_ER, PortMuxPinFunc=PORT_PIN_MUX_AD1EVT, PortMuxPinRegId=10, PortMuxPinRegPos=0, PortMuxPinNumberPackage1=N19, PortMuxPinNumberPackage2=86, PortMuxPinDirection=PORT_MUX_PIN_DIR_OUTPUT
          Pin_D4: PortMuxPinName=EMIF_ADDR[0], NHET2[1], PortMuxPinFunc=PORT_PIN_MUX_EMIF_ADDR_0, PortMuxPinRegId=22, PortMuxPinRegPos=0, PortMuxPinNumberPackage1=D4, PortMuxPinNumberPackage2=-, PortMuxPinDirection=PORT_MUX_PIN_DIR_OUTPUT
          Pin_D5: PortMuxPinName=EMIF_ADDR[1], NHET2[3], PortMuxPinFunc=PORT_PIN_MUX_EMIF_ADDR_1, PortMuxPinRegId=21, PortMuxPinRegPos=0, PortMuxPinNumberPackage1=D5, PortMuxPinNumberPackage2=-, PortMuxPinDirection=PORT_MUX_PIN_DIR_OUTPUT
          Pin_C8: PortMuxPinName=EMIF_ADDR[10], RTP_DATA[09], PortMuxPinFunc=PORT_PIN_MUX_EMIF_ADDR_10, PortMuxPinRegId=21, PortMuxPinRegPos=16, PortMuxPinNumberPackage1=C8, PortMuxPinNumberPackage2=-, PortMuxPinDirection=PORT_MUX_PIN_DIR_OUTPUT
          Pin_C9: PortMuxPinName=EMIF_ADDR[11], RTP_DATA[08], PortMuxPinFunc=PORT_PIN_MUX_EMIF_ADDR_11, PortMuxPinRegId=20, PortMuxPinRegPos=24, PortMuxPinNumberPackage1=C9, PortMuxPinNumberPackage2=-, PortMuxPinDirection=PORT_MUX_PIN_DIR_OUTPUT
          Pin_C10: PortMuxPinName=EMIF_ADDR[12], RTP_DATA[06], PortMuxPinFunc=PORT_PIN_MUX_EMIF_ADDR_12, PortMuxPinRegId=20, PortMuxPinRegPos=8, PortMuxPinNumberPackage1=C10, PortMuxPinNumberPackage2=-, PortMuxPinDirection=PORT_MUX_PIN_DIR_OUTPUT
          Pin_C11: PortMuxPinName=EMIF_ADDR[13], RTP_DATA[05], PortMuxPinFunc=PORT_PIN_MUX_EMIF_ADDR_13, PortMuxPinRegId=20, PortMuxPinRegPos=0, PortMuxPinNumberPackage1=C11, PortMuxPinNumberPackage2=-, PortMuxPinDirection=PORT_MUX_PIN_DIR_OUTPUT
          Pin_C12: PortMuxPinName=EMIF_ADDR[14], RTP_DATA[04], PortMuxPinFunc=PORT_PIN_MUX_EMIF_ADDR_14, PortMuxPinRegId=18, PortMuxPinRegPos=16, PortMuxPinNumberPackage1=C12, PortMuxPinNumberPackage2=-, PortMuxPinDirection=PORT_MUX_PIN_DIR_OUTPUT
          Pin_C13: PortMuxPinName=EMIF_ADDR[15], RTP_DATA[03], PortMuxPinFunc=PORT_PIN_MUX_EMIF_ADDR_15, PortMuxPinRegId=18, PortMuxPinRegPos=0, PortMuxPinNumberPackage1=C13, PortMuxPinNumberPackage2=-, PortMuxPinDirection=PORT_MUX_PIN_DIR_OUTPUT
          Pin_D14: PortMuxPinName=EMIF_ADDR[16], RTP_DATA[02], PortMuxPinFunc=PORT_PIN_MUX_EMIF_ADDR_16, PortMuxPinRegId=16, PortMuxPinRegPos=16, PortMuxPinNumberPackage1=D14, PortMuxPinNumberPackage2=-, PortMuxPinDirection=PORT_MUX_PIN_DIR_OUTPUT
          Pin_C14: PortMuxPinName=EMIF_ADDR[17], RTP_DATA[01], PortMuxPinFunc=PORT_PIN_MUX_EMIF_ADDR_17, PortMuxPinRegId=16, PortMuxPinRegPos=8, PortMuxPinNumberPackage1=C14, PortMuxPinNumberPackage2=-, PortMuxPinDirection=PORT_MUX_PIN_DIR_OUTPUT
          Pin_D15: PortMuxPinName=EMIF_ADDR[18], RTP_DATA[0], PortMuxPinFunc=PORT_PIN_MUX_EMIF_ADDR_18, PortMuxPinRegId=15, PortMuxPinRegPos=24, PortMuxPinNumberPackage1=D15, PortMuxPinNumberPackage2=-, PortMuxPinDirection=PORT_MUX_PIN_DIR_OUTPUT
          Pin_C15: PortMuxPinName=EMIF_ADDR[19], RTP_nENA, PortMuxPinFunc=PORT_PIN_MUX_EMIF_ADDR_19, PortMuxPinRegId=15, PortMuxPinRegPos=16, PortMuxPinNumberPackage1=C15, PortMuxPinNumberPackage2=-, PortMuxPinDirection=PORT_MUX_PIN_DIR_OUTPUT
          Pin_C16: PortMuxPinName=EMIF_ADDR[20], RTP_nSYNC, PortMuxPinFunc=PORT_PIN_MUX_EMIF_ADDR_20, PortMuxPinRegId=15, PortMuxPinRegPos=8, PortMuxPinNumberPackage1=C16, PortMuxPinNumberPackage2=-, PortMuxPinDirection=PORT_MUX_PIN_DIR_OUTPUT
          Pin_C17: PortMuxPinName=EMIF_ADDR[21], RTP_CLK, PortMuxPinFunc=PORT_PIN_MUX_EMIF_ADDR_21, PortMuxPinRegId=15, PortMuxPinRegPos=0, PortMuxPinNumberPackage1=C17, PortMuxPinNumberPackage2=-, PortMuxPinDirection=PORT_MUX_PIN_DIR_OUTPUT
          Pin_C4: PortMuxPinName=EMIF_ADDR[6], RTP_DATA[13], NHET2[11], PortMuxPinFunc=PORT_PIN_MUX_EMIF_ADDR_6, PortMuxPinRegId=22, PortMuxPinRegPos=16, PortMuxPinNumberPackage1=C4, PortMuxPinNumberPackage2=-, PortMuxPinDirection=PORT_MUX_PIN_DIR_OUTPUT
          Pin_C5: PortMuxPinName=EMIF_ADDR[7], RTP_DATA[12], NHET2[13], PortMuxPinFunc=PORT_PIN_MUX_EMIF_ADDR_7, PortMuxPinRegId=22, PortMuxPinRegPos=8, PortMuxPinNumberPackage1=C5, PortMuxPinNumberPackage2=-, PortMuxPinDirection=PORT_MUX_PIN_DIR_OUTPUT
          Pin_C6: PortMuxPinName=EMIF_ADDR[8], RTP_DATA[11], NHET2[15], PortMuxPinFunc=PORT_PIN_MUX_EMIF_ADDR_8, PortMuxPinRegId=23, PortMuxPinRegPos=0, PortMuxPinNumberPackage1=C6, PortMuxPinNumberPackage2=-, PortMuxPinDirection=PORT_MUX_PIN_DIR_OUTPUT
          Pin_C7: PortMuxPinName=EMIF_ADDR[9], RTP_DATA[10], PortMuxPinFunc=PORT_PIN_MUX_EMIF_ADDR_9, PortMuxPinRegId=21, PortMuxPinRegPos=24, PortMuxPinNumberPackage1=C7, PortMuxPinNumberPackage2=-, PortMuxPinDirection=PORT_MUX_PIN_DIR_OUTPUT
          Pin_D16: PortMuxPinName=EMIF_BA[1], NHET2[5], PortMuxPinFunc=PORT_PIN_MUX_EMIF_BA_1, PortMuxPinRegId=14, PortMuxPinRegPos=24, PortMuxPinNumberPackage1=D16, PortMuxPinNumberPackage2=-, PortMuxPinDirection=PORT_MUX_PIN_DIR_OUTPUT
          Pin_N17: PortMuxPinName=EMIF_nCS[0], RTP_DATA[15], NHET2[7], PortMuxPinFunc=PORT_PIN_MUX_EMIF_nCS_0, PortMuxPinRegId=10, PortMuxPinRegPos=16, PortMuxPinNumberPackage1=N17, PortMuxPinNumberPackage2=-, PortMuxPinDirection=PORT_MUX_PIN_DIR_OUTPUT
          Pin_K17: PortMuxPinName=EMIF_nCS[3], RTP_DATA[14], NHET2[9], PortMuxPinFunc=PORT_PIN_MUX_EMIF_nCS_3, PortMuxPinRegId=11, PortMuxPinRegPos=0, PortMuxPinNumberPackage1=K17, PortMuxPinNumberPackage2=-, PortMuxPinDirection=PORT_MUX_PIN_DIR_OUTPUT
          Pin_M17: PortMuxPinName=EMIF_nCS[4], RTP_DATA[07], PortMuxPinFunc=PORT_PIN_MUX_EMIF_nCS_4, PortMuxPinRegId=11, PortMuxPinRegPos=8, PortMuxPinNumberPackage1=M17, PortMuxPinNumberPackage2=-, PortMuxPinDirection=PORT_MUX_PIN_DIR_OUTPUT
          Pin_D17: PortMuxPinName=EMIF_nWE, EMIF_RNW, PortMuxPinFunc=PORT_PIN_MUX_EMIF_nWE, PortMuxPinRegId=14, PortMuxPinRegPos=16, PortMuxPinNumberPackage1=D17, PortMuxPinNumberPackage2=-, PortMuxPinDirection=PORT_MUX_PIN_DIR_OUTPUT
          Pin_D9: PortMuxPinName=ETMDATA[08], EMIF_ADDR[5], PortMuxPinFunc=PORT_PIN_MUX_ETMDATA_08, PortMuxPinRegId=17, PortMuxPinRegPos=24, PortMuxPinNumberPackage1=D9, PortMuxPinNumberPackage2=-, PortMuxPinDirection=PORT_MUX_PIN_DIR_OUTPUT
          Pin_D8: PortMuxPinName=ETMDATA[09], EMIF_ADDR[4], PortMuxPinFunc=PORT_PIN_MUX_ETMDATA_09, PortMuxPinRegId=19, PortMuxPinRegPos=0, PortMuxPinNumberPackage1=D8, PortMuxPinNumberPackage2=-, PortMuxPinDirection=PORT_MUX_PIN_DIR_OUTPUT
          Pin_D7: PortMuxPinName=ETMDATA[10], EMIF_ADDR[3], PortMuxPinFunc=PORT_PIN_MUX_ETMDATA_10, PortMuxPinRegId=19, PortMuxPinRegPos=24, PortMuxPinNumberPackage1=D7, PortMuxPinNumberPackage2=-, PortMuxPinDirection=PORT_MUX_PIN_DIR_OUTPUT
          Pin_D6: PortMuxPinName=ETMDATA[11], EMIF_ADDR[2], PortMuxPinFunc=PORT_PIN_MUX_ETMDATA_11, PortMuxPinRegId=22, PortMuxPinRegPos=24, PortMuxPinNumberPackage1=D6, PortMuxPinNumberPackage2=-, PortMuxPinDirection=PORT_MUX_PIN_DIR_OUTPUT
          Pin_D13: PortMuxPinName=ETMDATA[12], EMIF_BA[0], PortMuxPinFunc=PORT_PIN_MUX_ETMDATA_12, PortMuxPinRegId=16, PortMuxPinRegPos=0, PortMuxPinNumberPackage1=D13, PortMuxPinNumberPackage2=-, PortMuxPinDirection=PORT_MUX_PIN_DIR_OUTPUT
          Pin_D12: PortMuxPinName=ETMDATA[13], EMIF_nOE, PortMuxPinFunc=PORT_PIN_MUX_ETMDATA_13, PortMuxPinRegId=16, PortMuxPinRegPos=24, PortMuxPinNumberPackage1=D12, PortMuxPinNumberPackage2=-, PortMuxPinDirection=PORT_MUX_PIN_DIR_OUTPUT
          Pin_D11: PortMuxPinName=ETMDATA[14], EMIF_nDQM[1], PortMuxPinFunc=PORT_PIN_MUX_ETMDATA_14, PortMuxPinRegId=17, PortMuxPinRegPos=8, PortMuxPinNumberPackage1=D11, PortMuxPinNumberPackage2=-, PortMuxPinDirection=PORT_MUX_PIN_DIR_OUTPUT
          Pin_D10: PortMuxPinName=ETMDATA[15], EMIF_nDQM[0], PortMuxPinFunc=PORT_PIN_MUX_ETMDATA_15, PortMuxPinRegId=19, PortMuxPinRegPos=16, PortMuxPinNumberPackage1=D10, PortMuxPinNumberPackage2=-, PortMuxPinDirection=PORT_MUX_PIN_DIR_OUTPUT
          Pin_K15: PortMuxPinName=ETMDATA[16], EMIF_DATA[0], PortMuxPinFunc=PORT_PIN_MUX_ETMDATA_16, PortMuxPinRegId=12, PortMuxPinRegPos=8, PortMuxPinNumberPackage1=K15, PortMuxPinNumberPackage2=-, PortMuxPinDirection=PORT_MUX_PIN_DIR_OUTPUT
          Pin_L15: PortMuxPinName=ETMDATA[17], EMIF_DATA[1], PortMuxPinFunc=PORT_PIN_MUX_ETMDATA_17, PortMuxPinRegId=11, PortMuxPinRegPos=16, PortMuxPinNumberPackage1=L15, PortMuxPinNumberPackage2=-, PortMuxPinDirection=PORT_MUX_PIN_DIR_OUTPUT
          Pin_M15: PortMuxPinName=ETMDATA[18], EMIF_DATA[2], PortMuxPinFunc=PORT_PIN_MUX_ETMDATA_18, PortMuxPinRegId=10, PortMuxPinRegPos=24, PortMuxPinNumberPackage1=M15, PortMuxPinNumberPackage2=-, PortMuxPinDirection=PORT_MUX_PIN_DIR_OUTPUT
          Pin_N15: PortMuxPinName=ETMDATA[19], EMIF_DATA[3], PortMuxPinFunc=PORT_PIN_MUX_ETMDATA_19, PortMuxPinRegId=10, PortMuxPinRegPos=8, PortMuxPinNumberPackage1=N15, PortMuxPinNumberPackage2=-, PortMuxPinDirection=PORT_MUX_PIN_DIR_OUTPUT
          Pin_E4: PortMuxPinName=ETMDATA[20], EMIF_DATA[4], PortMuxPinFunc=PORT_PIN_MUX_ETMDATA_20, PortMuxPinRegId=1, PortMuxPinRegPos=16, PortMuxPinNumberPackage1=E4, PortMuxPinNumberPackage2=-, PortMuxPinDirection=PORT_MUX_PIN_DIR_OUTPUT
          Pin_F4: PortMuxPinName=ETMDATA[21], EMIF_DATA[5], PortMuxPinFunc=PORT_PIN_MUX_ETMDATA_21, PortMuxPinRegId=1, PortMuxPinRegPos=24, PortMuxPinNumberPackage1=F4, PortMuxPinNumberPackage2=-, PortMuxPinDirection=PORT_MUX_PIN_DIR_OUTPUT
          Pin_G4: PortMuxPinName=ETMDATA[22], EMIF_DATA[6], PortMuxPinFunc=PORT_PIN_MUX_ETMDATA_22, PortMuxPinRegId=2, PortMuxPinRegPos=8, PortMuxPinNumberPackage1=G4, PortMuxPinNumberPackage2=-, PortMuxPinDirection=PORT_MUX_PIN_DIR_OUTPUT
          Pin_K4: PortMuxPinName=ETMDATA[23], EMIF_DATA[7], PortMuxPinFunc=PORT_PIN_MUX_ETMDATA_23, PortMuxPinRegId=3, PortMuxPinRegPos=0, PortMuxPinNumberPackage1=K4, PortMuxPinNumberPackage2=-, PortMuxPinDirection=PORT_MUX_PIN_DIR_OUTPUT
          Pin_L4: PortMuxPinName=ETMDATA[24], EMIF_DATA[8], PortMuxPinFunc=PORT_PIN_MUX_ETMDATA_24, PortMuxPinRegId=3, PortMuxPinRegPos=24, PortMuxPinNumberPackage1=L4, PortMuxPinNumberPackage2=-, PortMuxPinDirection=PORT_MUX_PIN_DIR_OUTPUT
          Pin_M4: PortMuxPinName=ETMDATA[25], EMIF_DATA[9], PortMuxPinFunc=PORT_PIN_MUX_ETMDATA_25, PortMuxPinRegId=4, PortMuxPinRegPos=8, PortMuxPinNumberPackage1=M4, PortMuxPinNumberPackage2=-, PortMuxPinDirection=PORT_MUX_PIN_DIR_OUTPUT
          Pin_N4: PortMuxPinName=ETMDATA[26], EMIF_DATA[10], PortMuxPinFunc=PORT_PIN_MUX_ETMDATA_26, PortMuxPinRegId=5, PortMuxPinRegPos=24, PortMuxPinNumberPackage1=N4, PortMuxPinNumberPackage2=-, PortMuxPinDirection=PORT_MUX_PIN_DIR_OUTPUT
          Pin_P4: PortMuxPinName=ETMDATA[27], EMIF_DATA[11], PortMuxPinFunc=PORT_PIN_MUX_ETMDATA_27, PortMuxPinRegId=6, PortMuxPinRegPos=8, PortMuxPinNumberPackage1=P4, PortMuxPinNumberPackage2=-, PortMuxPinDirection=PORT_MUX_PIN_DIR_OUTPUT
          Pin_R5: PortMuxPinName=ETMDATA[28], EMIF_DATA[12], PortMuxPinFunc=PORT_PIN_MUX_ETMDATA_28, PortMuxPinRegId=6, PortMuxPinRegPos=24, PortMuxPinNumberPackage1=R5, PortMuxPinNumberPackage2=-, PortMuxPinDirection=PORT_MUX_PIN_DIR_OUTPUT
          Pin_R6: PortMuxPinName=ETMDATA[29], EMIF_DATA[13], PortMuxPinFunc=PORT_PIN_MUX_ETMDATA_29, PortMuxPinRegId=7, PortMuxPinRegPos=0, PortMuxPinNumberPackage1=R6, PortMuxPinNumberPackage2=-, PortMuxPinDirection=PORT_MUX_PIN_DIR_OUTPUT
          Pin_R7: PortMuxPinName=ETMDATA[30], EMIF_DATA[14], PortMuxPinFunc=PORT_PIN_MUX_ETMDATA_30, PortMuxPinRegId=7, PortMuxPinRegPos=24, PortMuxPinNumberPackage1=R7, PortMuxPinNumberPackage2=-, PortMuxPinDirection=PORT_MUX_PIN_DIR_OUTPUT
          Pin_R8: PortMuxPinName=ETMDATA[31], EMIF_DATA[15], PortMuxPinFunc=PORT_PIN_MUX_ETMDATA_31, PortMuxPinRegId=8, PortMuxPinRegPos=24, PortMuxPinNumberPackage1=R8, PortMuxPinNumberPackage2=-, PortMuxPinDirection=PORT_MUX_PIN_DIR_OUTPUT
          Pin_R9: PortMuxPinName=ETMTRACECLKIN, EXTCLKIN2, PortMuxPinFunc=PORT_PIN_MUX_ETMTRACECLKIN, PortMuxPinRegId=9, PortMuxPinRegPos=0, PortMuxPinNumberPackage1=R9, PortMuxPinNumberPackage2=-, PortMuxPinDirection=PORT_MUX_PIN_DIR_OUTPUT
          Pin_C1_9: PortMuxPinName=GIOA[2], Reserved, Reserved, NHET2[0], PortMuxPinFunc=PORT_PIN_MUX_GIOA_2, PortMuxPinRegId=2, PortMuxPinRegPos=0, PortMuxPinNumberPackage1=C1, PortMuxPinNumberPackage2=9, PortMuxPinDirection=PORT_MUX_PIN_DIR_OUTPUT
          Pin_E1: PortMuxPinName=GIOA[3], NHET2[2], PortMuxPinFunc=PORT_PIN_MUX_GIOA_3, PortMuxPinRegId=2, PortMuxPinRegPos=16, PortMuxPinNumberPackage1=E1, PortMuxPinNumberPackage2=-, PortMuxPinDirection=PORT_MUX_PIN_DIR_OUTPUT
          Pin_B5_14: PortMuxPinName=GIOA[5], EXTCLKIN, PortMuxPinFunc=PORT_PIN_MUX_GIOA_5, PortMuxPinRegId=2, PortMuxPinRegPos=24, PortMuxPinNumberPackage1=B5, PortMuxPinNumberPackage2=14, PortMuxPinDirection=PORT_MUX_PIN_DIR_OUTPUT
          Pin_H3_16: PortMuxPinName=GIOA[6], NHET2[4], PortMuxPinFunc=PORT_PIN_MUX_NHET2_4, PortMuxPinRegId=3, PortMuxPinRegPos=16, PortMuxPinNumberPackage1=H3, PortMuxPinNumberPackage2=16, PortMuxPinDirection=PORT_MUX_PIN_DIR_OUTPUT
          Pin_M1_22: PortMuxPinName=GIOA[7], NHET2[6], PortMuxPinFunc=PORT_PIN_MUX_GIOA_7, PortMuxPinRegId=4, PortMuxPinRegPos=0, PortMuxPinNumberPackage1=M1, PortMuxPinNumberPackage2=22, PortMuxPinDirection=PORT_MUX_PIN_DIR_OUTPUT
          Pin_R2_105: PortMuxPinName=MIBSPI1NCS[0], MIBSPI1SOMI[1], MII_TXD[2], PortMuxPinFunc=PORT_PIN_MUX_MIBSPI1NCS_0, PortMuxPinRegId=13, PortMuxPinRegPos=24, PortMuxPinNumberPackage1=R2, PortMuxPinNumberPackage2=105, PortMuxPinDirection=PORT_MUX_PIN_DIR_OUTPUT
          Pin_F3_130: PortMuxPinName=MIBSPI1NCS[1], NHET1[17], MII_COL, PortMuxPinFunc=PORT_PIN_MUX_MIBSPI1NCS_1, PortMuxPinRegId=20, PortMuxPinRegPos=16, PortMuxPinNumberPackage1=F3, PortMuxPinNumberPackage2=130, PortMuxPinDirection=PORT_MUX_PIN_DIR_OUTPUT
          Pin_F3_130_IN: PortMuxPinName=MIBSPI1NCS[1], NHET1[17], PortMuxPinFunc=PORT_PIN_MUX_MIBSPI1NCS_1, PortMuxPinRegId=24, PortMuxPinRegPos=16, PortMuxPinNumberPackage1=F3, PortMuxPinNumberPackage2=130, PortMuxPinDirection=PORT_MUX_PIN_DIR_INPUT
          Pin_G3_40: PortMuxPinName=MIBSPI1NCS[2], NHET1[19], MDIO, PortMuxPinFunc=PORT_PIN_MUX_MIBSPI1NCS_2, PortMuxPinRegId=8, PortMuxPinRegPos=8, PortMuxPinNumberPackage1=G3, PortMuxPinNumberPackage2=40, PortMuxPinDirection=PORT_MUX_PIN_DIR_OUTPUT
          Pin_G3_40_IN: PortMuxPinName=MIBSPI1NCS[2], NHET1[19], PortMuxPinFunc=PORT_PIN_MUX_MIBSPI1NCS_2, PortMuxPinRegId=24, PortMuxPinRegPos=24, PortMuxPinNumberPackage1=G3, PortMuxPinNumberPackage2=40, PortMuxPinDirection=PORT_MUX_PIN_DIR_INPUT
          Pin_J3: PortMuxPinName=MIBSPI1NCS[3], NHET1[21], PortMuxPinFunc=PORT_PIN_MUX_MIBSPI1NCS_3, PortMuxPinRegId=9, PortMuxPinRegPos=24, PortMuxPinNumberPackage1=J3, PortMuxPinNumberPackage2=-, PortMuxPinDirection=PORT_MUX_PIN_DIR_OUTPUT
          Pin_J3_IN: PortMuxPinName=MIBSPI1NCS[3], NHET1[21], PortMuxPinFunc=PORT_PIN_MUX_MIBSPI1NCS_3, PortMuxPinRegId=25, PortMuxPinRegPos=0, PortMuxPinNumberPackage1=J3, PortMuxPinNumberPackage2=-, PortMuxPinDirection=PORT_MUX_PIN_DIR_INPUT
          Pin_G19_96: PortMuxPinName=MIBSPI1NENA, NHET1[23], MII_RXD[2], PortMuxPinFunc=PORT_PIN_MUX_MIBSPI1NENA, PortMuxPinRegId=12, PortMuxPinRegPos=16, PortMuxPinNumberPackage1=G19, PortMuxPinNumberPackage2=96, PortMuxPinDirection=PORT_MUX_PIN_DIR_OUTPUT
          Pin_G19_96_IN: PortMuxPinName=MIBSPI1NENA, NHET1[23], PortMuxPinFunc=PORT_PIN_MUX_MIBSPI1NENA, PortMuxPinRegId=25, PortMuxPinRegPos=8, PortMuxPinNumberPackage1=G19, PortMuxPinNumberPackage2=96, PortMuxPinDirection=PORT_MUX_PIN_DIR_INPUT
          Pin_V10_55: PortMuxPinName=MIBSPI3NCS[0], AD2EVT, GIOB[2], PortMuxPinFunc=PORT_PIN_MUX_MIBSPI3NCS_0, PortMuxPinRegId=9, PortMuxPinRegPos=16, PortMuxPinNumberPackage1=V10, PortMuxPinNumberPackage2=55, PortMuxPinDirection=PORT_MUX_PIN_DIR_OUTPUT
          Pin_V10_55_IN: PortMuxPinName=MIBSPI3NCS[0], GIOB[2], PortMuxPinFunc=PORT_PIN_MUX_MIBSPI3NCS_0, PortMuxPinRegId=29, PortMuxPinRegPos=16, PortMuxPinNumberPackage1=V10, PortMuxPinNumberPackage2=55, PortMuxPinDirection=PORT_MUX_PIN_DIR_INPUT
          Pin_V5_37: PortMuxPinName=MIBSPI3NCS[1], NHET1[25], MDCLK, PortMuxPinFunc=PORT_PIN_MUX_MIBSPI3NCS_1, PortMuxPinRegId=7, PortMuxPinRegPos=8, PortMuxPinNumberPackage1=V5, PortMuxPinNumberPackage2=37, PortMuxPinDirection=PORT_MUX_PIN_DIR_OUTPUT
          Pin_V5_37_IN: PortMuxPinName=MIBSPI3NCS[1], NHET1[25], PortMuxPinFunc=PORT_PIN_MUX_MIBSPI3NCS_1, PortMuxPinRegId=25, PortMuxPinRegPos=16, PortMuxPinNumberPackage1=V5, PortMuxPinNumberPackage2=37, PortMuxPinDirection=PORT_MUX_PIN_DIR_INPUT
          Pin_B2_4: PortMuxPinName=MIBSPI3NCS[2], I2C_SDA, NHET1[27], PortMuxPinFunc=PORT_PIN_MUX_I2C_SDA, PortMuxPinRegId=0, PortMuxPinRegPos=24, PortMuxPinNumberPackage1=B2, PortMuxPinNumberPackage2=4, PortMuxPinDirection=PORT_MUX_PIN_DIR_OUTPUT
          Pin_B2_4_IN: PortMuxPinName=MIBSPI3NCS[2], NHET1[27], PortMuxPinFunc=PORT_PIN_MUX_MIBSPI3NCS_2, PortMuxPinRegId=25, PortMuxPinRegPos=24, PortMuxPinNumberPackage1=B2, PortMuxPinNumberPackage2=4, PortMuxPinDirection=PORT_MUX_PIN_DIR_INPUT
          Pin_C3_3: PortMuxPinName=MIBSPI3NCS[3], I2C_SCL, NHET1[29], PortMuxPinFunc=PORT_PIN_MUX_I2C_SCL, PortMuxPinRegId=0, PortMuxPinRegPos=16, PortMuxPinNumberPackage1=C3, PortMuxPinNumberPackage2=3, PortMuxPinDirection=PORT_MUX_PIN_DIR_OUTPUT
          Pin_C3_3_IN: PortMuxPinName=MIBSPI3NCS[3], NHET1[29], PortMuxPinFunc=PORT_PIN_MUX_MIBSPI3NCS_3, PortMuxPinRegId=26, PortMuxPinRegPos=0, PortMuxPinNumberPackage1=C3, PortMuxPinNumberPackage2=3, PortMuxPinDirection=PORT_MUX_PIN_DIR_INPUT
          Pin_W9_54: PortMuxPinName=MIBSPI3NENA, MIBSPI3NCS[5], NHET1[31], PortMuxPinFunc=PORT_PIN_MUX_MIBSPI3NENA, PortMuxPinRegId=9, PortMuxPinRegPos=8, PortMuxPinNumberPackage1=W9, PortMuxPinNumberPackage2=54, PortMuxPinDirection=PORT_MUX_PIN_DIR_OUTPUT
          Pin_W9_54_IN: PortMuxPinName=MIBSPI3NENA, NHET1[31], PortMuxPinFunc=PORT_PIN_MUX_MIBSPI3NENA, PortMuxPinRegId=26, PortMuxPinRegPos=8, PortMuxPinNumberPackage1=W9, PortMuxPinNumberPackage2=54, PortMuxPinDirection=PORT_MUX_PIN_DIR_INPUT
          Pin_H19_100: PortMuxPinName=MIBSPI5CLK, DMM_DATA[4], MII_TXEN, RMII_TXEN, PortMuxPinFunc=PORT_PIN_MUX_MIBSPI5CLK, PortMuxPinRegId=13, PortMuxPinRegPos=16, PortMuxPinNumberPackage1=H19, PortMuxPinNumberPackage2=100, PortMuxPinDirection=PORT_MUX_PIN_DIR_OUTPUT
          Pin_E19_32: PortMuxPinName=MIBSPI5NCS[0], DMM_DATA[5], PortMuxPinFunc=PORT_PIN_MUX_MIBSPI5NCS_0, PortMuxPinRegId=27, PortMuxPinRegPos=0, PortMuxPinNumberPackage1=E19, PortMuxPinNumberPackage2=32, PortMuxPinDirection=PORT_MUX_PIN_DIR_OUTPUT
          Pin_B6: PortMuxPinName=MIBSPI5NCS[1], DMM_DATA[6], PortMuxPinFunc=PORT_PIN_MUX_MIBSPI5NCS_1, PortMuxPinRegId=27, PortMuxPinRegPos=8, PortMuxPinNumberPackage1=B6, PortMuxPinNumberPackage2=-, PortMuxPinDirection=PORT_MUX_PIN_DIR_OUTPUT
          Pin_W6: PortMuxPinName=MIBSPI5NCS[2], DMM_DATA[2], PortMuxPinFunc=PORT_PIN_MUX_MIBSPI5NCS_2, PortMuxPinRegId=26, PortMuxPinRegPos=16, PortMuxPinNumberPackage1=W6, PortMuxPinNumberPackage2=-, PortMuxPinDirection=PORT_MUX_PIN_DIR_OUTPUT
          Pin_T12: PortMuxPinName=MIBSPI5NCS[3], DMM_DATA[3], PortMuxPinFunc=PORT_PIN_MUX_MIBSPI5NCS_3, PortMuxPinRegId=26, PortMuxPinRegPos=24, PortMuxPinNumberPackage1=T12, PortMuxPinNumberPackage2=-, PortMuxPinDirection=PORT_MUX_PIN_DIR_OUTPUT
          Pin_H18_97: PortMuxPinName=MIBSPI5NENA, DMM_DATA[7], MII_RXD[3], PortMuxPinFunc=PORT_PIN_MUX_MIBSPI5NENA, PortMuxPinRegId=12, PortMuxPinRegPos=24, PortMuxPinNumberPackage1=H18, PortMuxPinNumberPackage2=97, PortMuxPinDirection=PORT_MUX_PIN_DIR_OUTPUT
          Pin_J19_99: PortMuxPinName=MIBSPI5SIMO[0], DMM_DATA[8], MII_TXD[1], RMII_TXD[1], PortMuxPinFunc=PORT_PIN_MUX_MIBSPI5SIMO_0, PortMuxPinRegId=13, PortMuxPinRegPos=8, PortMuxPinNumberPackage1=J19, PortMuxPinNumberPackage2=99, PortMuxPinDirection=PORT_MUX_PIN_DIR_OUTPUT
          Pin_E16: PortMuxPinName=MIBSPI5SIMO[1], DMM_DATA[9], PortMuxPinFunc=PORT_PIN_MUX_MIBSPI5SIMO_1, PortMuxPinRegId=27, PortMuxPinRegPos=16, PortMuxPinNumberPackage1=E16, PortMuxPinNumberPackage2=-, PortMuxPinDirection=PORT_MUX_PIN_DIR_OUTPUT
          Pin_H17: PortMuxPinName=MIBSPI5SIMO[2], DMM_DATA[10], PortMuxPinFunc=PORT_PIN_MUX_MIBSPI5SIMO_2, PortMuxPinRegId=27, PortMuxPinRegPos=24, PortMuxPinNumberPackage1=H17, PortMuxPinNumberPackage2=-, PortMuxPinDirection=PORT_MUX_PIN_DIR_OUTPUT
          Pin_G17: PortMuxPinName=MIBSPI5SIMO[3], DMM_DATA[11], PortMuxPinFunc=PORT_PIN_MUX_MIBSPI5SIMO_3, PortMuxPinRegId=28, PortMuxPinRegPos=0, PortMuxPinNumberPackage1=G17, PortMuxPinNumberPackage2=-, PortMuxPinDirection=PORT_MUX_PIN_DIR_OUTPUT
          Pin_J18_98: PortMuxPinName=MIBSPI5SOMI[0], DMM_DATA[12], MII_TXD[0], RMII_TXD[0], PortMuxPinFunc=PORT_PIN_MUX_MIBSPI5SOMI_0, PortMuxPinRegId=13, PortMuxPinRegPos=0, PortMuxPinNumberPackage1=J18, PortMuxPinNumberPackage2=98, PortMuxPinDirection=PORT_MUX_PIN_DIR_OUTPUT
          Pin_E17: PortMuxPinName=MIBSPI5SOMI[1], DMM_DATA[13], PortMuxPinFunc=PORT_PIN_MUX_MIBSPI5SOMI_1, PortMuxPinRegId=28, PortMuxPinRegPos=8, PortMuxPinNumberPackage1=E17, PortMuxPinNumberPackage2=-, PortMuxPinDirection=PORT_MUX_PIN_DIR_OUTPUT
          Pin_H16: PortMuxPinName=MIBSPI5SOMI[2], DMM_DATA[14], PortMuxPinFunc=PORT_PIN_MUX_MIBSPI5SOMI_2, PortMuxPinRegId=28, PortMuxPinRegPos=16, PortMuxPinNumberPackage1=H16, PortMuxPinNumberPackage2=-, PortMuxPinDirection=PORT_MUX_PIN_DIR_OUTPUT
          Pin_G16: PortMuxPinName=MIBSPI5SOMI[3], DMM_DATA[15], PortMuxPinFunc=PORT_PIN_MUX_MIBSPI5SOMI_3, PortMuxPinRegId=28, PortMuxPinRegPos=24, PortMuxPinNumberPackage1=G16, PortMuxPinNumberPackage2=-, PortMuxPinDirection=PORT_MUX_PIN_DIR_OUTPUT
          Pin_K18_25: PortMuxPinName=NHET1[0], SPI4CLK, PortMuxPinFunc=PORT_PIN_MUX_NHET1_0, PortMuxPinRegId=5, PortMuxPinRegPos=0, PortMuxPinNumberPackage1=K18, PortMuxPinNumberPackage2=25, PortMuxPinDirection=PORT_MUX_PIN_DIR_OUTPUT
          Pin_K18_25_IN: PortMuxPinName=NHET1[0], SPI4CLK, PortMuxPinFunc=PORT_PIN_MUX_NHET1_0, PortMuxPinRegId=23, PortMuxPinRegPos=8, PortMuxPinNumberPackage1=K18, PortMuxPinNumberPackage2=25, PortMuxPinDirection=PORT_MUX_PIN_DIR_INPUT
          Pin_V2_23: PortMuxPinName=NHET1[01], SPI4NENA, NHET2[8], PortMuxPinFunc=PORT_PIN_MUX_NHET2_8, PortMuxPinRegId=4, PortMuxPinRegPos=16, PortMuxPinNumberPackage1=V2, PortMuxPinNumberPackage2=23, PortMuxPinDirection=PORT_MUX_PIN_DIR_OUTPUT
          Pin_W5_30: PortMuxPinName=NHET1[02], SPI4SIMO, PortMuxPinFunc=PORT_PIN_MUX_NHET1_02, PortMuxPinRegId=5, PortMuxPinRegPos=8, PortMuxPinNumberPackage1=W5, PortMuxPinNumberPackage2=30, PortMuxPinDirection=PORT_MUX_PIN_DIR_OUTPUT
          Pin_W5_30_IN: PortMuxPinName=NHET1[02], SPI4SIMO, PortMuxPinFunc=PORT_PIN_MUX_NHET1_02, PortMuxPinRegId=23, PortMuxPinRegPos=16, PortMuxPinNumberPackage1=W5, PortMuxPinNumberPackage2=30, PortMuxPinDirection=PORT_MUX_PIN_DIR_INPUT
          Pin_U1_24: PortMuxPinName=NHET1[03], SPI4NCS[0], NHET2[10], PortMuxPinFunc=PORT_PIN_MUX_NHET2_10, PortMuxPinRegId=4, PortMuxPinRegPos=24, PortMuxPinNumberPackage1=U1, PortMuxPinNumberPackage2=24, PortMuxPinDirection=PORT_MUX_PIN_DIR_OUTPUT
          Pin_V6_31: PortMuxPinName=NHET1[05], SPI4SOMI, NHET2[12], PortMuxPinFunc=PORT_PIN_MUX_NHET2_12, PortMuxPinRegId=5, PortMuxPinRegPos=16, PortMuxPinNumberPackage1=V6, PortMuxPinNumberPackage2=31, PortMuxPinDirection=PORT_MUX_PIN_DIR_OUTPUT
          Pin_V6_31_IN: PortMuxPinName=NHET1[05], SPI4SOMI, PortMuxPinFunc=PORT_PIN_MUX_NHET1_05, PortMuxPinRegId=23, PortMuxPinRegPos=24, PortMuxPinNumberPackage1=V6, PortMuxPinNumberPackage2=31, PortMuxPinDirection=PORT_MUX_PIN_DIR_INPUT
          Pin_W3_38: PortMuxPinName=NHET1[06], SCIRX, PortMuxPinFunc=PORT_PIN_MUX_NHET1_06, PortMuxPinRegId=7, PortMuxPinRegPos=16, PortMuxPinNumberPackage1=W3, PortMuxPinNumberPackage2=38, PortMuxPinDirection=PORT_MUX_PIN_DIR_OUTPUT
          Pin_T1_33: PortMuxPinName=NHET1[07], Reserved, Reserved, NHET2[14], PortMuxPinFunc=PORT_PIN_MUX_NHET2_14, PortMuxPinRegId=6, PortMuxPinRegPos=0, PortMuxPinNumberPackage1=T1, PortMuxPinNumberPackage2=33, PortMuxPinDirection=PORT_MUX_PIN_DIR_OUTPUT
          Pin_E18_106: PortMuxPinName=NHET1[08], MIBSPI1SIMO[1], MII_TXD[3], PortMuxPinFunc=PORT_PIN_MUX_NHET1_08, PortMuxPinRegId=14, PortMuxPinRegPos=0, PortMuxPinNumberPackage1=E18, PortMuxPinNumberPackage2=106, PortMuxPinDirection=PORT_MUX_PIN_DIR_OUTPUT
          Pin_V7_35: PortMuxPinName=NHET1[09], NHET2[16], PortMuxPinFunc=PORT_PIN_MUX_NHET1_09, PortMuxPinRegId=6, PortMuxPinRegPos=16, PortMuxPinNumberPackage1=V7, PortMuxPinNumberPackage2=35, PortMuxPinDirection=PORT_MUX_PIN_DIR_OUTPUT
          Pin_D19_118: PortMuxPinName=NHET1[10], MII_TX_CLK, Reserved, MII_TX_AVCLK4, PortMuxPinFunc=PORT_PIN_MUX_NHET1_10, PortMuxPinRegId=17, PortMuxPinRegPos=0, PortMuxPinNumberPackage1=D19, PortMuxPinNumberPackage2=118, PortMuxPinDirection=PORT_MUX_PIN_DIR_OUTPUT
          Pin_E3_6: PortMuxPinName=NHET1[11], MIBSPI3NCS[4], NHET2[18], PortMuxPinFunc=PORT_PIN_MUX_NHET2_18, PortMuxPinRegId=1, PortMuxPinRegPos=8, PortMuxPinNumberPackage1=E3, PortMuxPinNumberPackage2=6, PortMuxPinDirection=PORT_MUX_PIN_DIR_OUTPUT
          Pin_B4_124: PortMuxPinName=NHET1[12], MII_CRS, RMII_CRS_DV, PortMuxPinFunc=PORT_PIN_MUX_NHET1_12, PortMuxPinRegId=17, PortMuxPinRegPos=16, PortMuxPinNumberPackage1=B4, PortMuxPinNumberPackage2=124, PortMuxPinDirection=PORT_MUX_PIN_DIR_OUTPUT
          Pin_N2_39: PortMuxPinName=NHET1[13], SCITX, PortMuxPinFunc=PORT_PIN_MUX_NHET1_13, PortMuxPinRegId=8, PortMuxPinRegPos=0, PortMuxPinNumberPackage1=N2, PortMuxPinNumberPackage2=39, PortMuxPinDirection=PORT_MUX_PIN_DIR_OUTPUT
          Pin_N1_41: PortMuxPinName=NHET1[15], MIBSPI1NCS[4], PortMuxPinFunc=PORT_PIN_MUX_NHET1_15, PortMuxPinRegId=8, PortMuxPinRegPos=16, PortMuxPinNumberPackage1=N1, PortMuxPinNumberPackage2=41, PortMuxPinDirection=PORT_MUX_PIN_DIR_OUTPUT
          Pin_P1_91: PortMuxPinName=NHET1[24], MIBSPI1NCS[5], MII_RXD[0], RMII_RXD[0], PortMuxPinFunc=PORT_PIN_MUX_NHET1_24, PortMuxPinRegId=11, PortMuxPinRegPos=24, PortMuxPinNumberPackage1=P1, PortMuxPinNumberPackage2=91, PortMuxPinDirection=PORT_MUX_PIN_DIR_OUTPUT
          Pin_A14_92: PortMuxPinName=NHET1[26], MII_RXD[1], RMII_RXD[1], PortMuxPinFunc=PORT_PIN_MUX_NHET1_26, PortMuxPinRegId=12, PortMuxPinRegPos=0, PortMuxPinNumberPackage1=A14, PortMuxPinNumberPackage2=92, PortMuxPinDirection=PORT_MUX_PIN_DIR_OUTPUT
          Pin_K19_107: PortMuxPinName=NHET1[28], MII_RXCLK, RMII_REFCLK, MII_RX_AVCLK4, PortMuxPinFunc=PORT_PIN_MUX_NHET1_28, PortMuxPinRegId=14, PortMuxPinRegPos=8, PortMuxPinNumberPackage1=K19, PortMuxPinNumberPackage2=107, PortMuxPinDirection=PORT_MUX_PIN_DIR_OUTPUT
          Pin_B11_127: PortMuxPinName=NHET1[30], MII_RX_DV, PortMuxPinFunc=PORT_PIN_MUX_NHET1_30, PortMuxPinRegId=19, PortMuxPinRegPos=8, PortMuxPinNumberPackage1=B11, PortMuxPinNumberPackage2=127, PortMuxPinDirection=PORT_MUX_PIN_DIR_OUTPUT
          Pin_D3_54: PortMuxPinName=SPI2NENA, SPI2NCS[1], PortMuxPinFunc=PORT_PIN_MUX_SPI2NENA, PortMuxPinRegId=29, PortMuxPinRegPos=0, PortMuxPinNumberPackage1=D3, PortMuxPinNumberPackage2=54, PortMuxPinDirection=PORT_MUX_PIN_DIR_OUTPUT
    PortGeneral:
      PortDevErrorDetect = true
      PortSetPinDirectionApi = true
      PortSetPinModeApi = false
      PortVersionInfoApi = false
      PortRefreshPortDirectionApi = false
      PortCfgDoParamChk = true
      PortCfgChkUninit = true
      PortCfgChkParamPin = true
      PortCfgChkParamVinfo = true
      PortCfgChkParamConfig = true
      PortCfgDebugReporting = true
      PortErrorhook = Det_ReportError
      PortDetIncludeFile = Det.h
      PortPackageMapping0 = NA
      PortPackageMapping1 = Pin_337
      PortPackageMapping2 = Pin_144
      PortPackageMapping3 = NA
      PortPackageMapping4 = NA
      PortSpecialRegisterAccessEnabled = true
      PortSpecialRegisterAccessOnlyForWrite = true
      PortSpecialRegisterAccessOnlyForPrivilegedModeRegisters = true
      PortSpecialRegisterAccessNotInInit = false
      PortIrqHandling = SuspendAllInterrupts
  module config PwrLmtFuncCr: implementation-config-variant=VARIANT-POST-BUILD
    PwrLmtFuncCrGeneral
    CommonPublishedInformation: ArMajorVersion=3, ArMinorVersion=2, ArPatchVersion=0, SwMajorVersion=0, SwMinorVersion=0, SwPatchVersion=0, ModuleId=0, VendorId=0
  module config QuadDet: implementation-config-variant=VARIANT-POST-BUILD
    QuadDetGeneral
    CommonPublishedInformation: ArMajorVersion=3, ArMinorVersion=2, ArPatchVersion=0, SwMajorVersion=0, SwMinorVersion=0, SwPatchVersion=0, ModuleId=0, VendorId=0
  module config Return: implementation-config-variant=VARIANT-POST-BUILD
    ReturnGeneral
    CommonPublishedInformation: ArMajorVersion=3, ArMinorVersion=2, ArPatchVersion=0, SwMajorVersion=0, SwMinorVersion=0, SwPatchVersion=0, ModuleId=0, VendorId=0
  module config ReturnFirewall: implementation-config-variant=VARIANT-POST-BUILD
    ReturnFirewallGeneral
    CommonPublishedInformation: ArMajorVersion=3, ArMinorVersion=2, ArPatchVersion=0, SwMajorVersion=0, SwMinorVersion=0, SwPatchVersion=0, ModuleId=0, VendorId=0
  module config ShtdnMech: implementation-config-variant=VARIANT-POST-BUILD
    ShtdnMechGeneral
    CommonPublishedInformation: ArMajorVersion=3, ArMinorVersion=2, ArPatchVersion=0, SwMajorVersion=0, SwMinorVersion=0, SwPatchVersion=0, ModuleId=0, VendorId=0
  module config SignlCondn: implementation-config-variant=VARIANT-POST-BUILD
    SignlCondnGeneral
    CommonPublishedInformation: ArMajorVersion=3, ArMinorVersion=2, ArPatchVersion=0, SwMajorVersion=0, SwMinorVersion=0, SwPatchVersion=0, ModuleId=0, VendorId=0
  module config SpiNxt: implementation-config-variant=VARIANT-PRE-COMPILE
    SpiNxtGeneral: SpiNxtUseWith=D_SPINXT_USEWITHDIGMSB, SpiNxtUseDMA=STD_ON
  module config StabilityComp: implementation-config-variant=VARIANT-POST-BUILD
    StabilityCompGeneral
    CommonPublishedInformation: ArMajorVersion=3, ArMinorVersion=2, ArPatchVersion=0, SwMajorVersion=0, SwMinorVersion=0, SwPatchVersion=0, ModuleId=0, VendorId=0
  module config StabilityComp2: implementation-config-variant=VARIANT-POST-BUILD
    StabilityComp2General
    CommonPublishedInformation: ArMajorVersion=3, ArMinorVersion=2, ArPatchVersion=0, SwMajorVersion=0, SwMinorVersion=0, SwPatchVersion=0, ModuleId=0, VendorId=0
  module config StaMd: implementation-config-variant=VARIANT-POST-BUILD
    StaMdGeneral:
      TypeHDataSize = 100
      StaMdTODType = TOD_SteadyState
      StaMdNvMWriteAllAPI = NvMProxy_WriteAll
      StaMdNvMGetErrorStatusAPI = NvMProxy_GetErrorStatus
      StaMdTrnsDiagMgrShtDwnTaskActivation = Task_SchM_Trns_9
      GenerateExcludeOsAppRef = Ap_0
      StaMdCoreOsAppRef = Ap_10
      StaMdSComOsAppRef = Ap_9
      StaMdSysCovOsAppRef = Ap_8
    CommonPublishedInformation: ArMajorVersion=3, ArMinorVersion=2, ArPatchVersion=0, SwMajorVersion=0, SwMinorVersion=0, SwPatchVersion=0, ModuleId=0, VendorId=0
  module config StOpCtrl: implementation-config-variant=VARIANT-POST-BUILD
    StOpCtrlGeneral
    CommonPublishedInformation: ArMajorVersion=3, ArMinorVersion=2, ArPatchVersion=0, SwMajorVersion=0, SwMinorVersion=0, SwPatchVersion=0, ModuleId=0, VendorId=0
  module config Sweep: implementation-config-variant=VARIANT-POST-BUILD
    SweepGeneral
    CommonPublishedInformation: ArMajorVersion=3, ArMinorVersion=2, ArPatchVersion=0, SwMajorVersion=0, SwMinorVersion=0, SwPatchVersion=0, ModuleId=0, VendorId=0
  module config Sweep2: implementation-config-variant=VARIANT-POST-BUILD
    Sweep2General
    CommonPublishedInformation: ArMajorVersion=3, ArMinorVersion=2, ArPatchVersion=0, SwMajorVersion=0, SwMinorVersion=0, SwPatchVersion=0, ModuleId=0, VendorId=0
  module config ThrmlDutyCycle: implementation-config-variant=VARIANT-POST-BUILD
    ThrmlDutyCycleGeneral
    CommonPublishedInformation: ArMajorVersion=3, ArMinorVersion=2, ArPatchVersion=0, SwMajorVersion=0, SwMinorVersion=0, SwPatchVersion=0, ModuleId=0, VendorId=0
  module config TmprlMon: implementation-config-variant=VARIANT-POST-BUILD
    TmprlMonGeneral
    CommonPublishedInformation: ArMajorVersion=3, ArMinorVersion=2, ArPatchVersion=0, SwMajorVersion=0, SwMinorVersion=0, SwPatchVersion=0, ModuleId=0, VendorId=0
  module config TmprlMon2: implementation-config-variant=VARIANT-POST-BUILD
    TmprlMon2General
    CommonPublishedInformation: ArMajorVersion=3, ArMinorVersion=2, ArPatchVersion=0, SwMajorVersion=0, SwMinorVersion=0, SwPatchVersion=0, ModuleId=0, VendorId=0
  module config TqRsDg: implementation-config-variant=VARIANT-POST-BUILD
    TqRsDgGeneral
    CommonPublishedInformation: ArMajorVersion=3, ArMinorVersion=2, ArPatchVersion=0, SwMajorVersion=0, SwMinorVersion=0, SwPatchVersion=0, ModuleId=0, VendorId=0
  module config TrqCanc: implementation-config-variant=VARIANT-POST-BUILD
    TrqCancGeneral
    CommonPublishedInformation: ArMajorVersion=3, ArMinorVersion=2, ArPatchVersion=0, SwMajorVersion=0, SwMinorVersion=0, SwPatchVersion=0, ModuleId=0, VendorId=0

[part 1 of 4: package /ActiveEcuC]
AUTOSAR XML (schema 3.0.2)
# Copyright © Vector Informatik GmbH 2014
package /ActiveEcuC
  ecu configuration ActiveEcuC: ecu-extract=System, module=[Can, CanIf, CanSM, CanTp, Com, EcuC, PduR, ComM, Dcm, EcuM, Board, AbsHwPos, ActivePull, ApXcp, Assist, AssistFirewall, AstLmt, AvgFricLrn, BatteryVoltage, BkCpPc, BVDiag, CmMtrCurr, ComplErr, Crc, CtrldDisShtdn, CtrlTemp, CurrCmd, CurrParamComp, Damping, DampingFirewall, DiagMgr, DigHwTrqSENT, DigMSB, DigPhsReasDiag, Dio, ElePwr, EOTActuatorMng, EtDmpFw, Fee, FlsTst, FrqDepDmpnInrtCmp, Gpt, Gsod, HighFreqAssist, HiLoadStall, HwPwUp, HystComp, IoHwAb, LmtCod, LrnEOT, Mcu, MemIf, MtrDrvDiag, MtrTempEst, MtrVel, MtrVel2, NvM, NvMMgr, NvMProxy, OvrVoltMon, PeakCurrEst, PICurrCntrl, Polarity, Port, PwrLmtFuncCr, QuadDet, Return, ReturnFirewall, ShtdnMech, SignlCondn, SpiNxt, StabilityComp, StabilityComp2, StaMd, StOpCtrl, Sweep, Sweep2, ThrmlDutyCycle, TmprlMon, TmprlMon2, TqRsDg, TrqCanc, TrqCmdScl, TuningSelAuth, uDiag, VehDyn, VehPwrMd, VehSpdLmt, Wdg, WdgIf, WdgM, Os, Wdg_internal_TMS570LS3x, Rte, GenyBaseEnv, Xcp, CanXcp, Dem, Det, GenyAsrBase_Cfg, BswM, DigColPs, CanNm, Nm]
  module config Can: implementation-config-variant=VARIANT-PRE-COMPILE, module-description=Can_Impl
    CanGeneral:
      CanIndex = 0
      CanDevErrorDetection = true
      CanHardwareCancellation = false
      CanMultiplexedTransmission = false
      CanTimeoutDurationFactor = 10000
      CanVersionInfoApi = false
      CanWakeupSupport = false
      CanProdErrorDetection = true
      CanGenericPrecopy = false
      CanDevTimeoutDetect = false
      CanHardwareLoopCheck = true
      CanRxFullCANSupport = true
      CanTxFullCANSupport = true
      CanRxBasicCANSupport = true
      CanUseNestedCANInterrupts = false
      CanHardwareCancelByAppl = false
      CanPowerDownModeSelect = Local
      CanGenericConfirmation = false
      CanSupportMixedID = true
      CanHardwareHandleType = UINT8
      CanDynamicFullCANTxID = true
      CanOptimizeOneController = true
      CanErrata22Iterations = 255
      CanRamCheck = None
      CanOverrunNotification = None
      CanReinitStart = false
      CanGenericPreTransmit = false
      CanIdenticalIdCancellation = true
      CanAmdRuntimeMeasurement = false
      CanBaudrateQuartzFrequency = 80000
      CanIndividualProcessing = false
      CanInterruptLock = DRIVER
      CanInterruptCategory = CATEGORY2
      CanSecureTempBuffer = false
      CanUserConfigFile = 
      CanRxQueue = false
      CanRxQueueSize = 3
      CanMultipleBasicCANObjects = false
      CanGetStatus = false
      CanPnEnable = false
    CanConfigSet
      CCAN (CanController):
        CanControllerActivation = true
        CanControllerBaudRate = 500
        CanControllerId = 0
        CanBusoffProcessing = INTERRUPT
        CanRxProcessing = POLLING
        CanTxProcessing = INTERRUPT
        CanWakeupProcessing = INTERRUPT
        CANBaseAddress = 4294433792
        CanNumberOfBasicCANObjects = 2
        CanControllerPropSeg = 0
        CanControllerSeg1 = 13
        CanControllerSeg2 = 3
        CanControllerTimeQuanta = 0
        CanMailboxPerBasicCANObjects = 2
        CanCommonCAN = false
        CanPnControllerEnable = false
        CanWakeupSourceId = 32
        CanWakeupSourceRef = CHNL
        CanFilterMask_0 (CanFilterMask): CanFilterMaskValue=2047
        CanFilterMask_1 (CanFilterMask): CanFilterMaskValue=536870911
        InitStructure_0 (CanInitStructure): CBT0=137, CBT1=43, CBT2=0, Baudrate=500000
          Filter_0 (CanAcceptanceFilter): IsLocked=false, Mask=536608768, Code=0
          Filter_1 (CanAcceptanceFilter): IsLocked=false, Mask=536870911, Code=-2147483648
        CanFilterMask_RxFullcan (CanFilterMask): CanFilterMaskValue=0
      23 x CanHardwareObject, all with CanControllerRef=CanConfigSet/CCAN:
        CanHardwareObject_0: CanObjectId=0, CanObjectType=TRANSMIT, CanIdType=STANDARD, CanHandleType=FULL, CanIdValue=222
        CanHardwareObject_1: CanObjectId=1, CanObjectType=TRANSMIT, CanIdType=EXTENDED, CanHandleType=FULL, CanIdValue=417002544
        CanHardwareObject_2: CanObjectId=2, CanObjectType=TRANSMIT, CanIdType=STANDARD, CanHandleType=FULL, CanIdValue=1765
        CanHardwareObject_3: CanObjectId=3, CanObjectType=TRANSMIT, CanIdType=EXTENDED, CanHandleType=FULL, CanIdValue=504446978
        CanHardwareObject_4: CanObjectId=4, CanObjectType=TRANSMIT, CanIdType=EXTENDED, CanHandleType=FULL, CanIdValue=506724354
        CanHardwareObject_5: CanObjectId=5, CanObjectType=TRANSMIT, CanIdType=EXTENDED, CanHandleType=FULL, CanIdValue=506855426
        CanHardwareObject_6: CanObjectId=6, CanObjectType=TRANSMIT, CanIdType=STANDARD, CanHandleType=FULL, CanIdValue=2033
        CanHardwareObject_7: CanObjectId=7, CanObjectType=TRANSMIT, CanIdType=STANDARD, CanHandleType=BASIC, CanIdValue=0
        CanHardwareObject_8: CanObjectId=9, CanObjectType=RECEIVE, CanIdType=STANDARD, CanHandleType=FULL, CanIdValue=2032, CanFilterMaskRef=CanFilterMask_RxFullcan
        CanHardwareObject_9: CanObjectId=10, CanObjectType=RECEIVE, CanIdType=EXTENDED, CanHandleType=FULL, CanIdValue=504446976, CanFilterMaskRef=CanFilterMask_RxFullcan
        CanHardwareObject_10: CanObjectId=11, CanObjectType=RECEIVE, CanIdType=STANDARD, CanHandleType=FULL, CanIdValue=1685, CanFilterMaskRef=CanFilterMask_RxFullcan
        CanHardwareObject_11: CanObjectId=12, CanObjectType=RECEIVE, CanIdType=EXTENDED, CanHandleType=FULL, CanIdValue=417070836, CanFilterMaskRef=CanFilterMask_RxFullcan
        CanHardwareObject_12: CanObjectId=13, CanObjectType=RECEIVE, CanIdType=EXTENDED, CanHandleType=FULL, CanIdValue=416952564, CanFilterMaskRef=CanFilterMask_RxFullcan
        CanHardwareObject_13: CanObjectId=14, CanObjectType=RECEIVE, CanIdType=STANDARD, CanHandleType=FULL, CanIdValue=1204, CanFilterMaskRef=CanFilterMask_RxFullcan
        CanHardwareObject_14: CanObjectId=15, CanObjectType=RECEIVE, CanIdType=STANDARD, CanHandleType=FULL, CanIdValue=1049, CanFilterMaskRef=CanFilterMask_RxFullcan
        CanHardwareObject_15: CanObjectId=16, CanObjectType=RECEIVE, CanIdType=STANDARD, CanHandleType=FULL, CanIdValue=750, CanFilterMaskRef=CanFilterMask_RxFullcan
        CanHardwareObject_16: CanObjectId=17, CanObjectType=RECEIVE, CanIdType=STANDARD, CanHandleType=FULL, CanIdValue=250, CanFilterMaskRef=CanFilterMask_RxFullcan
        CanHardwareObject_17: CanObjectId=18, CanObjectType=RECEIVE, CanIdType=STANDARD, CanHandleType=FULL, CanIdValue=242, CanFilterMaskRef=CanFilterMask_RxFullcan
        CanHardwareObject_18: CanObjectId=19, CanObjectType=RECEIVE, CanIdType=STANDARD, CanHandleType=FULL, CanIdValue=230, CanFilterMaskRef=CanFilterMask_RxFullcan
        CanHardwareObject_19: CanObjectId=20, CanObjectType=RECEIVE, CanIdType=STANDARD, CanHandleType=BASIC, CanIdValue=0, CanFilterMaskRef=CanFilterMask_0
        CanHardwareObject_20: CanObjectId=20, CanObjectType=RECEIVE, CanIdType=STANDARD, CanHandleType=BASIC, CanIdValue=0, CanFilterMaskRef=CanFilterMask_0
        CanHardwareObject_21: CanObjectId=21, CanObjectType=RECEIVE, CanIdType=STANDARD, CanHandleType=BASIC, CanIdValue=0, CanFilterMaskRef=CanFilterMask_0
        CanHardwareObject_22: CanObjectId=21, CanObjectType=RECEIVE, CanIdType=STANDARD, CanHandleType=BASIC, CanIdValue=0, CanFilterMaskRef=CanFilterMask_0
    VectorCommonData: BswmdVersion=2.12.00
  module config CanIf: implementation-config-variant=VARIANT-PRE-COMPILE, module-description=CanIf_Impl
    CanIfPublicConfiguration:
      CanIfDevErrorDetect = false
      CanIfVersionInfoApi = false
      CanIfProdErrorDetect = true
      CanIfMultipleDriverSupport = false
      CanIfNumberOfCanHwUnits = 1
      CanIfReadRxPduDataApi = false
      CanIfReadRxPduNotifyStatusApi = false
      CanIfReadTxPduNotifyStatusApi = false
      CanIfSetDynamicTxIdApi = false
      CanIfWakeupEventApi = true
      CanIfPnWakeupTxPduFilterSupport = false
      CanIfPnTrcvHandlingSupport = false
      CanIfPublicTxConfirmPollingSupport = false
      CanIfPublicPnSupport = false
      CanIfAmdRuntimeMeasurement = false
    CanIfPrivateConfiguration:
      CanIfSoftwareFilterType = LINEAR
      CanIf_TransceiverMapping = false
      CanIf_TransceiverHandling = false
      CanIfDlcCheck = true
      CanIf_SupportExtendedIds = true
      CanIf_TransmitCancellationAPI = false
      CanIf_BusOffRecovery = false
      CanIf_ExtendedStateMachine = false
      CanIf_Autosar21_ComM_Compliance = false
      CanIf_AsrIfCan_IsLibrarySolution = false
      CanIfDlcFailedReportDem = true
      CanIf_TxBufferAPI = Bit_queue
      CanIfNumberOfTxBuffers = 0
      CanIfNumberOfDynamicTxBuffers = 0
      CanIf_UserConfigFile = 
      CanIf_SupportNmOsek = false
      CanIf_StartAddress = 0
      CanIf_MaxControllerTableSize = 0
      CanIfOptimizeOneController = true
      CanIf_DynamicTxBuffersApi = false
      CanIf_MaxNumberOfTxPDUs = 0
      CanIfDlcCheckOptimization = false
      CanIf_DoubleHashAdditionalMemory = 0
      CanIf_DoubleHashAdjustCount = 0
      CanIf_SupportConfigULPduIDCalc = true
    CanIfInitConfiguration: CanIfConfigSet=initConfiguration, CanIfNumberOfCanRxPduIds=11, CanIfNumberOfCanTXPduIds=7, CanIfNumberOfDynamicCanTXPduIds=0
      CanIfInitHohConfig: CanIfRefConfigSet=CanConfigSet
        8 x CanIfHthConfig, all with CanIfCanControllerIdRef=CanIf/CT_CCAN:
          CanIfHthConfig_{0..6}: CanIfHthType=FULL_CAN, CanIfHthIdSymRef=CanHardwareObject_{0..6}
          CanIfHthConfig_7: CanIfHthType=BASIC_CAN, CanIfHthIdSymRef=CanHardwareObject_7
        15 x CanIfHrhConfig, all with CanIfCanControllerHrhIdRef=CanIf/CT_CCAN:
          CanIfHrhConfig_{8..18}: CanIfSoftwareFilterHrh=false, CanIfHrhType=FULL_CAN, CanIfHrhIdSymRef=CanHardwareObject_{8..18}
          CanIfHrhConfig_{19..22}: CanIfSoftwareFilterHrh=true, CanIfHrhType=BASIC_CAN, CanIfHrhIdSymRef=CanHardwareObject_{19..22}
      CT_CCAN (CanIfInitControllerConfig): CanIfControllerRefConfigSet=CanConfigSet/CCAN
      3 x CanIfRxPduConfig, all with CanIfRxUserType=PDUR, CanIfUserRxIndication=PduR_CanIfRxIndication, CanIfReadRxPduData=false, CanIfReadRxPduNotifyStatus=false, CanIf_DlcCheck=true, CanIfUserDlcErrorNotification=, CanIf_FullCANLocked=true:
        BCM_COMMAND__CCAN: CanIfCanRxPduCanId=250, CanIfCanRxPduDlc=5, CanIfRxPduIdCanIdType=STANDARD_CAN, CanIfCanRxPduId=4, CanIfCanRxPduHrhRef=CanIfHrhConfig_16, PduIdRef=PduCollection/BCM_COMMAND__CCAN
        BSM1__CCAN: CanIfCanRxPduCanId=242, CanIfCanRxPduDlc=8, CanIfRxPduIdCanIdType=STANDARD_CAN, CanIfCanRxPduId=5, CanIfCanRxPduHrhRef=CanIfHrhConfig_17, PduIdRef=PduCollection/BSM1__CCAN
        CFG_DATA_CODE_REQUEST__CCAN: CanIfCanRxPduCanId=504446976, CanIfCanRxPduDlc=6, CanIfRxPduIdCanIdType=EXTENDED_CAN, CanIfCanRxPduId=0, CanIfCanRxPduHrhRef=CanIfHrhConfig_9, PduIdRef=PduCollection/CFG_DATA_CODE_REQUEST__CCAN
      CFG_DATA_CODE_RSP_EPS__CCAN (CanIfTxPduConfig):
        CanIfCanTxPduIdCanId = 504446978
        CanIfCanTxPduIdDlc = 6
        CanIfCanTxPduType = STATIC
        CanIfTxPduIdCanIdType = EXTENDED_CAN
        CanIfTxUserType = PDUR
        CanIfUserTxConfirmation = PduR_CanIfTxConfirmation
        CanIfCanTxPduId = 3
        CanIfReadTxPduNotifyStatus = false
        CanIfTxPduPnFilterPdu = false
        CanIfCanTxPduHthRef = CanIfHthConfig_3
        PduIdRef = PduCollection/CFG_DATA_CODE_RSP_EPS__CCAN
      DIAGNOSTIC_REQUEST_EPS_Tp__CCAN (CanIfRxPduConfig):
        CanIfCanRxPduCanId = 416952564
        CanIfCanRxPduDlc = 8
        CanIfRxPduIdCanIdType = EXTENDED_CAN
        CanIfRxUserType = CAN_TP
        CanIfUserRxIndication = CanTp_RxIndication
        CanIfCanRxPduId = 1
        CanIfReadRxPduData = false
        CanIfReadRxPduNotifyStatus = false
        CanIf_DlcCheck = false
        CanIfUserDlcErrorNotification = 
        CanIf_FullCANLocked = true
        CanIfCanRxPduHrhRef = CanIfHrhConfig_12
        PduIdRef = PduCollection/DIAGNOSTIC_REQUEST_EPS_Tp__CCAN_Rx
      DIAGNOSTIC_REQUEST_FUNCTIONAL_Tp__CCAN (CanIfRxPduConfig):
        CanIfCanRxPduCanId = 417070836
        CanIfCanRxPduDlc = 8
        CanIfRxPduIdCanIdType = EXTENDED_CAN
        CanIfRxUserType = CAN_TP
        CanIfUserRxIndication = CanTp_RxIndication
        CanIfCanRxPduId = 0
        CanIfReadRxPduData = false
        CanIfReadRxPduNotifyStatus = false
        CanIf_DlcCheck = false
        CanIfUserDlcErrorNotification = 
        CanIf_FullCANLocked = true
        CanIfCanRxPduHrhRef = CanIfHrhConfig_11
        PduIdRef = PduCollection/DIAGNOSTIC_REQUEST_FUNCTIONAL_Tp__CCAN_Rx
      DIAGNOSTIC_RESPONSE_EPS_Tp__CCAN (CanIfTxPduConfig):
        CanIfCanTxPduIdCanId = 417002544
        CanIfCanTxPduIdDlc = 8
        CanIfCanTxPduType = STATIC
        CanIfTxPduIdCanIdType = EXTENDED_CAN
        CanIfTxUserType = CAN_TP
        CanIfUserTxConfirmation = CanTp_TxConfirmation
        CanIfCanTxPduId = 5
        CanIfReadTxPduNotifyStatus = false
        CanIfTxPduPnFilterPdu = false
        CanIfCanTxPduHthRef = CanIfHthConfig_1
        PduIdRef = DIAGNOSTIC_RESPONSE_EPS_Tp__CCAN_Rx
      GE__CCAN (CanIfTxPduConfig):
        CanIfCanTxPduIdCanId = 222
        CanIfCanTxPduIdDlc = 6
        CanIfCanTxPduType = STATIC
        CanIfTxPduIdCanIdType = STANDARD_CAN
        CanIfTxUserType = PDUR
        CanIfUserTxConfirmation = PduR_CanIfTxConfirmation
        CanIfCanTxPduId = 6
        CanIfReadTxPduNotifyStatus = false
        CanIfTxPduPnFilterPdu = false
        CanIfCanTxPduHthRef = CanIfHthConfig_0
        PduIdRef = PduCollection/GE__CCAN
      5 x CanIfRxPduConfig, all with CanIfReadRxPduData=false, CanIfReadRxPduNotifyStatus=false, CanIf_DlcCheck=true:
        MOT1__CCAN: CanIfCanRxPduCanId=230, CanIfCanRxPduDlc=8, CanIfRxPduIdCanIdType=STANDARD_CAN, CanIfRxUserType=PDUR, CanIfUserRxIndication=PduR_CanIfRxIndication, CanIfCanRxPduId=6, CanIfUserDlcErrorNotification=, CanIf_FullCANLocked=true, CanIfCanRxPduHrhRef=CanIfHrhConfig_18, PduIdRef=PduCollection/MOT1__CCAN
        MOT3__CCAN: CanIfCanRxPduCanId=750, CanIfCanRxPduDlc=8, CanIfRxPduIdCanIdType=STANDARD_CAN, CanIfRxUserType=PDUR, CanIfUserRxIndication=PduR_CanIfRxIndication, CanIfCanRxPduId=3, CanIfUserDlcErrorNotification=, CanIf_FullCANLocked=true, CanIfCanRxPduHrhRef=CanIfHrhConfig_15, PduIdRef=PduCollection/MOT3__CCAN
        NM_BCM__CCAN: CanIfCanRxPduCanId=506724352, CanIfCanRxPduDlc=2, CanIfRxPduIdCanIdType=EXTENDED_CAN, CanIfRxUserType=CAN_NM, CanIfUserRxIndication=CanNm_RxIndication, CanIfCanRxPduId=0, CanIfCanRxPduHrhRef=CanIfHrhConfig_22, PduIdRef=PduCollection/NM_BCM__CCAN
        NM_BSM__CCAN: CanIfCanRxPduCanId=506724358, CanIfCanRxPduDlc=2, CanIfRxPduIdCanIdType=EXTENDED_CAN, CanIfRxUserType=CAN_NM, CanIfUserRxIndication=CanNm_RxIndication, CanIfCanRxPduId=0, CanIfCanRxPduHrhRef=CanIfHrhConfig_22, PduIdRef=PduCollection/NM_BSM__CCAN
        NM_ECM__CCAN: CanIfCanRxPduCanId=506724353, CanIfCanRxPduDlc=2, CanIfRxPduIdCanIdType=EXTENDED_CAN, CanIfRxUserType=CAN_NM, CanIfUserRxIndication=CanNm_RxIndication, CanIfCanRxPduId=0, CanIfCanRxPduHrhRef=CanIfHrhConfig_22, PduIdRef=PduCollection/NM_ECM__CCAN
      NM_EPS__CCAN (CanIfTxPduConfig):
        CanIfCanTxPduIdCanId = 506724354
        CanIfCanTxPduType = STATIC
        CanIfTxPduIdCanIdType = EXTENDED_CAN
        CanIfTxUserType = CAN_NM
        CanIfCanTxPduId = 2
        CanIfReadTxPduNotifyStatus = false
        CanIfTxPduPnFilterPdu = false
        CanIfUserTxConfirmation = CanNm_TxConfirmation
        CanIfCanTxPduIdDlc = 2
        CanIfCanTxPduHthRef = CanIfHthConfig_4
        PduIdRef = PduCollection/NM_EPS__CCAN
      NM_IPC__CCAN (CanIfRxPduConfig):
        CanIfCanRxPduCanId = 506724355
        CanIfCanRxPduDlc = 2
        CanIfRxPduIdCanIdType = EXTENDED_CAN
        CanIfRxUserType = CAN_NM
        CanIfUserRxIndication = CanNm_RxIndication
        CanIfCanRxPduId = 0
        CanIfReadRxPduData = false
        CanIfReadRxPduNotifyStatus = false
        CanIf_DlcCheck = true
        CanIfCanRxPduHrhRef = CanIfHrhConfig_22
        PduIdRef = PduCollection/NM_IPC__CCAN
      NM_TRANSMISSION__CCAN (CanIfRxPduConfig):
        CanIfCanRxPduCanId = 506724363
        CanIfCanRxPduDlc = 2
        CanIfRxPduIdCanIdType = EXTENDED_CAN
        CanIfRxUserType = CAN_NM
        CanIfUserRxIndication = CanNm_RxIndication
        CanIfCanRxPduId = 0
        CanIfReadRxPduData = false
        CanIfReadRxPduNotifyStatus = false
        CanIf_DlcCheck = true
        CanIfCanRxPduHrhRef = CanIfHrhConfig_22
        PduIdRef = PduCollection/NM_TRANSMISSION__CCAN
      PDC_INFO_EPS__CCAN (CanIfTxPduConfig):
        CanIfCanTxPduIdCanId = 506855426
        CanIfCanTxPduIdDlc = 3
        CanIfCanTxPduType = STATIC
        CanIfTxPduIdCanIdType = EXTENDED_CAN
        CanIfTxUserType = PDUR
        CanIfUserTxConfirmation = PduR_CanIfTxConfirmation
        CanIfCanTxPduId = 1
        CanIfReadTxPduNotifyStatus = false
        CanIfTxPduPnFilterPdu = false
        CanIfCanTxPduHthRef = CanIfHthConfig_5
        PduIdRef = PduCollection/PDC_INFO_EPS__CCAN
      3 x CanIfRxPduConfig, all with CanIfRxPduIdCanIdType=STANDARD_CAN, CanIfReadRxPduData=false, CanIfReadRxPduNotifyStatus=false, CanIf_DlcCheck=true, CanIfUserDlcErrorNotification=, CanIf_FullCANLocked=true:
        STATUS_C_BCM2__CCAN: CanIfCanRxPduCanId=1204, CanIfCanRxPduDlc=5, CanIfRxUserType=PDUR, CanIfUserRxIndication=PduR_CanIfRxIndication, CanIfCanRxPduId=1, CanIfCanRxPduHrhRef=CanIfHrhConfig_13, PduIdRef=PduCollection/STATUS_C_BCM2__CCAN
        STATUS_C_IPC__CCAN: CanIfCanRxPduCanId=1049, CanIfCanRxPduDlc=8, CanIfRxUserType=PDUR, CanIfUserRxIndication=PduR_CanIfRxIndication, CanIfCanRxPduId=2, CanIfCanRxPduHrhRef=CanIfHrhConfig_14, PduIdRef=PduCollection/STATUS_C_IPC__CCAN
        GliwaMaster__CCAN: CanIfCanRxPduCanId=2032, CanIfCanRxPduDlc=8, CanIfRxUserType=APPL, CanIfCanRxPduId=0, CanIfUserRxIndication=GliwaT1_MsgProcess_RxT1HostToTarget, CanIfCanRxPduHrhRef=CanIfHrhConfig_8, PduIdRef=PduCollection/GliwaMaster__CCAN
      GliwaSlave__CCAN (CanIfTxPduConfig):
        CanIfCanTxPduIdCanId = 2033
        CanIfCanTxPduIdDlc = 8
        CanIfCanTxPduType = STATIC
        CanIfTxPduIdCanIdType = STANDARD_CAN
        CanIfTxUserType = APPL
        CanIfCanTxPduId = 0
        CanIfReadTxPduNotifyStatus = false
        CanIfTxPduPnFilterPdu = false
        CanIfCanTxPduHthRef = CanIfHthConfig_6
        PduIdRef = PduCollection/GliwaSlave__CCAN
      XcpMaster__CCAN (CanIfRxPduConfig):
        CanIfCanRxPduCanId = 1685
        CanIfCanRxPduDlc = 8
        CanIfRxPduIdCanIdType = STANDARD_CAN
        CanIfRxUserType = APPL
        CanIfCanRxPduId = 0
        CanIfReadRxPduData = false
        CanIfReadRxPduNotifyStatus = false
        CanIfUserRxIndication = CanXcp_RxIndication
        CanIf_DlcCheck = true
        CanIfUserDlcErrorNotification = 
        CanIf_FullCANLocked = true
        CanIfCanRxPduHrhRef = CanIfHrhConfig_10
        PduIdRef = PduCollection/XcpMaster__CCAN
      XcpSlave__CCAN (CanIfTxPduConfig):
        CanIfCanTxPduIdCanId = 1765
        CanIfCanTxPduIdDlc = 8
        CanIfCanTxPduType = STATIC
        CanIfTxPduIdCanIdType = STANDARD_CAN
        CanIfTxUserType = APPL
        CanIfCanTxPduId = 4
        CanIfReadTxPduNotifyStatus = false
        CanIfTxPduPnFilterPdu = false
        CanIfUserTxConfirmation = CanXcp_TxConfirmation
        CanIfCanTxPduHthRef = CanIfHthConfig_2
        PduIdRef = PduCollection/XcpSlave__CCAN
      RangeConfig_Ch_CCAN_Nr_0 (CanIf_RangeConfig):
        CanIf_UserRxIndication = CanNm_RxIndication
        CanIf_RangeConfigMask = 536870656
        CanIf_RangeConfigCode = 506724352
        CanIf_RangeConfigExtendedIds = true
        CanIf_RangeConfigDisableDlcCheck = false
        CanIf_RangeConfigMinimumDLC = 2
        CanIf_RangeRxPduId = 0
        CanIf_RangeConfigHandledByGeny = true
        CanIf_RangeConfigHrhRef = CanIfHrhConfig_22
    CanIfDriverConfig:
      CanIfTransmitCancellation = false
      CanIfBusoffNotification = true
      CanIfReceiveIndication = true
      CanIfTxConfirmation = true
      CanIfWakeupNotification = true
      CanIfDriverNameRef = CanGeneral
      CanIfInitHohConfigRef = CanIfInitHohConfig
    CT_CCAN (CanIfControllerConfig):
      CanIfWakeupSupport = CONTROLLER
      CanIfChPnWuTxPduFilterSupport = false
      CanIf_DoubleHashRandom1 = 0
      CanIf_DoubleHashRandom2 = 0
      CanIfControllerIdRef = CanConfigSet/CCAN
      CanIfDriverNameRef = CanIfDriverConfig
      CanIfInitControllerRef = CanIfInitConfiguration/CT_CCAN
    CanIfDispatchConfig:
      CanIfBusOffNotification = CanSM_ControllerBusOff
      CanIfWakeupNotification = EcuM_SetWakeupEvent
      CanIfWakeupValidNotification = CanIfWakeupValidNotification
    VectorCommonData: BswmdVersion=2.23.01
    5 x CanIf_TxConfirmationFunction:
      CanIf_TxConfirmationFunction_0: CanIf_TxConfirmationFunctionName=NULL_PTR
      CanIf_TxConfirmationFunction_1: CanIf_TxConfirmationFunctionName=CanNm_TxConfirmation
      CanIf_TxConfirmationFunction_2: CanIf_TxConfirmationFunctionName=CanTp_TxConfirmation
      CanIf_TxConfirmationFunction_3: CanIf_TxConfirmationFunctionName=PduR_CanIfTxConfirmation
      CanIf_TxConfirmationFunction_4: CanIf_TxConfirmationFunctionName=CanXcp_TxConfirmation
    6 x CanIf_RxIndicationFunction:
      CanIf_RxIndicationFunction_0: CanIf_RxIndicationFunctionType=TYPE_I_STANDARD, CanIf_AutoCalculateRxPduIds=true, CanIf_RxIndicationFunctionName=NULL_PTR
      CanIf_RxIndicationFunction_1: CanIf_RxIndicationFunctionType=TYPE_II_ADVANCED, CanIf_AutoCalculateRxPduIds=true, CanIf_RxIndicationFunctionName=CanNm_RxIndication
      CanIf_RxIndicationFunction_2: CanIf_RxIndicationFunctionType=TYPE_II_ADVANCED, CanIf_AutoCalculateRxPduIds=false, CanIf_RxIndicationFunctionName=CanTp_RxIndication
      CanIf_RxIndicationFunction_3: CanIf_RxIndicationFunctionType=TYPE_II_ADVANCED, CanIf_AutoCalculateRxPduIds=true, CanIf_RxIndicationFunctionName=PduR_CanIfRxIndication
      CanIf_RxIndicationFunction_4: CanIf_RxIndicationFunctionType=TYPE_I_STANDARD, CanIf_AutoCalculateRxPduIds=true, CanIf_RxIndicationFunctionName=CanXcp_RxIndication
      CanIf_RxIndicationFunction_5: CanIf_RxIndicationFunctionType=TYPE_I_STANDARD, CanIf_AutoCalculateRxPduIds=true, CanIf_RxIndicationFunctionName=GliwaT1_MsgProcess_RxT1HostToTarget
    TrcvConfig_CCAN (CanIfTransceiverDrvConfig): CanIfTrcvWakeupNotification=false
  module config CanSM: implementation-config-variant=VARIANT-PRE-COMPILE, module-description=CanSM_Impl
    CanStateManagerConfiguration:
      CanSMBusOffNotification = true
      CanSMBswMComModeIndication = true
      CanSMDisableDMInSilentCom = false
      CanSMBorCounterL1ToL2 = 5
      CanSMBorCounterL2Err = 8
      CanSMBorDisableRxDlMonitoring = false
      CanSMBorTimeL1 = 1
      CanSMBorTimeL2 = 3
      CanSMBorTimeTxEnsured = 5
      CanSMDevErrorDetect = true
      CanSMProdErrorDetect = true
      CanSMMainFctCycleTime = 0.01
      CanSMVersionInfoApi = false
      CanSMPostBuildConfigStartAddress = 0
      CanSMHwRepetition = 5
      CanSMEcuPassiveMode = false
      CanSMPartialNetwork = false
      CanSMBorTxConfirmationGlobal = false
      CanSMIndicationTimeOut = 0.05
      CanSMAmdRuntimeMeasurement = false
      CanSMUserConfigurationFile = 
      CCAN (CanStateManagerNetworks):
        CanSMBorTimeL1Ch = 0.05
        CanSMBorTimeL2Ch = 1
        CanSMDisableRxPduGroup = true
        CanSMDisableTxPduGroup = true
        CanSMBorCounterL1ToL2Ch = 20
        CanSMBorTimeTxEnsuredCh = 5
        CanSMBorDisableRxDlMonitoringCh = false
        CanSMInitializeTxPduData = false
        CanSMInitializeRxPduData = false
        CanSMBorTxConfirmationPolling = false
        CanSMTransceiverPnSupport = false
        CanSMNetworkHandle = ComM/CCAN
        CanSMRxPduGroupId = PduGrp_EPS__CCAN_Rx
        CanSMTxPduGroupId = PduGrp_EPS__CCAN_Tx
        CanSMTransceiverId = (unset)
        CT_CCAN (CanStateManagerControllers): CanSMControllerId=CanConfigSet/CCAN
    VectorCommonData: BswmdVersion=1.18.00
  module config CanTp: implementation-config-variant=VARIANT-PRE-COMPILE, module-description=CanTp_Impl
    CanTpGeneral:
      CanTpVersionInfoApi = false
      CanTpOptimizeSingleConnection = true
      CanTpProdErrorDetect = true
      CanTpFFProvide2RxBufferCalls = false
      CanTpEnableRxNSduIdRemapping = false
      CanTpEnableTxNSduIdRemapping = false
      CanTpEnableAr40CompliantPduRApi = false
      CanTpEnableExtendedApiSTMin = false
      CanTpRc = false
      CanTpTc = false
      CanTpHavePaddingByte = true
      CanTpSupportMixed11Addressing = false
      CanTpSupportStandardAddressing = true
      CanTpSupportExtendedAddressing = false
      CanTpPaddingPattern = 0
      CanTpTcNotifyAlways = false
      CanTpRcNotifyAlways = false
      CanTpChangeParameterReqApi = false
      CanTpEnableExtendedApiBs = (unset)
      CanTpSupportFullBufferHandlingRx = true
      CanTpSupportFullBufferHandlingTx = true
      CanTpDynamicChannelAssignment = false
      CanTpSuppressPrePassIndication = false
      CanTpExtErrorDetect = false
      CanTpHasTxConfirmation = true
      CanTpStrictRxCallSeq = false
      CanTpPaddingActive = true
      CanTpDevErrorDetect = false
      CanTpMainFunctionPeriod = 0.010000000474974513
      CanTpMaxNumRxSdus = 1
      CanTpMaxNumTxSdus = 1
      CanTpPostbuildStartAddress = 0
      CanTpAmdRuntimeMeasurement = false
      CanTpMaxNumRxChannels = 0
      CanTpMaxNumRxChannels_PbLimit = 0
      CanTpMaxNumTxChannels = 0
      CanTpMaxNumTxChannels_PbLimit = 0
      CanTpOptimizeSingleConnPrec = true
      CanTpEnableSplitMainFunction = false
      CanTpHasRxIndication = true
      CanTpHasInitCfgPtr = false
      CanTpOperNotSupportedReportDem = false
      CanTpECommReportDem = true
      CanTpIgnoreFcWithReservedStMin = false
      CanTpIgnoreFcOvflAndInvalidFS = false
      CanTpIgnoreCfWithWrongSN = false
      CanTpEnableDcmRequestDetect = false
      CanTpEnableSynchronousTransmit = true
      CanTpEnableConstantBS = false
      CanTpUseOnlyFirstFc = false
      CanTpSuppressCancelErrorWhenIdle = false
      CanTpSuppressInvalidBufferFcOvfl = false
      CanTpSupportLowLevelRouting = false
      CanTpGwErrorsReportDem = false
      CanTpUserConfigFile = 
      CanTpLowLevelRoutingPrefix = Cdd
    CanTpConfigSet:
      CanTpActiveRxNSduRef = CanTp/DIAGNOSTIC_REQUEST_FUNCTIONAL__CCAN
      CanTpActiveRxNSduRef = DIAGNOSTIC_REQUEST_EPS__CCAN_EPS
      CanTpActiveTxNSduRef = CanTp/DIAGNOSTIC_RESPONSE_EPS__CCAN
    DIAGNOSTIC_REQUEST_FUNCTIONAL__CCAN (CanTpRxNSdu):
      CanTpAddressingFormat = CANTP_STANDARD
      CanTpRxTaType = CANTP_FUNCTIONAL
      CanTpNar = 0.02500000037252903
      CanTpRxPaddingActivation = CANTP_ON
      CanTpNcr = 0.15000000596046448
      CanTpBs = 0
      CanTpSTmin = 0
      CanTpNbr = 0.15000000596046448
      CanTpRxChannel = 0
      CanTpRxDl = 8
      CanTpRxWftMax = 15
      CanTpCreatedByTool = false
      CanTpRxNSduRef = PduCollection/DIAGNOSTIC_REQUEST_FUNCTIONAL__CCAN
      DIAGNOSTIC_REQUEST_FUNCTIONAL_Tp__CCAN_Rx (CanTpRxNPdu): CanTpRxNPduId=0, CanTpRxNPduRef=PduCollection/DIAGNOSTIC_REQUEST_FUNCTIONAL_Tp__CCAN_Rx
      CanTpTxFcNPdu: CanTpTxFcNPduRef=(unset)
    DIAGNOSTIC_RESPONSE_EPS__CCAN (CanTpTxNSdu):
      CanTpAddressingMode = CANTP_STANDARD
      CanTpTxNSduId = 0
      CanTpTxTaType = CANTP_PHYSICAL
      CanTpNas = 0.025000001187436283
      CanTpNbs = 0.075000003562308848
      CanTpTxPaddingActivation = CANTP_ON
      CanTpNcs = 0.1500000071246177
      CanTpTxChannel = 0
      CanTpTxDl = 8
      CanTpCreatedByTool = false
      CanTpTxUpperLayerNSduId = 0
      CanTpTxTc = true
      CanTpTxNSduRef = PduCollection/DIAGNOSTIC_RESPONSE_EPS__CCAN
      DIAGNOSTIC_RESPONSE_EPS_Tp__CCAN_0 (CanTpTxNPdu): CanTpTxNPduRef=DIAGNOSTIC_RESPONSE_EPS_Tp__CCAN_Rx
      DIAGNOSTIC_REQUEST_EPS_Tp__CCAN_Rx (CanTpRxFcNPdu): CanTpRxFcNPduId=1, CanTpRxFcNPduRef=PduCollection/DIAGNOSTIC_REQUEST_EPS_Tp__CCAN_Rx
      CanTpNTa: CanTpNTa=(unset)
      CanTpNSa: CanTpNSa=(unset)
    DIAGNOSTIC_REQUEST_EPS__CCAN_EPS (CanTpRxNSdu):
      CanTpAddressingFormat = CANTP_STANDARD
      CanTpRxTaType = CANTP_PHYSICAL
      CanTpNar = 0.02500000037252903
      CanTpRxPaddingActivation = CANTP_ON
      CanTpNcr = 0.15000000596046448
      CanTpBs = 0
      CanTpSTmin = 0
      CanTpNbr = 0.15000000596046448
      CanTpRxChannel = 0
      CanTpRxDl = 8
      CanTpRxWftMax = 15
      CanTpCreatedByTool = false
      CanTpRxNSduRef = PduCollection/DIAGNOSTIC_REQUEST_EPS__CCAN
      DIAGNOSTIC_REQUEST_EPS_Tp__CCAN_Rx_1 (CanTpRxNPdu): CanTpRxNPduId=1, CanTpRxNPduRef=PduCollection/DIAGNOSTIC_REQUEST_EPS_Tp__CCAN_Rx
      DIAGNOSTIC_REQUEST_EPS_Tp__CCAN_1 (CanTpTxFcNPdu): CanTpTxFcNPduRef=DIAGNOSTIC_RESPONSE_EPS_Tp__CCAN_Rx
    VectorCommonData: BswmdVersion=1.25.00
    CanTp_Channel_0 (CanTpChannel): CanTpChannelMode=CANTP_MODE_FULL_DUPLEX, CanTpRxNSduRef=CanTp/DIAGNOSTIC_REQUEST_FUNCTIONAL__CCAN, CanTpTxNSduRef=(unset)
    CanTp_Channel_1 (CanTpChannel): CanTpChannelMode=CANTP_MODE_FULL_DUPLEX, CanTpRxNSduRef=DIAGNOSTIC_REQUEST_EPS__CCAN_EPS, CanTpTxNSduRef=CanTp/DIAGNOSTIC_RESPONSE_EPS__CCAN
  module config Com: implementation-config-variant=VARIANT-PRE-COMPILE, module-description=Com_Impl
    ComGeneral:
      ComConfigurationTimeBase = 0.001
      ComUseRte = false
      ComConfigurationUseDet = false
      ComVersionInfoApi = false
      ComConfigurationUseDem = true
      ComConfigurationString = 
      ComTriggerIPDUSendApi = false
      ComEnableStateOnFlags = false
      ComGwCanMost = false
      ComIsLibrary = false
      ComEnableRx = true
      ComEnableTx = true
      ComTmsSupport = true
      ComGw03ConsistencyCheck = true
      ComMainFunctionTxApi = true
      ComMainFunctionRxApi = true
      ComShowError0005AsWarning = true
      ComEnableLoTxConfirmation = true
      ComGetConfigurationStringPtrApi = false
      ComIPduGroupTransmit = false
      ComSignalConversionInterface = false
      ComEnableIndicationFlags = false
      ComEnableTimeoutFlags = false
      ComTransportProtocolSupport = false
      ComMissingSourceValueHandling = false
      ComTsiTestCode = false
      ComRxSignalWriteAccess = false
      ComOptimizeIdTypes = true
      ComEnableSignalInterface = true
      ComVStdLibMemApi = true
      ComGwStopTxOnRxTimeout = false
      ComGwInvalidateTxOnRxTimeout = false
      ComGwTriggerTxOnInvalidation = false
      ComMultipleIPduGroupRefSupport = true
      ComGetStatusApi = true
      ComQueueFailedTransmitRequests = true
      ComSignalAccessMacroApi = true
      ComGetConfigurationIdApi = false
      ComTxTimeoutForTxModeNoneSupport = false
      ComSignalInvalidationApi = true
      ComTriggerTransmissionByCom = true
      ComEnableReceptionFiltering = true
      ComReceptionDMApi = true
      ComEnableSignalGroupInterface = true
      ComEnableUpdateBitSupport = true
      ComDynamicDlcSupport = false
      ComPBStartAddress = 0
      ComMaxNumberOfRxIPdus = 1
      ComMaxNumberOfTxIPdus = 1
      ComMaxNumberOfRxUpdateBits = 1
      ComBufferSize = 0
      ComMaxNumberOfTxSignalGroups = 1
      ComConfigurationRxTimeBase = 0.01
      ComConfigurationTxTimeBase = 0.01
      ComUserConfigFile = 
      ComTriggerTransmitApi = true
      ComDeInitApi = true
      ComGwSuspendIsrPerPdu = false
      ComLargeSignalSupport = false
      ComLargeComIPdus = false
      ComProtectTimeoutFlags = true
      ComProtectIndicationFlags = true
      ComMaxRxIPduLength = 8
      ComResetTimeoutFlags = false
      ComEnableIndicationFlagOnRxTimeout = false
      ComGwRxDlMonBasedCyclicRouting = false
      ComGwImmediateRouting = false
      ComGwEnableDlcRouting = false
      ComAmdRuntimeMeasurement = false
      ComNotiFctRxPrefix = Appl_COMCbk_
      ComNotiFctTxPrefix = Appl_COMCbkTAck_
      ComTimeoutNotiFctRxPrefix = Appl_COMCbkTOut_
      ComInvalidNotiFctRxPrefix = Appl_COMCbkInv_
      ComErrorNotiFctTxPrefix = Appl_COMCbkTErr_
      ComIpduCalloutFctPrefix = Appl_COMCout_
      ComIndicationFlagPostfix = IndicationFlag
      ComTimeoutFlagPostfix = TimeoutFlag
      ComStateOnFlagPostfix = StateOnFlag
      ComTimeoutNotiFctTxPrefix = Appl_COMCbkTOut_
    ComConfig: ComConfigurationId=0
      PduGrp_EPS__CCAN_Rx (ComIPduGroup): ComIPduGroupHandleId=0
      PduGrp_EPS__CCAN_Tx (ComIPduGroup): ComIPduGroupHandleId=1
      10 x ComIPdu, all with ComIPduSignalProcessing=DEFERED, ComGenerate=true:
        Pdu_BCM_COMMAND__CCAN: ComIpduDirection=RECEIVE, ComIPduRxHandleId=0, ComIPduSize=5, ComGwRouteDlc=false, ComIPduGroupRef=PduGrp_EPS__CCAN_Rx, ComIPduSignalRef=Com_OperationalModeSts__BCM_COMMAND__CCAN, PduIdRef=PduCollection/BCM_COMMAND__CCAN
        Pdu_BSM1__CCAN: ComIpduDirection=RECEIVE, ComIPduRxHandleId=1, ComIPduSize=8, ComGwRouteDlc=false, ComIPduGroupRef=PduGrp_EPS__CCAN_Rx, ComIPduSignalRef=Com_VehicleSpeedVSOSig__BSM1__CCAN, ComIPduSignalRef=Com_VehicleSpeedVSOSigFailSts__BSM1__CCAN, ComIPduSignalRef=Com_MessageCounter_B1__BSM1__CCAN, ComIPduSignalRef=Com_CRC_B1__BSM1__CCAN, PduIdRef=PduCollection/BSM1__CCAN
        Pdu_CFG_DATA_CODE_REQUEST__CCAN: ComIpduDirection=RECEIVE, ComIPduRxHandleId=2, ComIPduSize=6, ComGwRouteDlc=false, ComIPduGroupRef=PduGrp_EPS__CCAN_Rx, ComIPduSignalRef=Com_Digit_10__CFG_DATA_CODE_REQUEST__CCAN, ComIPduSignalRef=Com_Digit_11__CFG_DATA_CODE_REQUEST__CCAN, ComIPduSignalRef=Com_Digit_08__CFG_DATA_CODE_REQUEST__CCAN, ComIPduSignalRef=Com_Digit_09__CFG_DATA_CODE_REQUEST__CCAN, ComIPduSignalRef=Com_Digit_06__CFG_DATA_CODE_REQUEST__CCAN, ComIPduSignalRef=Com_Digit_07__CFG_DATA_CODE_REQUEST__CCAN, ComIPduSignalRef=Com_Digit_04__CFG_DATA_CODE_REQUEST__CCAN, ComIPduSignalRef=Com_Digit_05__CFG_DATA_CODE_REQUEST__CCAN, ComIPduSignalRef=Com_Digit_02__CFG_DATA_CODE_REQUEST__CCAN, ComIPduSignalRef=Com_Digit_03__CFG_DATA_CODE_REQUEST__CCAN, ComIPduSignalRef=Com_Digit_01__CFG_DATA_CODE_REQUEST__CCAN, PduIdRef=PduCollection/CFG_DATA_CODE_REQUEST__CCAN
        Pdu_CFG_DATA_CODE_RSP_EPS__CCAN: ComIpduDirection=SEND, ComIPduSize=6, ComIPduGroupRef=PduGrp_EPS__CCAN_Tx, ComIPduSignalRef=Com_Digit_10_EPS__CFG_DATA_CODE_RSP_EPS__CCAN, ComIPduSignalRef=Com_Digit_11_EPS__CFG_DATA_CODE_RSP_EPS__CCAN, ComIPduSignalRef=Com_Digit_08_EPS__CFG_DATA_CODE_RSP_EPS__CCAN, ComIPduSignalRef=Com_Digit_09_EPS__CFG_DATA_CODE_RSP_EPS__CCAN, ComIPduSignalRef=Com_Digit_06_EPS__CFG_DATA_CODE_RSP_EPS__CCAN, ComIPduSignalRef=Com_Digit_07_EPS__CFG_DATA_CODE_RSP_EPS__CCAN, ComIPduSignalRef=Com_Digit_04_EPS__CFG_DATA_CODE_RSP_EPS__CCAN, ComIPduSignalRef=Com_Digit_05_EPS__CFG_DATA_CODE_RSP_EPS__CCAN, ComIPduSignalRef=Com_Digit_02_EPS__CFG_DATA_CODE_RSP_EPS__CCAN, ComIPduSignalRef=Com_Digit_03_EPS__CFG_DATA_CODE_RSP_EPS__CCAN, ComIPduSignalRef=Com_Digit_01_EPS__CFG_DATA_CODE_RSP_EPS__CCAN, PduIdRef=PduCollection/CFG_DATA_CODE_RSP_EPS__CCAN
          ComTxIPdu: ComTxIPduMinimumDelayTimeFactor=0, ComTxIPduUnusedAreasDefault=0, ComTxIPduTimeoutContext=COM_TRANSMIT, ComTxIPduClearUpdateBit=Transmit
            ComTxModeTrue
              ComTxModeTrueTrue (ComTxMode): ComTxModeMode=DIRECT, ComTxModeNumberOfRepetitions=0, ComTxModeRepetitionPeriodFactor=0, ComTxModeTimePeriodFactor=0, ComTxModeTimeOffsetFactor=0
            ComTxModeFalse
              ComTxModeFalseFalse (ComTxMode): ComTxModeMode=DIRECT, ComTxModeNumberOfRepetitions=0, ComTxModeRepetitionPeriodFactor=0, ComTxModeTimePeriodFactor=0, ComTxModeTimeOffsetFactor=0
        Pdu_GE__CCAN: ComIpduDirection=SEND, ComIPduSize=6, ComIPduGroupRef=PduGrp_EPS__CCAN_Tx, ComIPduSignalRef=Com_LwsAngle__GE__CCAN, ComIPduSignalRef=Com_LwsSpeed__GE__CCAN, ComIPduSignalRef=Com_SteeringLoad__GE__CCAN, ComIPduSignalRef=Com_LwsAngleType__GE__CCAN, ComIPduSignalRef=Com_LwsCalibration__GE__CCAN, ComIPduSignalRef=Com_LWSFailSts__GE__CCAN, ComIPduSignalRef=Com_ElectricSteeringFailSts__GE__CCAN, PduIdRef=PduCollection/GE__CCAN
          ComTxIPdu: ComTxIPduMinimumDelayTimeFactor=0, ComTxIPduUnusedAreasDefault=0, ComTxIPduTimeoutContext=COM_TRANSMIT, ComTxIPduClearUpdateBit=Transmit
            ComTxModeTrue
              ComTxModeTrueTrue (ComTxMode): ComTxModeMode=PERIODIC, ComTxModeTimeOffsetFactor=0, ComTxModeTimePeriodFactor=10, ComTxModeRepetitionPeriodFactor=0, ComTxModeNumberOfRepetitions=0
            ComTxModeFalse
              ComTxModeFalseFalse (ComTxMode): ComTxModeMode=PERIODIC, ComTxModeTimeOffsetFactor=0, ComTxModeTimePeriodFactor=10, ComTxModeRepetitionPeriodFactor=0, ComTxModeNumberOfRepetitions=0
        Pdu_MOT1__CCAN: ComIpduDirection=RECEIVE, ComIPduRxHandleId=3, ComIPduSize=8, ComGwRouteDlc=false, ComIPduGroupRef=PduGrp_EPS__CCAN_Rx, ComIPduSignalRef=Com_EngineSts__MOT1__CCAN, PduIdRef=PduCollection/MOT1__CCAN
        Pdu_MOT3__CCAN: ComIpduDirection=RECEIVE, ComIPduRxHandleId=4, ComIPduSize=8, ComGwRouteDlc=false, ComIPduGroupRef=PduGrp_EPS__CCAN_Rx, ComIPduSignalRef=Com_EngineStopStartSts__MOT3__CCAN, ComIPduSignalRef=Com_StopStartSts__MOT3__CCAN, PduIdRef=PduCollection/MOT3__CCAN
        Pdu_PDC_INFO_EPS__CCAN: ComIpduDirection=SEND, ComIPduSize=3, ComIPduGroupRef=PduGrp_EPS__CCAN_Tx, ComIPduSignalRef=Com_Reserved_for_PDC_EPS__PDC_INFO_EPS__CCAN, ComIPduSignalRef=Com_DES_EPS__PDC_INFO_EPS__CCAN, ComIPduSignalRef=Com_GenericFailSts_EPS__PDC_INFO_EPS__CCAN, ComIPduSignalRef=Com_CurrentFailSts_EPS__PDC_INFO_EPS__CCAN, ComIPduSignalRef=Com_EOL_EPS__PDC_INFO_EPS__CCAN, ComIPduSignalRef=Com_StayActiveSource_EPS_7__PDC_INFO_EPS__CCAN, ComIPduSignalRef=Com_StayActiveSource_EPS_6__PDC_INFO_EPS__CCAN, ComIPduSignalRef=Com_StayActiveSource_EPS_5__PDC_INFO_EPS__CCAN, ComIPduSignalRef=Com_StayActiveSource_EPS_4__PDC_INFO_EPS__CCAN, ComIPduSignalRef=Com_StayActiveSource_EPS_3__PDC_INFO_EPS__CCAN, ComIPduSignalRef=Com_StayActiveSource_EPS_2__PDC_INFO_EPS__CCAN, ComIPduSignalRef=Com_StayActiveSource_EPS_1__PDC_INFO_EPS__CCAN, ComIPduSignalRef=Com_StayActiveSource_EPS_0__PDC_INFO_EPS__CCAN, ComIPduSignalRef=Com_StayActiveSource_EPS_15__PDC_INFO_EPS__CCAN, ComIPduSignalRef=Com_StayActiveSource_EPS_14__PDC_INFO_EPS__CCAN, ComIPduSignalRef=Com_StayActiveSource_EPS_13__PDC_INFO_EPS__CCAN, ComIPduSignalRef=Com_StayActiveSource_EPS_12__PDC_INFO_EPS__CCAN, ComIPduSignalRef=Com_StayActiveSource_EPS_11__PDC_INFO_EPS__CCAN, ComIPduSignalRef=Com_StayActiveSource_EPS_10__PDC_INFO_EPS__CCAN, ComIPduSignalRef=Com_StayActiveSource_EPS_9__PDC_INFO_EPS__CCAN, ComIPduSignalRef=Com_StayActiveSource_EPS_8__PDC_INFO_EPS__CCAN, PduIdRef=PduCollection/PDC_INFO_EPS__CCAN
          ComTxIPdu: ComTxIPduMinimumDelayTimeFactor=0, ComTxIPduUnusedAreasDefault=0, ComTxIPduTimeoutContext=COM_TRANSMIT, ComTxIPduClearUpdateBit=Transmit
            ComTxModeTrue
              ComTxModeTrueTrue (ComTxMode):
                ComTxModeMode = PERIODIC
                ComTxModeTimeOffsetFactor = 0
                ComTxModeTimePeriodFactor = 1000
                ComTxModeRepetitionPeriodFactor = 0
                ComTxModeNumberOfRepetitions = 0
            ComTxModeFalse
              ComTxModeFalseFalse (ComTxMode):
                ComTxModeMode = PERIODIC
                ComTxModeTimeOffsetFactor = 0
                ComTxModeTimePeriodFactor = 1000
                ComTxModeRepetitionPeriodFactor = 0
                ComTxModeNumberOfRepetitions = 0
        Pdu_STATUS_C_BCM2__CCAN: ComIpduDirection=RECEIVE, ComIPduRxHandleId=5, ComIPduSize=5, ComGwRouteDlc=false, ComIPduGroupRef=PduGrp_EPS__CCAN_Rx, ComIPduSignalRef=Com_CmdIgn_FailSts__STATUS_C_BCM2__CCAN, ComIPduSignalRef=Com_CmdIgnSts__STATUS_C_BCM2__CCAN, ComIPduSignalRef=Com_CityModeSts__STATUS_C_BCM2__CCAN, PduIdRef=PduCollection/STATUS_C_BCM2__CCAN
        Pdu_STATUS_C_IPC__CCAN: ComIpduDirection=RECEIVE, ComIPduRxHandleId=6, ComIPduSize=8, ComGwRouteDlc=false, ComIPduGroupRef=PduGrp_EPS__CCAN_Rx, ComIPduSignalRef=Com_ElectricSteeringLamp_FailSts__STATUS_C_IPC__CCAN, PduIdRef=PduCollection/STATUS_C_IPC__CCAN, ComIPduSignalRef=Com_TotalOdometer__STATUS_C_IPC__CCAN
      63 x ComSignal, all with ComSignalEndianess=BIG_ENDIAN, ComIssmSignal=false, ComInternal=false:
        Com_OperationalModeSts__BCM_COMMAND__CCAN: ComBitPosition=7, ComBitSize=4, ComHandleId=19, ComSignalDataInvalidValue=15, ComSignalInitValue=0, ComSignalType=UINT8, ComTimeoutFactor=2500, ComTransferProperty=PENDING, ComRxDataTimeoutAction=NONE, ComFirstTimeoutFactor=0, ComNotificationFlag=false, ComTimeoutNotificationFlag=false, ComStateOnFlag=false, ComNotification=Appl_COMCbk_Com_OperationalModeSts__BCM_COMMAND__CCAN, SystemTemplateSystemSignalRef=OperationalModeSts
        Com_VehicleSpeedVSOSig__BSM1__CCAN: ComBitPosition=7, ComBitSize=13, ComHandleId=23, ComSignalDataInvalidValue=8191, ComSignalInitValue=0, ComSignalType=UINT16, ComTimeoutFactor=2500, ComTransferProperty=PENDING, ComRxDataTimeoutAction=NONE, ComFirstTimeoutFactor=0, ComNotificationFlag=false, ComTimeoutNotificationFlag=false, ComStateOnFlag=false, ComNotification=Appl_COMCbk_Com_VehicleSpeedVSOSig__BSM1__CCAN, SystemTemplateSystemSignalRef=VehicleSpeedVSOSig
        Com_VehicleSpeedVSOSigFailSts__BSM1__CCAN: ComBitPosition=10, ComBitSize=1, ComHandleId=22, ComSignalInitValue=0, ComSignalType=BOOLEAN, ComTimeoutFactor=2500, ComTransferProperty=PENDING, ComRxDataTimeoutAction=NONE, ComFirstTimeoutFactor=0, ComNotificationFlag=false, ComTimeoutNotificationFlag=false, ComStateOnFlag=false, ComNotification=Appl_COMCbk_Com_VehicleSpeedVSOSigFailSts__BSM1__CCAN, SystemTemplateSystemSignalRef=VehicleSpeedVSOSigFailSts
        Com_MessageCounter_B1__BSM1__CCAN: ComBitPosition=51, ComBitSize=4, ComHandleId=18, ComSignalInitValue=0, ComSignalType=UINT8, ComTimeoutFactor=2500, ComTransferProperty=PENDING, ComRxDataTimeoutAction=NONE, ComFirstTimeoutFactor=0, ComNotificationFlag=false, ComTimeoutNotificationFlag=false, ComStateOnFlag=false, SystemTemplateSystemSignalRef=MessageCounter_B1
        Com_CRC_B1__BSM1__CCAN: ComBitPosition=63, ComBitSize=8, ComHandleId=0, ComSignalInitValue=0, ComSignalType=UINT8, ComTimeoutFactor=2500, ComTransferProperty=PENDING, ComRxDataTimeoutAction=NONE, ComFirstTimeoutFactor=0, ComNotificationFlag=false, ComTimeoutNotificationFlag=false, ComStateOnFlag=false, SystemTemplateSystemSignalRef=CRC_B1
        Com_Digit_10__CFG_DATA_CODE_REQUEST__CCAN: ComBitPosition=3, ComBitSize=4, ComHandleId=13, ComSignalInitValue=0, ComSignalType=UINT8, ComTimeoutFactor=2500, ComTransferProperty=PENDING, ComRxDataTimeoutAction=NONE, ComFirstTimeoutFactor=0, ComNotificationFlag=false, ComTimeoutNotificationFlag=false, ComStateOnFlag=false, ComNotification=Appl_COMCbk_Com_Digit_10__CFG_DATA_CODE_REQUEST__CCAN, SystemTemplateSystemSignalRef=Digit_10
        Com_Digit_11__CFG_DATA_CODE_REQUEST__CCAN: ComBitPosition=7, ComBitSize=4, ComHandleId=14, ComSignalInitValue=0, ComSignalType=UINT8, ComTimeoutFactor=2500, ComTransferProperty=PENDING, ComRxDataTimeoutAction=NONE, ComFirstTimeoutFactor=0, ComNotificationFlag=false, ComTimeoutNotificationFlag=false, ComStateOnFlag=false, ComNotification=Appl_COMCbk_Com_Digit_11__CFG_DATA_CODE_REQUEST__CCAN, SystemTemplateSystemSignalRef=Digit_11
        Com_Digit_08__CFG_DATA_CODE_REQUEST__CCAN: ComBitPosition=11, ComBitSize=4, ComHandleId=11, ComSignalInitValue=0, ComSignalType=UINT8, ComTimeoutFactor=2500, ComTransferProperty=PENDING, ComRxDataTimeoutAction=NONE, ComFirstTimeoutFactor=0, ComNotificationFlag=false, ComTimeoutNotificationFlag=false, ComStateOnFlag=false, ComNotification=Appl_COMCbk_Com_Digit_08__CFG_DATA_CODE_REQUEST__CCAN, SystemTemplateSystemSignalRef=Digit_08
        Com_Digit_09__CFG_DATA_CODE_REQUEST__CCAN: ComBitPosition=15, ComBitSize=4, ComHandleId=12, ComSignalInitValue=0, ComSignalType=UINT8, ComTimeoutFactor=2500, ComTransferProperty=PENDING, ComRxDataTimeoutAction=NONE, ComFirstTimeoutFactor=0, ComNotificationFlag=false, ComTimeoutNotificationFlag=false, ComStateOnFlag=false, ComNotification=Appl_COMCbk_Com_Digit_09__CFG_DATA_CODE_REQUEST__CCAN, SystemTemplateSystemSignalRef=Digit_09
        Com_Digit_06__CFG_DATA_CODE_REQUEST__CCAN: ComBitPosition=19, ComBitSize=4, ComHandleId=9, ComSignalInitValue=0, ComSignalType=UINT8, ComTimeoutFactor=2500, ComTransferProperty=PENDING, ComRxDataTimeoutAction=NONE, ComFirstTimeoutFactor=0, ComNotificationFlag=false, ComTimeoutNotificationFlag=false, ComStateOnFlag=false, ComNotification=Appl_COMCbk_Com_Digit_06__CFG_DATA_CODE_REQUEST__CCAN, SystemTemplateSystemSignalRef=Digit_06
        Com_Digit_07__CFG_DATA_CODE_REQUEST__CCAN: ComBitPosition=23, ComBitSize=4, ComHandleId=10, ComSignalInitValue=0, ComSignalType=UINT8, ComTimeoutFactor=2500, ComTransferProperty=PENDING, ComRxDataTimeoutAction=NONE, ComFirstTimeoutFactor=0, ComNotificationFlag=false, ComTimeoutNotificationFlag=false, ComStateOnFlag=false, ComNotification=Appl_COMCbk_Com_Digit_07__CFG_DATA_CODE_REQUEST__CCAN, SystemTemplateSystemSignalRef=Digit_07
        Com_Digit_04__CFG_DATA_CODE_REQUEST__CCAN: ComBitPosition=27, ComBitSize=4, ComHandleId=7, ComSignalInitValue=0, ComSignalType=UINT8, ComTimeoutFactor=2500, ComTransferProperty=PENDING, ComRxDataTimeoutAction=NONE, ComFirstTimeoutFactor=0, ComNotificationFlag=false, ComTimeoutNotificationFlag=false, ComStateOnFlag=false, ComNotification=Appl_COMCbk_Com_Digit_04__CFG_DATA_CODE_REQUEST__CCAN, SystemTemplateSystemSignalRef=Digit_04
        Com_Digit_05__CFG_DATA_CODE_REQUEST__CCAN: ComBitPosition=31, ComBitSize=4, ComHandleId=8, ComSignalInitValue=0, ComSignalType=UINT8, ComTimeoutFactor=2500, ComTransferProperty=PENDING, ComRxDataTimeoutAction=NONE, ComFirstTimeoutFactor=0, ComNotificationFlag=false, ComTimeoutNotificationFlag=false, ComStateOnFlag=false, ComNotification=Appl_COMCbk_Com_Digit_05__CFG_DATA_CODE_REQUEST__CCAN, SystemTemplateSystemSignalRef=Digit_05
        Com_Digit_02__CFG_DATA_CODE_REQUEST__CCAN: ComBitPosition=35, ComBitSize=4, ComHandleId=5, ComSignalInitValue=0, ComSignalType=UINT8, ComTimeoutFactor=2500, ComTransferProperty=PENDING, ComRxDataTimeoutAction=NONE, ComFirstTimeoutFactor=0, ComNotificationFlag=false, ComTimeoutNotificationFlag=false, ComStateOnFlag=false, ComNotification=Appl_COMCbk_Com_Digit_02__CFG_DATA_CODE_REQUEST__CCAN, SystemTemplateSystemSignalRef=Digit_02
        Com_Digit_03__CFG_DATA_CODE_REQUEST__CCAN: ComBitPosition=39, ComBitSize=4, ComHandleId=6, ComSignalInitValue=0, ComSignalType=UINT8, ComTimeoutFactor=2500, ComTransferProperty=PENDING, ComRxDataTimeoutAction=NONE, ComFirstTimeoutFactor=0, ComNotificationFlag=false, ComTimeoutNotificationFlag=false, ComStateOnFlag=false, ComNotification=Appl_COMCbk_Com_Digit_03__CFG_DATA_CODE_REQUEST__CCAN, SystemTemplateSystemSignalRef=Digit_03
        Com_Digit_01__CFG_DATA_CODE_REQUEST__CCAN: ComBitPosition=47, ComBitSize=4, ComHandleId=4, ComSignalInitValue=0, ComSignalType=UINT8, ComTimeoutFactor=2500, ComTransferProperty=TRIGGERED_WITHOUT_REPETITION, ComRxDataTimeoutAction=NONE, ComFirstTimeoutFactor=0, ComNotificationFlag=false, ComTimeoutNotificationFlag=false, ComStateOnFlag=false, ComNotification=Appl_COMCbk_Com_Digit_01__CFG_DATA_CODE_REQUEST__CCAN, SystemTemplateSystemSignalRef=Digit_01
        Com_Digit_10_EPS__CFG_DATA_CODE_RSP_EPS__CCAN: ComBitPosition=3, ComBitSize=4, ComHandleId=35, ComSignalInitValue=0, ComSignalType=UINT8, ComTransferProperty=PENDING, ComTimeoutFactor=0, SystemTemplateSystemSignalRef=Digit_10_EPS
        Com_Digit_11_EPS__CFG_DATA_CODE_RSP_EPS__CCAN: ComBitPosition=7, ComBitSize=4, ComHandleId=36, ComSignalInitValue=0, ComSignalType=UINT8, ComTransferProperty=PENDING, ComTimeoutFactor=0, SystemTemplateSystemSignalRef=Digit_11_EPS
        Com_Digit_08_EPS__CFG_DATA_CODE_RSP_EPS__CCAN: ComBitPosition=11, ComBitSize=4, ComHandleId=33, ComSignalInitValue=0, ComSignalType=UINT8, ComTransferProperty=PENDING, ComTimeoutFactor=0, SystemTemplateSystemSignalRef=Digit_08_EPS
        Com_Digit_09_EPS__CFG_DATA_CODE_RSP_EPS__CCAN: ComBitPosition=15, ComBitSize=4, ComHandleId=34, ComSignalInitValue=0, ComSignalType=UINT8, ComTransferProperty=PENDING, ComTimeoutFactor=0, SystemTemplateSystemSignalRef=Digit_09_EPS
        Com_Digit_06_EPS__CFG_DATA_CODE_RSP_EPS__CCAN: ComBitPosition=19, ComBitSize=4, ComHandleId=31, ComSignalInitValue=0, ComSignalType=UINT8, ComTransferProperty=PENDING, ComTimeoutFactor=0, SystemTemplateSystemSignalRef=Digit_06_EPS
        Com_Digit_07_EPS__CFG_DATA_CODE_RSP_EPS__CCAN: ComBitPosition=23, ComBitSize=4, ComHandleId=32, ComSignalInitValue=0, ComSignalType=UINT8, ComTransferProperty=PENDING, ComTimeoutFactor=0, SystemTemplateSystemSignalRef=Digit_07_EPS
        Com_Digit_04_EPS__CFG_DATA_CODE_RSP_EPS__CCAN: ComBitPosition=27, ComBitSize=4, ComHandleId=29, ComSignalInitValue=0, ComSignalType=UINT8, ComTransferProperty=PENDING, ComTimeoutFactor=0, SystemTemplateSystemSignalRef=Digit_04_EPS
        Com_Digit_05_EPS__CFG_DATA_CODE_RSP_EPS__CCAN: ComBitPosition=31, ComBitSize=4, ComHandleId=30, ComSignalInitValue=0, ComSignalType=UINT8, ComTransferProperty=PENDING, ComTimeoutFactor=0, SystemTemplateSystemSignalRef=Digit_05_EPS
        Com_Digit_02_EPS__CFG_DATA_CODE_RSP_EPS__CCAN: ComBitPosition=35, ComBitSize=4, ComHandleId=27, ComSignalInitValue=0, ComSignalType=UINT8, ComTransferProperty=PENDING, ComTimeoutFactor=0, SystemTemplateSystemSignalRef=Digit_02_EPS
        Com_Digit_03_EPS__CFG_DATA_CODE_RSP_EPS__CCAN: ComBitPosition=39, ComBitSize=4, ComHandleId=28, ComSignalInitValue=0, ComSignalType=UINT8, ComTransferProperty=PENDING, ComTimeoutFactor=0, SystemTemplateSystemSignalRef=Digit_03_EPS
        Com_Digit_01_EPS__CFG_DATA_CODE_RSP_EPS__CCAN: ComBitPosition=47, ComBitSize=4, ComHandleId=26, ComSignalInitValue=0, ComSignalType=UINT8, ComTransferProperty=TRIGGERED_WITHOUT_REPETITION, ComTimeoutFactor=0, SystemTemplateSystemSignalRef=Digit_01_EPS
        Com_LwsAngle__GE__CCAN: ComBitPosition=7, ComBitSize=16, ComHandleId=42, ComSignalDataInvalidValue=65535, ComSignalInitValue=0, ComSignalType=UINT16, ComTransferProperty=PENDING, ComTimeoutFactor=0, SystemTemplateSystemSignalRef=LwsAngle
        Com_LwsSpeed__GE__CCAN: ComBitPosition=19, ComBitSize=12, ComHandleId=44, ComSignalDataInvalidValue=4095, ComSignalInitValue=0, ComSignalType=UINT16, ComTransferProperty=PENDING, ComTimeoutFactor=0, SystemTemplateSystemSignalRef=LwsSpeed
        Com_SteeringLoad__GE__CCAN: ComBitPosition=20, ComBitSize=1, ComHandleId=62, ComSignalInitValue=1, ComSignalType=BOOLEAN, ComTransferProperty=PENDING, ComTimeoutFactor=0, SystemTemplateSystemSignalRef=SteeringLoad
        Com_LwsAngleType__GE__CCAN: ComBitPosition=22, ComBitSize=2, ComHandleId=41, ComSignalDataInvalidValue=3, ComSignalInitValue=0, ComSignalType=UINT8, ComTransferProperty=PENDING, ComTimeoutFactor=0, SystemTemplateSystemSignalRef=LwsAngleType
        Com_LwsCalibration__GE__CCAN: ComBitPosition=23, ComBitSize=1, ComHandleId=43, ComSignalInitValue=0, ComSignalType=BOOLEAN, ComTransferProperty=PENDING, ComTimeoutFactor=0, SystemTemplateSystemSignalRef=LwsCalibration
        Com_LWSFailSts__GE__CCAN: ComBitPosition=38, ComBitSize=2, ComHandleId=40, ComSignalInitValue=0, ComSignalType=UINT8, ComTransferProperty=PENDING, ComTimeoutFactor=0, SystemTemplateSystemSignalRef=LWSFailSts
        Com_ElectricSteeringFailSts__GE__CCAN: ComBitPosition=39, ComBitSize=1, ComHandleId=38, ComSignalInitValue=0, ComSignalType=BOOLEAN, ComTransferProperty=PENDING, ComTimeoutFactor=0, SystemTemplateSystemSignalRef=ElectricSteeringFailSts
        Com_EngineSts__MOT1__CCAN: ComBitPosition=9, ComBitSize=2, ComHandleId=17, ComSignalDataInvalidValue=3, ComSignalInitValue=3, ComSignalType=UINT8, ComTimeoutFactor=2500, ComTransferProperty=PENDING, ComRxDataTimeoutAction=NONE, ComFirstTimeoutFactor=0, ComNotificationFlag=false, ComTimeoutNotificationFlag=false, ComStateOnFlag=false, ComNotification=Appl_COMCbk_Com_EngineSts__MOT1__CCAN, SystemTemplateSystemSignalRef=EngineSts
        Com_EngineStopStartSts__MOT3__CCAN: ComBitPosition=54, ComBitSize=2, ComHandleId=16, ComSignalInitValue=1, ComSignalType=UINT8, ComTimeoutFactor=2500, ComTransferProperty=PENDING, ComRxDataTimeoutAction=NONE, ComFirstTimeoutFactor=0, ComNotificationFlag=false, ComTimeoutNotificationFlag=false, ComStateOnFlag=false, ComNotification=Appl_COMCbk_Com_EngineStopStartSts__MOT3__CCAN, SystemTemplateSystemSignalRef=EngineStopStartSts
        Com_StopStartSts__MOT3__CCAN: ComBitPosition=59, ComBitSize=2, ComHandleId=20, ComSignalInitValue=0, ComSignalType=UINT8, ComTimeoutFactor=2500, ComTransferProperty=PENDING, ComRxDataTimeoutAction=NONE, ComFirstTimeoutFactor=0, ComNotificationFlag=false, ComTimeoutNotificationFlag=false, ComStateOnFlag=false, SystemTemplateSystemSignalRef=StopStartSts
        Com_Reserved_for_PDC_EPS__PDC_INFO_EPS__CCAN: ComBitPosition=3, ComBitSize=4, ComHandleId=45, ComSignalInitValue=0, ComSignalType=UINT8, ComTransferProperty=PENDING, ComTimeoutFactor=0, SystemTemplateSystemSignalRef=Reserved_for_PDC_EPS
        Com_DES_EPS__PDC_INFO_EPS__CCAN: ComBitPosition=4, ComBitSize=1, ComHandleId=25, ComSignalInitValue=0, ComSignalType=BOOLEAN, ComTransferProperty=PENDING, ComTimeoutFactor=0, SystemTemplateSystemSignalRef=DES_EPS
        Com_GenericFailSts_EPS__PDC_INFO_EPS__CCAN: ComBitPosition=5, ComBitSize=1, ComHandleId=39, ComSignalInitValue=0, ComSignalType=BOOLEAN, ComTransferProperty=PENDING, ComTimeoutFactor=0, SystemTemplateSystemSignalRef=GenericFailSts_EPS
        Com_CurrentFailSts_EPS__PDC_INFO_EPS__CCAN: ComBitPosition=6, ComBitSize=1, ComHandleId=24, ComSignalInitValue=0, ComSignalType=BOOLEAN, ComTransferProperty=PENDING, ComTimeoutFactor=0, SystemTemplateSystemSignalRef=CurrentFailSts_EPS
        Com_EOL_EPS__PDC_INFO_EPS__CCAN: ComBitPosition=7, ComBitSize=1, ComHandleId=37, ComSignalInitValue=0, ComSignalType=BOOLEAN, ComTransferProperty=PENDING, ComTimeoutFactor=0, SystemTemplateSystemSignalRef=EOL_EPS
        Com_StayActiveSource_EPS_7__PDC_INFO_EPS__CCAN: ComBitPosition=8, ComBitSize=1, ComHandleId=59, ComSignalInitValue=0, ComSignalType=BOOLEAN, ComTransferProperty=PENDING, ComTimeoutFactor=0, SystemTemplateSystemSignalRef=StayActiveSource_EPS_7
        Com_StayActiveSource_EPS_6__PDC_INFO_EPS__CCAN: ComBitPosition=9, ComBitSize=1, ComHandleId=58, ComSignalInitValue=0, ComSignalType=BOOLEAN, ComTransferProperty=PENDING, ComTimeoutFactor=0, SystemTemplateSystemSignalRef=StayActiveSource_EPS_6
        Com_StayActiveSource_EPS_5__PDC_INFO_EPS__CCAN: ComBitPosition=10, ComBitSize=1, ComHandleId=57, ComSignalInitValue=0, ComSignalType=BOOLEAN, ComTransferProperty=PENDING, ComTimeoutFactor=0, SystemTemplateSystemSignalRef=StayActiveSource_EPS_5
        Com_StayActiveSource_EPS_4__PDC_INFO_EPS__CCAN: ComBitPosition=11, ComBitSize=1, ComHandleId=56, ComSignalInitValue=0, ComSignalType=BOOLEAN, ComTransferProperty=PENDING, ComTimeoutFactor=0, SystemTemplateSystemSignalRef=StayActiveSource_EPS_4
        Com_StayActiveSource_EPS_3__PDC_INFO_EPS__CCAN: ComBitPosition=12, ComBitSize=1, ComHandleId=55, ComSignalInitValue=0, ComSignalType=BOOLEAN, ComTransferProperty=PENDING, ComTimeoutFactor=0, SystemTemplateSystemSignalRef=StayActiveSource_EPS_3
        Com_StayActiveSource_EPS_2__PDC_INFO_EPS__CCAN: ComBitPosition=13, ComBitSize=1, ComHandleId=54, ComSignalInitValue=0, ComSignalType=BOOLEAN, ComTransferProperty=PENDING, ComTimeoutFactor=0, SystemTemplateSystemSignalRef=StayActiveSource_EPS_2
        Com_StayActiveSource_EPS_1__PDC_INFO_EPS__CCAN: ComBitPosition=14, ComBitSize=1, ComHandleId=53, ComSignalInitValue=0, ComSignalType=BOOLEAN, ComTransferProperty=PENDING, ComTimeoutFactor=0, SystemTemplateSystemSignalRef=StayActiveSource_EPS_1
        Com_StayActiveSource_EPS_0__PDC_INFO_EPS__CCAN: ComBitPosition=15, ComBitSize=1, ComHandleId=46, ComSignalInitValue=0, ComSignalType=BOOLEAN, ComTransferProperty=PENDING, ComTimeoutFactor=0, SystemTemplateSystemSignalRef=StayActiveSource_EPS_0
        Com_StayActiveSource_EPS_15__PDC_INFO_EPS__CCAN: ComBitPosition=16, ComBitSize=1, ComHandleId=52, ComSignalInitValue=0, ComSignalType=BOOLEAN, ComTransferProperty=PENDING, ComTimeoutFactor=0, SystemTemplateSystemSignalRef=StayActiveSource_EPS_15
        Com_StayActiveSource_EPS_14__PDC_INFO_EPS__CCAN: ComBitPosition=17, ComBitSize=1, ComHandleId=51, ComSignalInitValue=0, ComSignalType=BOOLEAN, ComTransferProperty=PENDING, ComTimeoutFactor=0, SystemTemplateSystemSignalRef=StayActiveSource_EPS_14
        Com_StayActiveSource_EPS_13__PDC_INFO_EPS__CCAN: ComBitPosition=18, ComBitSize=1, ComHandleId=50, ComSignalInitValue=0, ComSignalType=BOOLEAN, ComTransferProperty=PENDING, ComTimeoutFactor=0, SystemTemplateSystemSignalRef=StayActiveSource_EPS_13
        Com_StayActiveSource_EPS_12__PDC_INFO_EPS__CCAN: ComBitPosition=19, ComBitSize=1, ComHandleId=49, ComSignalInitValue=0, ComSignalType=BOOLEAN, ComTransferProperty=PENDING, ComTimeoutFactor=0, SystemTemplateSystemSignalRef=StayActiveSource_EPS_12
        Com_StayActiveSource_EPS_11__PDC_INFO_EPS__CCAN: ComBitPosition=20, ComBitSize=1, ComHandleId=48, ComSignalInitValue=0, ComSignalType=BOOLEAN, ComTransferProperty=PENDING, ComTimeoutFactor=0, SystemTemplateSystemSignalRef=StayActiveSource_EPS_11
        Com_StayActiveSource_EPS_10__PDC_INFO_EPS__CCAN: ComBitPosition=21, ComBitSize=1, ComHandleId=47, ComSignalInitValue=0, ComSignalType=BOOLEAN, ComTransferProperty=PENDING, ComTimeoutFactor=0, SystemTemplateSystemSignalRef=StayActiveSource_EPS_10
        Com_StayActiveSource_EPS_9__PDC_INFO_EPS__CCAN: ComBitPosition=22, ComBitSize=1, ComHandleId=61, ComSignalInitValue=0, ComSignalType=BOOLEAN, ComTransferProperty=PENDING, ComTimeoutFactor=0, SystemTemplateSystemSignalRef=StayActiveSource_EPS_9
        Com_StayActiveSource_EPS_8__PDC_INFO_EPS__CCAN: ComBitPosition=23, ComBitSize=1, ComHandleId=60, ComSignalInitValue=0, ComSignalType=BOOLEAN, ComTransferProperty=PENDING, ComTimeoutFactor=0, SystemTemplateSystemSignalRef=StayActiveSource_EPS_8
        Com_CmdIgn_FailSts__STATUS_C_BCM2__CCAN: ComBitPosition=7, ComBitSize=2, ComHandleId=3, ComSignalDataInvalidValue=3, ComSignalInitValue=0, ComSignalType=UINT8, ComTimeoutFactor=2500, ComTransferProperty=TRIGGERED_ON_CHANGE, ComRxDataTimeoutAction=NONE, ComFirstTimeoutFactor=0, ComNotificationFlag=false, ComTimeoutNotificationFlag=false, ComStateOnFlag=false, ComNotification=Appl_COMCbk_Com_CmdIgn_FailSts__STATUS_C_BCM2__CCAN, SystemTemplateSystemSignalRef=CmdIgn_FailSts
        Com_CmdIgnSts__STATUS_C_BCM2__CCAN: ComBitPosition=15, ComBitSize=3, ComHandleId=2, ComSignalDataInvalidValue=7, ComSignalInitValue=0, ComSignalType=UINT8, ComTimeoutFactor=2500, ComTransferProperty=TRIGGERED_ON_CHANGE, ComRxDataTimeoutAction=NONE, ComFirstTimeoutFactor=0, ComNotificationFlag=false, ComTimeoutNotificationFlag=false, ComStateOnFlag=false, ComNotification=Appl_COMCbk_Com_CmdIgnSts__STATUS_C_BCM2__CCAN, SystemTemplateSystemSignalRef=CmdIgnSts
        Com_CityModeSts__STATUS_C_BCM2__CCAN: ComBitPosition=31, ComBitSize=1, ComHandleId=1, ComSignalInitValue=0, ComSignalType=BOOLEAN, ComTimeoutFactor=2500, ComTransferProperty=TRIGGERED_ON_CHANGE, ComRxDataTimeoutAction=NONE, ComFirstTimeoutFactor=0, ComNotificationFlag=false, ComTimeoutNotificationFlag=false, ComStateOnFlag=false, SystemTemplateSystemSignalRef=CityModeSts
        Com_ElectricSteeringLamp_FailSts__STATUS_C_IPC__CCAN: ComBitPosition=1, ComBitSize=2, ComHandleId=15, ComSignalInitValue=0, ComSignalType=UINT8, ComTimeoutFactor=2500, ComTransferProperty=PENDING, ComRxDataTimeoutAction=NONE, ComFirstTimeoutFactor=0, ComNotificationFlag=false, ComTimeoutNotificationFlag=false, ComStateOnFlag=false, ComNotification=Appl_COMCbk_Com_ElectricSteeringLamp_FailSts__STATUS_C_IPC__CCAN, SystemTemplateSystemSignalRef=ElectricSteeringLamp_FailSts
        Com_TotalOdometer__STATUS_C_IPC__CCAN: ComBitPosition=31, ComBitSize=20, ComHandleId=21, ComSignalInitValue=0, ComSignalType=UINT32, ComTimeoutFactor=0, ComTransferProperty=PENDING, ComRxDataTimeoutAction=NONE, ComFirstTimeoutFactor=0, ComNotificationFlag=false, ComTimeoutNotificationFlag=false, ComStateOnFlag=false, SystemTemplateSystemSignalRef=TotalOdometer
    VectorCommonData: BswmdVersion=3.22.01
  module config EcuC
    PduCollection
      29 x Pdu:
        BCM_COMMAND__CCAN: PduLength=40
        BSM1__CCAN: PduLength=64
        CFG_DATA_CODE_REQUEST__CCAN: PduLength=48
        CFG_DATA_CODE_RSP_EPS__CCAN: PduLength=48
        DIAGNOSTIC_REQUEST_EPS_Tp__CCAN_Rx: PduLength=(unset)
        DIAGNOSTIC_REQUEST_EPS_Tp__CCAN_Tx: PduLength=(unset)
        DIAGNOSTIC_REQUEST_FUNCTIONAL_Tp__CCAN_Rx: PduLength=(unset)
        DIAGNOSTIC_REQUEST_FUNCTIONAL_Tp__CCAN_Tx: PduLength=(unset)
        DIAGNOSTIC_RESPONSE_EPS_Tp__CCAN_Rx: PduLength=(unset)
        DIAGNOSTIC_RESPONSE_EPS_Tp__CCAN_Tx: PduLength=(unset)
        GE__CCAN: PduLength=48
        MOT1__CCAN: PduLength=64
        MOT3__CCAN: PduLength=64
        NM_BCM__CCAN: PduLength=16
        NM_BSM__CCAN: PduLength=16
        NM_ECM__CCAN: PduLength=16
        NM_EPS__CCAN: PduLength=16
        NM_IPC__CCAN: PduLength=16
        NM_TRANSMISSION__CCAN: PduLength=16
        PDC_INFO_EPS__CCAN: PduLength=24
        STATUS_C_BCM2__CCAN: PduLength=40
        STATUS_C_IPC__CCAN: PduLength=64
        DIAGNOSTIC_REQUEST_EPS__CCAN: PduLength=64
        DIAGNOSTIC_REQUEST_FUNCTIONAL__CCAN: PduLength=56
        DIAGNOSTIC_RESPONSE_EPS__CCAN: PduLength=64
        GliwaMaster__CCAN: PduLength=64
        GliwaSlave__CCAN: PduLength=64
        XcpMaster__CCAN: PduLength=64
        XcpSlave__CCAN: PduLength=64
  module config PduR: implementation-config-variant=VARIANT-PRE-COMPILE, module-description=PduR_Impl
    PduRGeneral:
      PduRCanIfSupport = true
      PduRCanTpSupport = true
      PduRComSupport = true
      PduRDcmSupport = true
      PduRFrIfSupport = false
      PduRFrTpSupport = false
      PduRIpduMSupport = false
      PduRLinIfSupport = false
      PduRLinTpSupport = false
      PduRMostIfSupport = false
      PduRMostTpSupport = false
      PduRMulticastFromTpSupport = false
      PduRMulticastToIfSupport = false
      PduRMulticastToTpSupport = false
      PduRZeroCostOperation = false
      PduRRoutingPathGroupSupport = true
      PduRProdErrorDetect = true
      PduRDevErrorDetect = false
      PduRVersionInfoApi = false
      PduRBalanceRoutingTime = true
      PduRCanTp2ProvideRxBufferCalls = false
      PduRJ1939Support = false
      PduRApplIfSupport = false
      PduRFrTp2ProvideRxBufferCalls = false
      PduRApplTpSupport = false
      PduRRouting2CSFSupport = false
      PduRDynamicDlcSupport = true
      PduRCanTpCancelReceive = (unset)
      PduRCanTpChangeParameterRequestApi = (unset)
      PduRFifoTxBufferSupport = false
      PduRFrTpCancelReceive = (unset)
      PduRFrTpChangeParameterRequestApi = (unset)
      PduRGatewayOperation = false
      PduRLinTpChangeParameterRequestApi = (unset)
      PduRMemorySize = 0
      PduRMulticastFromIfSupport = false
      PduRSbTxBufferSupport = false
      PduRCanNmSupport = false
      PduRNmOsekSupport = false
      PduRFrNmSupport = false
      PduRPBStartAddress = 0
      PduRUserConfigurationFile = 
      PduRMaxNumberOfRxCanTpPdus = 1
      PduRMaxNumberOfRxFrTpPdus = 1
      PduRSoAdSupport = false
      PduRMaxRoutingPathGroups = 1
      PduRMaxRoutingPathsInRPGs = 1
      PduRAmdRuntimeMeasurement = false
    PduRGlobalConfig: PduRConfigurationId=0
      PduRRoutingTable
        13 x PduRRoutingPath:
          Derived_PduRRoutingPath_CD0D6991
            BCM_COMMAND__CCAN (PduRSrcPdu): HandleId=4, SrcPduRef=PduCollection/BCM_COMMAND__CCAN
            PT_BCM_COMMAND (PduRDestPdu): DataProvision=TRIGGER_TRANSMIT, DestPduRef=PduCollection/BCM_COMMAND__CCAN
          Derived_PduRRoutingPath_6B4356FE
            BSM1__CCAN (PduRSrcPdu): HandleId=5, SrcPduRef=PduCollection/BSM1__CCAN
            PT_BSM1 (PduRDestPdu): DataProvision=TRIGGER_TRANSMIT, DestPduRef=PduCollection/BSM1__CCAN
          Derived_PduRRoutingPath_A822388D
            CFG_DATA_CODE_REQUEST__CCAN (PduRSrcPdu): HandleId=0, SrcPduRef=PduCollection/CFG_DATA_CODE_REQUEST__CCAN
            PT_CFG_DATA_CODE_REQUEST (PduRDestPdu): DataProvision=TRIGGER_TRANSMIT, DestPduRef=PduCollection/CFG_DATA_CODE_REQUEST__CCAN
          Derived_PduRRoutingPath_D4E5FD1F
            CFG_DATA_CODE_RSP_EPS__CCAN (PduRSrcPdu): HandleId=1, SrcPduRef=PduCollection/CFG_DATA_CODE_RSP_EPS__CCAN
            PT_CFG_DATA_CODE_RSP_EPS (PduRDestPdu): DataProvision=DIRECT, DestPduRef=PduCollection/CFG_DATA_CODE_RSP_EPS__CCAN
          Derived_PduRRoutingPath_06ED1573
            DIAGNOSTIC_REQUEST_EPS__CCAN (PduRSrcPdu): HandleId=1, PduRCddDobtSwitch=false, SrcPduRef=PduCollection/DIAGNOSTIC_REQUEST_EPS__CCAN
            PT_DIAGNOSTIC_REQUEST_EPS (PduRDestPdu): PduRCddDobtSwitch=false, DestPduRef=PduCollection/DIAGNOSTIC_REQUEST_EPS__CCAN
          Derived_PduRRoutingPath_0D52CD87
            DIAGNOSTIC_REQUEST_FUNCTIONAL__CCAN (PduRSrcPdu): HandleId=0, PduRCddDobtSwitch=false, SrcPduRef=PduCollection/DIAGNOSTIC_REQUEST_FUNCTIONAL__CCAN
            PT_DIAGNOSTIC_REQUEST_FUNCTIONAL (PduRDestPdu): PduRCddDobtSwitch=false, DestPduRef=PduCollection/DIAGNOSTIC_REQUEST_FUNCTIONAL__CCAN
          Derived_PduRRoutingPath_1920CEE0
            DIAGNOSTIC_RESPONSE_EPS__CCAN (PduRSrcPdu): HandleId=0, PduRCddDobtSwitch=false, SrcPduRef=PduCollection/DIAGNOSTIC_RESPONSE_EPS__CCAN
            PT_DIAGNOSTIC_RESPONSE_EPS (PduRDestPdu): PduRCddDobtSwitch=false, DestPduRef=PduCollection/DIAGNOSTIC_RESPONSE_EPS__CCAN
          Derived_PduRRoutingPath_39860B71
            GE__CCAN (PduRSrcPdu): HandleId=2, SrcPduRef=PduCollection/GE__CCAN
            PT_GE (PduRDestPdu): DataProvision=DIRECT, DestPduRef=PduCollection/GE__CCAN
          Derived_PduRRoutingPath_3E58B739
            MOT1__CCAN (PduRSrcPdu): HandleId=6, SrcPduRef=PduCollection/MOT1__CCAN
            PT_MOT1 (PduRDestPdu): DataProvision=TRIGGER_TRANSMIT, DestPduRef=PduCollection/MOT1__CCAN
          Derived_PduRRoutingPath_4864C778
            MOT3__CCAN (PduRSrcPdu): HandleId=3, SrcPduRef=PduCollection/MOT3__CCAN
            PT_MOT3 (PduRDestPdu): DataProvision=TRIGGER_TRANSMIT, DestPduRef=PduCollection/MOT3__CCAN
          Derived_PduRRoutingPath_B20A3375
            PDC_INFO_EPS__CCAN (PduRSrcPdu): HandleId=0, SrcPduRef=PduCollection/PDC_INFO_EPS__CCAN
            PT_PDC_INFO_EPS (PduRDestPdu): DataProvision=DIRECT, DestPduRef=PduCollection/PDC_INFO_EPS__CCAN
          Derived_PduRRoutingPath_DCA53BC7
            STATUS_C_BCM2__CCAN (PduRSrcPdu): HandleId=1, SrcPduRef=PduCollection/STATUS_C_BCM2__CCAN
            PT_STATUS_C_BCM2 (PduRDestPdu): DataProvision=TRIGGER_TRANSMIT, DestPduRef=PduCollection/STATUS_C_BCM2__CCAN
          Derived_PduRRoutingPath_84FB10B0
            STATUS_C_IPC__CCAN (PduRSrcPdu): HandleId=2, SrcPduRef=PduCollection/STATUS_C_IPC__CCAN
            PT_STATUS_C_IPC (PduRDestPdu): DataProvision=TRIGGER_TRANSMIT, DestPduRef=PduCollection/STATUS_C_IPC__CCAN
      PduRTpBufferTable: PduRMaxTpBufferNumber=0
    VectorCommonData: BswmdVersion=3.20.02
    4 x PduRBswModules, all with PduRTriggertransmit=false, PduRCancelReceive=false, PduRCancelTransmit=false, PduRChangeParameterRequestApi=false, PduRReadParameterRequestApi=false:
      CanIf: PduRUpperModule=false, PduRLowerModule=true, PduRCommunicationInterface=true, PduRTransportProtocol=false, PduRDataProvision=DIRECT, PduRUseTag=false
      CanTp: PduRUpperModule=false, PduRLowerModule=true, PduRCommunicationInterface=false, PduRTransportProtocol=true, PduRDataProvision=NONE, PduRUseTag=false
      Com: PduRUpperModule=true, PduRLowerModule=false, PduRCommunicationInterface=true, PduRTransportProtocol=false, PduRDataProvision=NONE, PduRUseTag=true
      Dcm: PduRUpperModule=true, PduRLowerModule=false, PduRCommunicationInterface=false, PduRTransportProtocol=true, PduRDataProvision=NONE, PduRUseTag=false
  module config ComM: implementation-config-variant=VARIANT-PRE-COMPILE, module-description=ComM_Impl
    ComMGeneral:
      ComMPncSupport = false
      ComMUseRte = true
      ComMSynchronousWakeUp = false
      ComMDevErrorDetect = false
      ComMVersionInfoApi = false
      ComMProdErrorDetect = true
      ComMResetAfterForcingNoComm = false
      ComMModeLimitationEnabled = false
      ComMEcuGroupClassification = 3
      ComMNoCom = false
      ComMTMinFullComModeDuration = 5
      ComMWakeupInhibitionEnabled = false
      ComMSoftwareComponentName = ComM
      ComMReqModePortPrefix = UR_
      ComMCurrentModePortPrefix = UM_
      ComMAmdRuntimeMeasurement = false
      ComMUserConfigurationFilePath = 
      ComMGlobalNvmBlockDescString = 
      ComMPncGatewayEnabled = false
      ComMPncPrepareSleepTimer = 1.5
    ComMConfig: ComMPncEnabled=false, ComMPostBuildConfigStartAddress=0
      CCAN (ComMNetworks): ComMNetworkHandle=ComM/CCAN
    CCAN (ComMChannel):
      ComMBusType = COMM_BUS_TYPE_CAN
      ComMChannelId = 0
      ComMMainFunctionPeriod = 0.01
      ComMNoCom = false
      ComMNoFullCom = false
      ComMNoWakeup = false
      ComMChannelWakeUpPortPrefix = CW_
      ComMChannelLimitPortPrefix = CL_
      ComMModeNotificationToDcm = true
      ComMPncGatewayType = COMM_GATEWAY_TYPE_NONE
      ComMNetworkManagement: ComMNmLightTimeout=10, ComMPncNmRequest=true, ComMNmVariant=FULL
      ComMUser_CCAN (ComMUserPerChannel): ComMUserChannel=ComM/ComMUser_CCAN
    VectorCommonData: BswmdVersion=2.20.00
    ComMUser_CCAN (ComMUser): ComMUserIdentifier=0, ComMModeNotification=false, ComMSystemUser=false
  module config Dcm: implementation-config-variant=VARIANT-PRE-COMPILE, module-description=Dcm_Impl
    DcmDsl
      DcmDslProtocol
        DcmDslProtocolRow:
          DcmDslProtocolID = 1
          DcmDslProtocolTransType = Type1
          DcmDslProtocolIsParallelExecutab = (unset)
          DcmDslProtocolPreemptTimeout = 1
          DcmDslProtocolPriority = 0
          DcmDslProtocolBufferSize = 4095
          DcmDiagnosticDatabase = (unset)
          DcmDslProtocolTimeLimit = PROTOCOL_UDS_ON_CAN
          CCAN_EPS (DcmDslConnection): DcmConnectionProtocolType=UDS
            CCAN (DcmDslMainConnection)
              DcmDslProtocolRx_0 (DcmDslProtocolRx): DcmDslProtocolRxAddrType=FUNCTIONAL_TYPE, DcmDslProtocolRxPduRef=PduCollection/DIAGNOSTIC_REQUEST_FUNCTIONAL__CCAN
              DcmDslProtocolRx_1 (DcmDslProtocolRx): DcmDslProtocolRxAddrType=PHYSICAL_TYPE, DcmDslProtocolRxPduRef=PduCollection/DIAGNOSTIC_REQUEST_EPS__CCAN
              DcmDslProtocolTx: DcmDslProtocolTxPduRef=PduCollection/DIAGNOSTIC_RESPONSE_EPS__CCAN
      DcmDslProtocolTiming
        PROTOCOL_UDS_ON_CAN (DcmDslProtocolTimingRow):
          DcmTimStrP2ServerMin = 0
          DcmTimStrS3Server = 5.0000002374872565
          DcmTimStrP2ServerMax = 0.050000002374872565
          DcmTimStrP2StarServerMax = 5.0000002374872565
          DcmTimStrP2StarServerMin = 2.5000001187436283
      DcmDslDiagResp: DcmDslDiagRespForceRespPendEn=false, DcmDslDiagRespMaxNumRespPend=255
    DcmPageBufferCfg: DcmPagedBufferEnabled=true, DcmPagedBufferTimeout=0
    DcmGeneral:
      DcmDevErrorDetect = false
      DcmUseRte = true
      DcmVersionInfoApi = false
      DcmSupportMultiChannelFBL = false
      DcmRespondAllRequest = true
      DcmRequestIndicationEnabled = false
      DcmTaskTime = 0.010000000474974513
      DcmRuntimeLimiter = 10
      DcmEcuResetDelayTime = 1000
      DcmUserConfigFile = 
      DcmMaxMemoryGapSize = 0
      DcmAsr4StyleMemoryAccess = false
      DcmSoftwareComponentName = Dcm
      DcmUnspecifiedServiceSupport = true
      DcmSplitMainFunctionEnabled = false
      DcmSupplierNotificationSupport = false
      DcmOemNotificationSupport = false
      DcmOBDCalibrationSupport = false
      DcmMaxNumberParallelRequest = 3
      DcmAmdRuntimeMeasurement = false
      DcmParallelRequestHandling = EXCLUSIVE_SILENT
      DcmVariantModeSelection = SIMPLE_ECU
      DcmPeriodicTxType = Type_I
      DcmRoeTxType = Type_II
    DcmConfigSet: DcmActiveDsdServiceTableRef=CommonDiagnostics, DcmActiveDslProtocolRowRef=DcmDslProtocolRow
    DcmDsd
      CommonDiagnostics (DcmDsdServiceTable):
        DcmDiagnosticDatabase = C:\Users\mzjphh\Desktop\Fiasa_326_327_05.01.00\Fiasa_326_327_EPS_TMS570\Tools\AsrProject\Config\System\Fiasa_326_327_F187_updated.cdd
        DcmDiagnosticVariant = _FF_00_00_0002_00D2_P3272_P341_Next_Gen_A
    VectorCommonData: BswmdVersion=4.12.00
  module config EcuM: implementation-config-variant=VARIANT-PRE-COMPILE, module-description=EcuM_Impl
    EcuMGeneral:
      EcuMIncludeRte = true
      EcuMIncludeDem = true
      EcuMDevErrorDetect = false
      EcuMVersionInfoApi = false
      EcuMIncludeSchM = true
      EcuMIncludeComM = true
      EcuMIncludeDet = true
      EcuMEnableProdErrorReporting = true
      EcuMIncludeNvramMgr = true
      EcuMIncludeWdgM = false
      EcuMDetIncludeFile = Det.h
      EcuMComMIncludeFile = ComM.h
      EcuMRteIncludeFile = Rte_Main.h
      EcuMCheckConfigType = false
      EcuMDetErrorhookFunction = Det_ReportError
      EcuMDemSetError = Dem_ReportErrorStatus
      EcuMComMCallbackFile = ComM_EcuM.h
      EcuMDemIncludeFile = Dem.h
      EcuMSchMIncludeFile = SchM.h
      EcuMDevErrorDetectIncludeFile = Det.h
      EcuMProdErrorDetectIncludeFile = Dem.h
      EcuMMainFunctionPeriod = 0.01
      EcuMTTIIEnabled = false
      EcuMCheckParameter = true
      EcuMCheckPointerParameter = true
      EcuMCheckStateParameter = true
      EcuMCheckWkSourceParameter = true
      EcuMCheckBootTargetParameter = true
      EcuMCheckSleepModeParameter = true
      EcuMCheckUserParameter = true
      EcuMReportAllRunRequestsKilled = true
      EcuMReportRamCheckFailed = true
      EcuMCheckUnInit = true
      EcuMMcuIncludeFile = Mcu.h
      EcuMWdgMIncludeFile = WdgM.h
      EcuMNvmIncludeFile = Nvm.h
      EcuMOsIncludeFile = Os.h
      EcuMNvmCancelWriteAllTimeout = 60
      EcuMAmdRuntimeMeasurement = false
      EcuMShutdownOSFunction = ShutdownOS(E_OK)
      EcuMAdditionalIncludes = EcuStartup.h
      EcuMIrqHandling = SuspendAllInterrupts
      EcuMWkupIsrHandling = SuspendAllInterrupts
      EcuMCalloutSwitches:
        EcuMGeneratorCompatibilityError = false
        EcuMOnRTEStartupCallout = true
        EcuMOnEnterRunCallout = true
        EcuMOnExitRunCallout = true
        EcuMOnExitPostRunCallout = true
        EcuMOnPrepShutdownCallout = true
        EcuMOnGoSleepCallout = true
        EcuMOnGoOffOneCallout = true
        EcuMOnGoOffTwoCallout = true
        EcuMOnWakeupReactionCallout = true
        EcuMOnErrorHook = true
        EcuMOnStateChangeCallout = false
      EcuMApiSwitches: EcuMKillAllRUNRequestApi=true, EcuMGetValidatedWakeupEventsApi=true, EcuMGetExpiredWakeupEventsApi=true, EcuMGetStatusOfWakeupSourceApi=true
      EcuMServicePortConfig:
        EcuMGenStateRequestPort = false
        EcuMGenBootTargetPort = false
        EcuMGenApplicationModePort = false
        EcuMGenShutdownTargetPort = false
        EcuMServiceComponentName = EcuM
        EcuMModeSwitchCbkName = 
        EcuMGenModeSwitchPort = false
        EcuMModeSwitchRteAck = false
    EcuMConfiguration:
      EcuMComStackTypesIncludeFile = ComStack_Types.h
      EcuMConfigConsistencyHash = 0
      EcuMNvramReadallTimeout = 0
      EcuMNvramWriteallTimeout = 60
      EcuMRunMinimumDuration = 0.1
      EcuMSleepActivityPeriod = 0
      EcuMDefaultAppMode = OSDEFAULTAPPMODE
      EcuMModuleConfigurationRef = Gpt_Runtime
      EcuMModuleConfigurationRef = WdgM_Runtime
      EcuMModuleConfigurationRef = CanNmGlobalConfig
      EcuMModuleConfigurationRef = CanConfigSet
      EcuMModuleConfigurationRef = CanStateManagerConfiguration
      EcuMModuleConfigurationRef = CanIfInitConfiguration
      EcuMModuleConfigurationRef = ComConfig
      EcuMModuleConfigurationRef = Port_Runtime
      EcuMModuleConfigurationRef = McuModuleConfiguration
      EcuMModuleConfigurationRef = PduRGlobalConfig
      EcuMModuleConfigurationRef = ComMConfig
      EcuMUserConfig_FirstUser (EcuMUserConfig): EcuMUser=1
      EcuMDefaultShutdownTarget: EcuMDefaultState=EcuMStateSleep, EcuMDefaultSleepModeRef=EcuMSleepMode
      EcuMSleepMode:
        EcuMSleepModeId = 0
        EcuMSleepModeName = InitialEcuCSleepMode
        EcuMSleepModeSuspend = false
        EcuMSleepModeMcuModeRef = McuModeConf
        EcuMSleepModeWdgMModeRef = WdgMMode
        EcuMWakeupSourceMask = ECUM_WKSOURCE_RESET
        EcuMWakeupSourceMask = ECUM_WKSOURCE_INTERNAL_RESET
        EcuMWakeupSourceMask = ECUM_WKSOURCE_EXTERNAL_WDG
        EcuMWakeupSourceMask = ECUM_WKSOURCE_INTERNAL_WDG
        EcuMWakeupSourceMask = ECUM_WKSOURCE_POWER
        EcuMWakeupSourceMask = CHNL
      6 x EcuMWakeupSource, all with EcuMResetReason=-1, EcuMWakeupSourcePolling=false, EcuMValidationTimeout=0, EcuMCheckWakeupTimeout=0:
        ECUM_WKSOURCE_RESET: EcuMWakeupSourceId=2
        ECUM_WKSOURCE_INTERNAL_RESET: EcuMWakeupSourceId=4
        ECUM_WKSOURCE_EXTERNAL_WDG: EcuMWakeupSourceId=16
        ECUM_WKSOURCE_INTERNAL_WDG: EcuMWakeupSourceId=8
        ECUM_WKSOURCE_POWER: EcuMWakeupSourceId=1
        CHNL: EcuMWakeupSourceId=32, EcuMComMChannelRef=ComM/CCAN
      EcuMDriverInitListOne
        EcuStartup_Init1 (EcuMDriverInitItem): EcuMModuleID=Code, EcuMAdditionalInitCode=EcuStartup_Init1();
      EcuMDriverInitListTwo
        EcuStartup_Init2 (EcuMDriverInitItem): EcuMModuleID=Code, EcuMAdditionalInitCode=EcuStartup_Init2();
      EcuMDriverInitListThree
      EcuMDriverRestartList
    VectorCommonData: BswmdVersion=6.06.01
  module config Board: implementation-config-variant=VARIANT-PRE-COMPILE, module-description=Board_Impl
    BoardGeneral:
      BoardOscillator = 20
      BoardAtomicBitAccessInBitfield = false
      BoardAtomicVariableAccess = Atomic32BitAccess
      BoardWidthOfPointer = 4
      BoardStructAlignment = Auto
      BoardArrayAlignment = Byte
      BoardStructInArrayAlignment = Byte
      BoardAlignmentFillPattern = 0
      BoardSizeOfPduIdType = Two_Byte
      BoardSizeOfPduLengthType = Two_Byte
      BoardSizeOfEnum = One_Byte
      BoardSizeOfIdType = Four_Byte
      BoardSizeOfBoolean = One_Byte
      BoardMinObjectSize = 1
      BoardGlobalGPageBehaviour = false
      BoardUseExtendedAsrVersionCheck = false
      BoardPCAndLTCRCCheck = false
      systemVersion = (unset)
      ecuExtractVersion = (unset)
      BoardOsType = Autosar
      SilentCheck = false
      BoardDummyFunction = false
      BoardDummyStatement = true
      BoardConditionalGenerating = true
      BoardEnableSnvPrefixes = false
      BoardCPUType = CPU32Bit
      BoardByteOrder = Big_Endian
      BoardBitOrder = MSB_to_LSB
    InterruptFunctionality: BoardIncludeIsrList=Os.h, BoardUseSchm=true, BoardGlobalReEnableCat1=(unset), BoardGlobalReEnableCat2=(unset)
      4 x InterruptFunctionSet:
        SuspendAllInterrupts: BoardGlobalSuspend=SuspendAllInterrupts(), BoardGlobalRestore=ResumeAllInterrupts(), BoardIncludeFile=Os.h
        SuspendOSInterrupts: BoardGlobalSuspend=SuspendOSInterrupts(), BoardGlobalRestore=ResumeOSInterrupts(), BoardIncludeFile=Os.h
        DisableAllInterrupts: BoardGlobalSuspend=DisableAllInterrupts(), BoardGlobalRestore=EnableAllInterrupts(), BoardIncludeFile=Os.h
        NoCriticalSectionHandling: BoardGlobalSuspend=, BoardGlobalRestore=, BoardIncludeFile=
  module config AbsHwPos: implementation-config-variant=VARIANT-POST-BUILD
    AbsHwPosGeneral
    CommonPublishedInformation: ArMajorVersion=3, ArMinorVersion=2, ArPatchVersion=0, SwMajorVersion=0, SwMinorVersion=0, SwPatchVersion=0, ModuleId=0, VendorId=0
  module config ActivePull: implementation-config-variant=VARIANT-POST-BUILD
    ActivePullGeneral
    CommonPublishedInformation: ArMajorVersion=3, ArMinorVersion=2, ArPatchVersion=0, SwMajorVersion=0, SwMinorVersion=0, SwPatchVersion=0, ModuleId=0, VendorId=0
  module config ApXcp: implementation-config-variant=VARIANT-POST-BUILD
    XcpGeneral: ExternalEEPROMAccess=STD_OFF, XcpIncludes=NtWrap.h, XcpRteEvents=XcpEventChannel_2ms_DAQ_2
    XcpMemoryAccess
      Flash (InternalMemoryRng): IntMemRngLow=0, IntMemRngHigh=786431
      RAM (InternalMemoryRng): IntMemRngLow=134217728, IntMemRngHigh=134348799
    RamCopy
    TuneOnTheFly: TuneOnTheFlySupport=STD_OFF, RamBlockSize=4
      Seg0_Pers: Seg0Enable=STD_OFF, MaxPerCopy=1, CalConstNumOfPerSymbol=D_NUMOFPERS_CNT_U16, TuneOnTheFlyPersLkup=STD_OFF
      Seg1_Sets: Seg1Enable=STD_OFF, MaxSetCopy=1, CalConstNumOfSetSymbol=D_NUMOFTUNSETS_CNT_U16, TuneOnTheFlySetLkup=STD_OFF
      Seg2_Common: Seg2Enable=STD_OFF
      Seg3_SetAndPer: Seg3Enable=STD_OFF
      Seg4_SetAndPerAndCommon: Seg4Enable=STD_OFF
    CommonPublishedInformation: ArMajorVersion=3, ArMinorVersion=2, ArPatchVersion=0, SwMajorVersion=0, SwMinorVersion=0, SwPatchVersion=0, ModuleId=0, VendorId=0
  module config Assist: implementation-config-variant=VARIANT-POST-BUILD
    AssistGeneral
    CommonPublishedInformation: ArMajorVersion=3, ArMinorVersion=2, ArPatchVersion=0, SwMajorVersion=0, SwMinorVersion=0, SwPatchVersion=0, ModuleId=0, VendorId=0
  module config AssistFirewall: implementation-config-variant=VARIANT-POST-BUILD
    AssistFirewallGeneral
    CommonPublishedInformation: ArMajorVersion=3, ArMinorVersion=2, ArPatchVersion=0, SwMajorVersion=0, SwMinorVersion=0, SwPatchVersion=0, ModuleId=0, VendorId=0
  module config AstLmt: implementation-config-variant=VARIANT-POST-BUILD
    AstLmtGeneral
    CommonPublishedInformation: ArMajorVersion=3, ArMinorVersion=2, ArPatchVersion=0, SwMajorVersion=0, SwMinorVersion=0, SwPatchVersion=0, ModuleId=0, VendorId=0
  module config AvgFricLrn: implementation-config-variant=VARIANT-POST-BUILD
    AvgFricLrnGeneral
    CommonPublishedInformation: ArMajorVersion=3, ArMinorVersion=2, ArPatchVersion=0, SwMajorVersion=0, SwMinorVersion=0, SwPatchVersion=0, ModuleId=0, VendorId=0
  module config BatteryVoltage: implementation-config-variant=VARIANT-POST-BUILD
    BatteryVoltageGeneral
    CommonPublishedInformation: ArMajorVersion=3, ArMinorVersion=2, ArPatchVersion=0, SwMajorVersion=0, SwMinorVersion=0, SwPatchVersion=0, ModuleId=0, VendorId=0
  module config BkCpPc: implementation-config-variant=VARIANT-POST-BUILD
    BkCpPcGeneral: BkCpPcPwrDiscConfiguration=1
    CommonPublishedInformation: ArMajorVersion=3, ArMinorVersion=2, ArPatchVersion=0, SwMajorVersion=0, SwMinorVersion=0, SwPatchVersion=0, ModuleId=0, VendorId=0
  module config BVDiag: implementation-config-variant=VARIANT-POST-BUILD
    BVDiagGeneral: BC_B1_BATTVOLTDIAG=STD_OFF, BC_B1_BATTVOLTDIAG_ELPW=STD_OFF, BC_B0_BATTVOLTDIAG_ELPW=STD_OFF
    CommonPublishedInformation: ArMajorVersion=3, ArMinorVersion=2, ArPatchVersion=0, SwMajorVersion=0, SwMinorVersion=0, SwPatchVersion=0, ModuleId=0, VendorId=0
  module config CmMtrCurr: implementation-config-variant=VARIANT-POST-BUILD
    CmMtrCurrGeneral
    CommonPublishedInformation: ArMajorVersion=3, ArMinorVersion=2, ArPatchVersion=0, SwMajorVersion=0, SwMinorVersion=0, SwPatchVersion=0, ModuleId=0, VendorId=0
    CmMtrCurrPhaseConfig: CmMtrCurrConfig=MTRCURRPHASEBA
  module config ComplErr: implementation-config-variant=VARIANT-POST-BUILD
    ComplErrGeneral
    CommonPublishedInformation: ArMajorVersion=3, ArMinorVersion=2, ArPatchVersion=0, SwMajorVersion=0, SwMinorVersion=0, SwPatchVersion=0, ModuleId=0, VendorId=0
  module config Crc: implementation-config-variant=VARIANT-PRE-COMPILE, module-description=Bswmd_Crc
    CrcPublishedInformation: CrcInitialValue8=0, CrcInitialValue16=65535, CrcInitialValue32=4294967295
    CrcGeneral: Crc8Mode=CRC_8_RUNTIME, Crc16Mode=CRC_16_RUNTIME, Crc32Mode=CRC_32_RUNTIME, CrcVersionInfoApi=true
  module config CtrldDisShtdn: implementation-config-variant=VARIANT-POST-BUILD
    CtrldDisShtdnGeneral
    CommonPublishedInformation: ArMajorVersion=3, ArMinorVersion=2, ArPatchVersion=0, SwMajorVersion=0, SwMinorVersion=0, SwPatchVersion=0, ModuleId=0, VendorId=0
  module config CtrlTemp: implementation-config-variant=VARIANT-POST-BUILD
    CtrlTempGeneral
    CommonPublishedInformation: ArMajorVersion=3, ArMinorVersion=2, ArPatchVersion=0, SwMajorVersion=0, SwMinorVersion=0, SwPatchVersion=0, ModuleId=0, VendorId=0
  module config CurrCmd: implementation-config-variant=VARIANT-POST-BUILD
    CurrCmdGeneral
    CommonPublishedInformation: ArMajorVersion=3, ArMinorVersion=2, ArPatchVersion=0, SwMajorVersion=0, SwMinorVersion=0, SwPatchVersion=0, ModuleId=0, VendorId=0
  module config CurrParamComp: implementation-config-variant=VARIANT-POST-BUILD
    CurrParamCompGeneral
    CommonPublishedInformation: ArMajorVersion=3, ArMinorVersion=2, ArPatchVersion=0, SwMajorVersion=0, SwMinorVersion=0, SwPatchVersion=0, ModuleId=0, VendorId=0
  module config Damping: implementation-config-variant=VARIANT-POST-BUILD
    DampingGeneral
    CommonPublishedInformation: ArMajorVersion=3, ArMinorVersion=2, ArPatchVersion=0, SwMajorVersion=0, SwMinorVersion=0, SwPatchVersion=0, ModuleId=0, VendorId=0
  module config DampingFirewall: implementation-config-variant=VARIANT-POST-BUILD
    DampingFirewallGeneral
    CommonPublishedInformation: ArMajorVersion=3, ArMinorVersion=2, ArPatchVersion=0, SwMajorVersion=0, SwMinorVersion=0, SwPatchVersion=0, ModuleId=0, VendorId=0
  module config DiagMgr: implementation-config-variant=VARIANT-POST-BUILD
    DiagMgrConfigSet
      122 x DiagMgrEventParameter, all with DiagMgrEventID=(unset):
        NTC_Num_FlashWrapperLgcFlt: DiagMgrNTC=1, DiagMgrEventKind=DIAGMGR_EVENT_KIND_SWC, OsApplicationRef=Ap_10
        NTC_Num_FlashECCCorr: DiagMgrNTC=2, DiagMgrEventKind=DIAGMGR_EVENT_KIND_SWC, OsApplicationRef=Ap_10
        NTC_Num_FlashECCMemFlt: DiagMgrNTC=3, DiagMgrEventKind=DIAGMGR_EVENT_KIND_SWC, OsApplicationRef=Ap_10
        NTC_Num_FlashCRCMemFault: DiagMgrNTC=4, DiagMgrEventKind=DIAGMGR_EVENT_KIND_BSW, OsApplicationRef=Ap_10
        NTC_Num_NvMBlkDftActA: DiagMgrNTC=6, DiagMgrEventKind=DIAGMGR_EVENT_KIND_BSW, OsApplicationRef=Ap_10
        NTC_Num_NvMBlkDftActB: DiagMgrNTC=7, DiagMgrEventKind=DIAGMGR_EVENT_KIND_BSW, OsApplicationRef=Ap_10
        NTC_Num_NvMBlkDftActC: DiagMgrNTC=8, DiagMgrEventKind=DIAGMGR_EVENT_KIND_BSW, OsApplicationRef=Ap_10
        NTC_Num_EEPROMDiag: DiagMgrNTC=10, DiagMgrEventKind=DIAGMGR_EVENT_KIND_BSW, OsApplicationRef=Ap_10
        NTC_Num_EEPROMDiagMtrStr: DiagMgrNTC=11, DiagMgrEventKind=DIAGMGR_EVENT_KIND_SWC, OsApplicationRef=Ap_10
        NTC_Num_PriSnsrTrqStorFlt: DiagMgrNTC=12, DiagMgrEventKind=DIAGMGR_EVENT_KIND_SWC, OsApplicationRef=Ap_10
        NTC_Num_EEPROMDiagPosTrimStr: DiagMgrNTC=13, DiagMgrEventKind=DIAGMGR_EVENT_KIND_SWC, OsApplicationRef=Ap_10
        NTC_Num_EEPROMDiagPolarityStr: DiagMgrNTC=15, DiagMgrEventKind=DIAGMGR_EVENT_KIND_SWC, OsApplicationRef=Ap_10
        NTC_Num_RAMDiag_GeneralFlt: DiagMgrNTC=16, DiagMgrEventKind=DIAGMGR_EVENT_KIND_SWC, OsApplicationRef=Ap_10
        NTC_Num_RAMDiag_WrprLgcFlt: DiagMgrNTC=17, DiagMgrEventKind=DIAGMGR_EVENT_KIND_SWC, OsApplicationRef=Ap_10
        NTC_Num_RAMDiag_ECCCorrIndFlt: DiagMgrNTC=18, DiagMgrEventKind=DIAGMGR_EVENT_KIND_SWC, OsApplicationRef=Ap_10
        NTC_Num_RAMDiag_ECCMemFlt: DiagMgrNTC=19, DiagMgrEventKind=DIAGMGR_EVENT_KIND_SWC, OsApplicationRef=Ap_10
        NTC_Num_RAMDiag_VIMRamFlt: DiagMgrNTC=23, DiagMgrEventKind=DIAGMGR_EVENT_KIND_SWC, OsApplicationRef=Ap_10
        NTC_Num_RAMDiag_NHET1RamFlt: DiagMgrNTC=24, DiagMgrEventKind=DIAGMGR_EVENT_KIND_SWC, OsApplicationRef=Ap_10
        NTC_Num_RAMDiag_NHET2RamFlt: DiagMgrNTC=25, DiagMgrEventKind=DIAGMGR_EVENT_KIND_SWC, OsApplicationRef=Ap_10
        NTC_Num_RAMDiag_ADC1RamFlt: DiagMgrNTC=26, DiagMgrEventKind=DIAGMGR_EVENT_KIND_SWC, OsApplicationRef=Ap_10
        NTC_Num_RAMDiag_DCANRamFault: DiagMgrNTC=27, DiagMgrEventKind=DIAGMGR_EVENT_KIND_SWC, OsApplicationRef=Ap_10
        NTC_Num_RAMDiag_ADC2RamFlt: DiagMgrNTC=28, DiagMgrEventKind=DIAGMGR_EVENT_KIND_SWC, OsApplicationRef=Ap_10
        NTC_Num_RAMDiag_HETTU1RamFlt: DiagMgrNTC=29, DiagMgrEventKind=DIAGMGR_EVENT_KIND_BSW, OsApplicationRef=Ap_10
        NTC_Num_RAMDiag_HETTU2RamFlt: DiagMgrNTC=30, DiagMgrEventKind=DIAGMGR_EVENT_KIND_SWC, OsApplicationRef=Ap_10
        NTC_Num_CPU_RegVer: DiagMgrNTC=32, DiagMgrEventKind=DIAGMGR_EVENT_KIND_SWC, OsApplicationRef=Ap_10
        NTC_Num_CPU_CoreInitFlt: DiagMgrNTC=33, DiagMgrEventKind=DIAGMGR_EVENT_KIND_BSW, OsApplicationRef=Ap_10
        NTC_Num_CPU_CoreRunTimeFlt: DiagMgrNTC=34, DiagMgrEventKind=DIAGMGR_EVENT_KIND_SWC, OsApplicationRef=Ap_10
        NTC_Num_CPU_ClockMon: DiagMgrNTC=35, DiagMgrEventKind=DIAGMGR_EVENT_KIND_SWC, OsApplicationRef=Ap_10
        NTC_Num_CPU_eFuseFlt: DiagMgrNTC=36, DiagMgrEventKind=DIAGMGR_EVENT_KIND_SWC, OsApplicationRef=Ap_10
        NTC_Num_CPU_MPUViolation: DiagMgrNTC=37, DiagMgrEventKind=DIAGMGR_EVENT_KIND_SWC, OsApplicationRef=Ap_10
        NTC_Num_CPU_FactPrcsErr: DiagMgrNTC=40, DiagMgrEventKind=DIAGMGR_EVENT_KIND_SWC, OsApplicationRef=Ap_10
        NTC_Num_PrgFlwDeadlnFlt: DiagMgrNTC=42, DiagMgrEventKind=DIAGMGR_EVENT_KIND_BSW, OsApplicationRef=Ap_10
        NTC_Num_PropExeDiag_RunTimeDiag: DiagMgrNTC=43, DiagMgrEventKind=DIAGMGR_EVENT_KIND_SWC, OsApplicationRef=Ap_10
        NTC_Num_PropExeDiag_COPTimeout: DiagMgrNTC=44, DiagMgrEventKind=DIAGMGR_EVENT_KIND_SWC, OsApplicationRef=Ap_10
        NTC_Num_PropExeDiag_PrefetchAbort: DiagMgrNTC=48, DiagMgrEventKind=DIAGMGR_EVENT_KIND_SWC, OsApplicationRef=Ap_10
        NTC_Num_PropExeDiag_DataAbort: DiagMgrNTC=49, DiagMgrEventKind=DIAGMGR_EVENT_KIND_SWC, OsApplicationRef=Ap_10
        NTC_Num_PerDiag_ADC1Flt: DiagMgrNTC=50, DiagMgrEventKind=DIAGMGR_EVENT_KIND_SWC, OsApplicationRef=Ap_10
        NTC_Num_PerDiag_ADC2Flt: DiagMgrNTC=51, DiagMgrEventKind=DIAGMGR_EVENT_KIND_SWC, OsApplicationRef=Ap_10
        NTC_Num_PerDiag_IllegalAccess: DiagMgrNTC=53, DiagMgrEventKind=DIAGMGR_EVENT_KIND_SWC, OsApplicationRef=Ap_10
        NTC_Num_PerDiag_DMAFlt: DiagMgrNTC=54, DiagMgrEventKind=DIAGMGR_EVENT_KIND_SWC, OsApplicationRef=Ap_10
        NTC_Num_PeripheralStartupFlt: DiagMgrNTC=55, DiagMgrEventKind=DIAGMGR_EVENT_KIND_SWC, OsApplicationRef=Ap_10
        NTC_Num_TmpMonFunc: DiagMgrNTC=64, DiagMgrEventKind=DIAGMGR_EVENT_KIND_SWC, OsApplicationRef=Ap_10
        NTC_Num_TmpMonRunTimeFlt: DiagMgrNTC=65, DiagMgrEventKind=DIAGMGR_EVENT_KIND_SWC, OsApplicationRef=Ap_10
        NTC_Num_PowerRelayInitFlt: DiagMgrNTC=66, DiagMgrEventKind=DIAGMGR_EVENT_KIND_SWC, OsApplicationRef=Ap_9
        NTC_Num_PrechargeFailure: DiagMgrNTC=67, DiagMgrEventKind=DIAGMGR_EVENT_KIND_SWC, OsApplicationRef=Ap_9
        NTC_Num_PowerRelayRunFlt: DiagMgrNTC=68, DiagMgrEventKind=DIAGMGR_EVENT_KIND_SWC, OsApplicationRef=Ap_9
        NTC_Num_Thermistor: DiagMgrNTC=69, DiagMgrEventKind=DIAGMGR_EVENT_KIND_SWC, OsApplicationRef=Ap_9
        NTC_Num_RefSupplyVltg: DiagMgrNTC=70, DiagMgrEventKind=DIAGMGR_EVENT_KIND_SWC, OsApplicationRef=Ap_10
        NTC_Num_CPUSupplyOvervoltage: DiagMgrNTC=72, DiagMgrEventKind=DIAGMGR_EVENT_KIND_SWC, OsApplicationRef=Ap_10
        NTC_Num_GateDrvFltInProcess: DiagMgrNTC=76, DiagMgrEventKind=DIAGMGR_EVENT_KIND_SWC, OsApplicationRef=Ap_10
        NTC_Num_GateDrvFlt: DiagMgrNTC=77, DiagMgrEventKind=DIAGMGR_EVENT_KIND_SWC, OsApplicationRef=Ap_10
        NTC_Num_OnStateSingleFET: DiagMgrNTC=78, DiagMgrEventKind=DIAGMGR_EVENT_KIND_SWC, OsApplicationRef=Ap_10
        NTC_Num_OnStateMultiFET: DiagMgrNTC=79, DiagMgrEventKind=DIAGMGR_EVENT_KIND_SWC, OsApplicationRef=Ap_10
        NTC_Num_DigPhaseVoltageVerf: DiagMgrNTC=82, DiagMgrEventKind=DIAGMGR_EVENT_KIND_SWC, OsApplicationRef=Ap_10
        NTC_Num_CurrentMeasCrossChk: DiagMgrNTC=86, DiagMgrEventKind=DIAGMGR_EVENT_KIND_SWC, OsApplicationRef=Ap_10
        NTC_Num_T1vsT2: DiagMgrNTC=101, DiagMgrEventKind=DIAGMGR_EVENT_KIND_SWC, OsApplicationRef=Ap_10
        NTC_Num_T1OutofRange: DiagMgrNTC=102, DiagMgrEventKind=DIAGMGR_EVENT_KIND_SWC, OsApplicationRef=Ap_10
        NTC_Num_T2OutofRange: DiagMgrNTC=103, DiagMgrEventKind=DIAGMGR_EVENT_KIND_SWC, OsApplicationRef=Ap_10
        NTC_Num_HWACrossChecks: DiagMgrNTC=108, DiagMgrEventKind=DIAGMGR_EVENT_KIND_SWC, OsApplicationRef=Ap_10
        NTC_Num_HWASnsrCommFault: DiagMgrNTC=109, DiagMgrEventKind=DIAGMGR_EVENT_KIND_SWC, OsApplicationRef=Ap_10
        NTC_Num_HWASensorRel: DiagMgrNTC=110, DiagMgrEventKind=DIAGMGR_EVENT_KIND_SWC, OsApplicationRef=Ap_10
        NTC_Num_HWASensorAbs: DiagMgrNTC=111, DiagMgrEventKind=DIAGMGR_EVENT_KIND_SWC, OsApplicationRef=Ap_10
        NTC_Num_PriMSB_SinCosCorr: DiagMgrNTC=112, DiagMgrEventKind=DIAGMGR_EVENT_KIND_SWC, OsApplicationRef=Ap_10
        NTC_Num_SecMSB_SinCosCorr: DiagMgrNTC=113, DiagMgrEventKind=DIAGMGR_EVENT_KIND_SWC, OsApplicationRef=Ap_10
        NTC_Num_PriVsSec_SinCosCorr: DiagMgrNTC=114, DiagMgrEventKind=DIAGMGR_EVENT_KIND_SWC, OsApplicationRef=Ap_10
        NTC_Num_DigMSBFlt: DiagMgrNTC=115, DiagMgrEventKind=DIAGMGR_EVENT_KIND_SWC, OsApplicationRef=Ap_10
        NTC_Num_MtrVelFlt: DiagMgrNTC=116, DiagMgrEventKind=DIAGMGR_EVENT_KIND_SWC, OsApplicationRef=Ap_10
        NTC_Num_HWAtoMtrAngleCorr: DiagMgrNTC=117, DiagMgrEventKind=DIAGMGR_EVENT_KIND_SWC, OsApplicationRef=Ap_10
        NTC_Num_RedPriVsSec_SinCosCorr: DiagMgrNTC=118, DiagMgrEventKind=DIAGMGR_EVENT_KIND_SWC, OsApplicationRef=Ap_10
        NTC_Num_TurnCntr_PosLoss: DiagMgrNTC=128, DiagMgrEventKind=DIAGMGR_EVENT_KIND_SWC, OsApplicationRef=Ap_10
        NTC_Num_TurnCntr_SensorPosFlt: DiagMgrNTC=130, DiagMgrEventKind=DIAGMGR_EVENT_KIND_SWC, OsApplicationRef=Ap_10
        NTC_Num_TurnCntr_MainResets: DiagMgrNTC=133, DiagMgrEventKind=DIAGMGR_EVENT_KIND_SWC, OsApplicationRef=Ap_10
        NTC_Num_KinematicIntDiag: DiagMgrNTC=144, DiagMgrEventKind=DIAGMGR_EVENT_KIND_SWC, OsApplicationRef=Ap_10
        NTC_Num_HighFriction: DiagMgrNTC=145, DiagMgrEventKind=DIAGMGR_EVENT_KIND_SWC, OsApplicationRef=Ap_9
        NTC_Num_DutyCycleExceeded: DiagMgrNTC=148, DiagMgrEventKind=DIAGMGR_EVENT_KIND_SWC, OsApplicationRef=Ap_9
        NTC_Num_AbsTempThermLimit: DiagMgrNTC=149, DiagMgrEventKind=DIAGMGR_EVENT_KIND_SWC, OsApplicationRef=Ap_9
        NTC_Num_LatchActive: DiagMgrNTC=160, DiagMgrEventKind=DIAGMGR_EVENT_KIND_SWC, OsApplicationRef=Ap_9
        NTC_Num_CurrentReas: DiagMgrNTC=169, DiagMgrEventKind=DIAGMGR_EVENT_KIND_SWC, OsApplicationRef=Ap_10
        NTC_Num_OpVoltage: DiagMgrNTC=176, DiagMgrEventKind=DIAGMGR_EVENT_KIND_SWC, OsApplicationRef=Ap_9
        NTC_Num_ReducedAsstLowVoltage: DiagMgrNTC=178, DiagMgrEventKind=DIAGMGR_EVENT_KIND_SWC, OsApplicationRef=Ap_10
        NTC_Num_OpVoltageOvrMax: DiagMgrNTC=181, DiagMgrEventKind=DIAGMGR_EVENT_KIND_SWC, OsApplicationRef=Ap_9
        NTC_Num_BattTransOverVolt: DiagMgrNTC=182, DiagMgrEventKind=DIAGMGR_EVENT_KIND_SWC, OsApplicationRef=Ap_10
        NTC_Num_TurnCntr_LowBattery: DiagMgrNTC=185, DiagMgrEventKind=DIAGMGR_EVENT_KIND_SWC, OsApplicationRef=Ap_10
        NTC_Num_EEPROMCloseFailed: DiagMgrNTC=191, DiagMgrEventKind=DIAGMGR_EVENT_KIND_SWC, OsApplicationRef=Ap_10
        NTC_Num_SigPath1CrossChk: DiagMgrNTC=192, DiagMgrEventKind=DIAGMGR_EVENT_KIND_SWC, OsApplicationRef=Ap_10
        NTC_Num_DampingFWReached: DiagMgrNTC=197, DiagMgrEventKind=DIAGMGR_EVENT_KIND_SWC, OsApplicationRef=Ap_10
        NTC_Num_AssistFWReached: DiagMgrNTC=198, DiagMgrEventKind=DIAGMGR_EVENT_KIND_SWC, OsApplicationRef=Ap_10
        NTC_Num_ReturnFWReached: DiagMgrNTC=199, DiagMgrEventKind=DIAGMGR_EVENT_KIND_SWC, OsApplicationRef=Ap_10
        NTC_Num_DampingFWFltMode: DiagMgrNTC=200, DiagMgrEventKind=DIAGMGR_EVENT_KIND_SWC, OsApplicationRef=Ap_10
        NTC_Num_AssistFWFltMode: DiagMgrNTC=201, DiagMgrEventKind=DIAGMGR_EVENT_KIND_SWC, OsApplicationRef=Ap_10
        NTC_Num_VBICFltMode: DiagMgrNTC=202, DiagMgrEventKind=DIAGMGR_EVENT_KIND_SWC, OsApplicationRef=Ap_10
        NTC_Num_StaMdsSysC: DiagMgrNTC=203, DiagMgrEventKind=DIAGMGR_EVENT_KIND_SWC, OsApplicationRef=Ap_8
        NTC_NUM_SysFailureForRotVel: DiagMgrNTC=204, DiagMgrEventKind=DIAGMGR_EVENT_KIND_BSW, OsApplicationRef=Ap_10
        NTC_NUM_SysFailForRedntRotVel: DiagMgrNTC=205, DiagMgrEventKind=DIAGMGR_EVENT_KIND_BSW, OsApplicationRef=Ap_8
        NTC_NUM_SysFailureForCtrlVolt: DiagMgrNTC=209, DiagMgrEventKind=DIAGMGR_EVENT_KIND_SWC, OsApplicationRef=Ap_10
        NTC_Num_GlblSgnlOvrwrtDet: DiagMgrNTC=223, DiagMgrEventKind=DIAGMGR_EVENT_KIND_SWC, OsApplicationRef=Ap_10
        NTC_Num_BusOffCh1: DiagMgrNTC=256, DiagMgrEventKind=DIAGMGR_EVENT_KIND_SWC, OsApplicationRef=Ap_9
        NTC_Num_Node1AAbsent: DiagMgrNTC=258, DiagMgrEventKind=DIAGMGR_EVENT_KIND_SWC, OsApplicationRef=Ap_9
        NTC_Num_Node1AFaulty: DiagMgrNTC=259, DiagMgrEventKind=DIAGMGR_EVENT_KIND_SWC, OsApplicationRef=Ap_9
        NTC_Num_Node1BAbsent: DiagMgrNTC=260, DiagMgrEventKind=DIAGMGR_EVENT_KIND_SWC, OsApplicationRef=Ap_9
        NTC_Num_Node1BFaulty: DiagMgrNTC=261, DiagMgrEventKind=DIAGMGR_EVENT_KIND_SWC, OsApplicationRef=Ap_9
        NTC_Num_Node1CAbsent: DiagMgrNTC=262, DiagMgrEventKind=DIAGMGR_EVENT_KIND_SWC, OsApplicationRef=Ap_9
        NTC_Num_Node1DAbsent: DiagMgrNTC=264, DiagMgrEventKind=DIAGMGR_EVENT_KIND_SWC, OsApplicationRef=Ap_9
        NTC_Num_InvalidMsg_M: DiagMgrNTC=288, DiagMgrEventKind=DIAGMGR_EVENT_KIND_SWC, OsApplicationRef=Ap_9
        NTC_Num_MissingMsg_M: DiagMgrNTC=289, DiagMgrEventKind=DIAGMGR_EVENT_KIND_SWC, OsApplicationRef=Ap_9
        NTC_Num_InvalidMsg_N: DiagMgrNTC=296, DiagMgrEventKind=DIAGMGR_EVENT_KIND_SWC, OsApplicationRef=Ap_9
        NTC_Num_MissingMsg_N: DiagMgrNTC=297, DiagMgrEventKind=DIAGMGR_EVENT_KIND_SWC, OsApplicationRef=Ap_9
        NTC_Num_CRCFltMsg_N: DiagMgrNTC=298, DiagMgrEventKind=DIAGMGR_EVENT_KIND_SWC, OsApplicationRef=Ap_9
        NTC_Num_PgrsCntFltMsg_N: DiagMgrNTC=299, DiagMgrEventKind=DIAGMGR_EVENT_KIND_SWC, OsApplicationRef=Ap_9
        NTC_Num_InvalidMsg_O: DiagMgrNTC=304, DiagMgrEventKind=DIAGMGR_EVENT_KIND_SWC, OsApplicationRef=Ap_9
        NTC_Num_MissingMsg_O: DiagMgrNTC=305, DiagMgrEventKind=DIAGMGR_EVENT_KIND_SWC, OsApplicationRef=Ap_9
        NTC_Num_InvalidMsg_P: DiagMgrNTC=312, DiagMgrEventKind=DIAGMGR_EVENT_KIND_SWC, OsApplicationRef=Ap_9
        NTC_Num_MissingMsg_P: DiagMgrNTC=313, DiagMgrEventKind=DIAGMGR_EVENT_KIND_SWC, OsApplicationRef=Ap_9
        NTC_Num_InvalidMsg_Q: DiagMgrNTC=320, DiagMgrEventKind=DIAGMGR_EVENT_KIND_SWC, OsApplicationRef=Ap_9
        NTC_Num_MissingMsg_Q: DiagMgrNTC=321, DiagMgrEventKind=DIAGMGR_EVENT_KIND_SWC, OsApplicationRef=Ap_9
        NTC_Num_InvalidMsg_R: DiagMgrNTC=328, DiagMgrEventKind=DIAGMGR_EVENT_KIND_SWC, OsApplicationRef=Ap_9
        NTC_Num_MissingMsg_R: DiagMgrNTC=329, DiagMgrEventKind=DIAGMGR_EVENT_KIND_SWC, OsApplicationRef=Ap_9
        NTC_Num_MissingMsg_S: DiagMgrNTC=337, DiagMgrEventKind=DIAGMGR_EVENT_KIND_SWC, OsApplicationRef=Ap_9
        NTC_Num_MissingMsg_T: DiagMgrNTC=345, DiagMgrEventKind=DIAGMGR_EVENT_KIND_SWC, OsApplicationRef=Ap_9
        NTC_Num_EOLVehTunNtPerf: DiagMgrNTC=501, DiagMgrEventKind=DIAGMGR_EVENT_KIND_SWC, OsApplicationRef=Ap_9
        NTC_Num_HWASensorNotTrimmed: DiagMgrNTC=504, DiagMgrEventKind=DIAGMGR_EVENT_KIND_SWC, OsApplicationRef=Ap_10
        NTC_Num_TrqSensorNotTrimmed: DiagMgrNTC=507, DiagMgrEventKind=DIAGMGR_EVENT_KIND_SWC, OsApplicationRef=Ap_10
    DiagMgrGeneral:
      DiagMgrIsMtoProgram = false
      DiagMgrDevErrorDetect = true
      DiagMgrVersionInfoApi = false
      DiagMgrRecoverPeriod = 0.1
      DiagMgrFailPeriod = 0.002
      DiagMgrDemIfPeriod = 0.1
      NumOfDemEvents = 40
      DiagMgrDemIfOsAppRef = Ap_9
      DiagMgrFailActionOsAppRef = Ap_10
    CommonPublishedInformation: ArMajorVersion=3, ArMinorVersion=2, ArPatchVersion=0, SwMajorVersion=0, SwMinorVersion=0, SwPatchVersion=0, ModuleId=0, VendorId=0
  module config DigHwTrqSENT: implementation-config-variant=VARIANT-POST-BUILD
    DigHwTrqSENTGeneral
    CommonPublishedInformation: ArMajorVersion=3, ArMinorVersion=2, ArPatchVersion=0, SwMajorVersion=0, SwMinorVersion=0, SwPatchVersion=0, ModuleId=0, VendorId=0
  module config DigMSB: implementation-config-variant=VARIANT-POST-BUILD
    DigMSBGeneral
    CommonPublishedInformation: ArMajorVersion=3, ArMinorVersion=2, ArPatchVersion=0, SwMajorVersion=0, SwMinorVersion=0, SwPatchVersion=0, ModuleId=0, VendorId=0
  module config DigPhsReasDiag: implementation-config-variant=VARIANT-POST-BUILD
    DigPhsReasDiagGeneral: NHETFREQUENCY_HZ=80000000, MAXPWMFREQ_HZ=18000
    CommonPublishedInformation: ArMajorVersion=3, ArMinorVersion=2, ArPatchVersion=0, SwMajorVersion=0, SwMinorVersion=0, SwPatchVersion=0, ModuleId=0, VendorId=0
  module config Dio: implementation-config-variant=VARIANT-LINK-TIME, module-description=Dio_Impl
    DioGeneral:
      DioDevErrorDetect = true
      DioVersionInfoApi = true
      DioMaskedWritePortApi = false
      DioCfgSupportGio = true
      DioCfgSupportCan = true
      DioCfgDoParamCheck = true
      DioCfgReportDet = true
      DioCfgChkParamChannel = true
      DioCfgChkParamPort = true
      DioCfgChkParamGroup = true
      DioCfgChkParamVinfo = true
      DioReportDet = Det_ReportError
      DioCfgIncludeDet = Det.h
      DioCfgChannelApi = true
      DioCfgPortApi = true
      DioCfgGroupApi = true
      DioSpecialRegisterAccessEnabled = true
      DioSpecialRegisterAccessOnlyForWrite = true
      DioSpecialRegisterAccessOnlyForPrivilegedModeRegisters = true
      DioIrqHandling = SuspendAllInterrupts
    DioVectorCommonData (VectorCommonData): BswmdVersion=2.01.00
    DioPackageMapping337 (DioPackageMapping): DioPackageName=Pin_337, DioPortDefMaskName=DIO_PORT_DEF_MASK_IN_PKG_A
    DioPackageMapping144 (DioPackageMapping): DioPackageName=Pin_144, DioPortDefMaskName=DIO_PORT_DEF_MASK_IN_PKG_B
    24 x DioPortDefinition, all with DioPortDefMaskInPkgC=0, DioPortDefMaskInPkgD=0, DioPortDefMaskInPkgE=0, DioPortDefMaskInPkgF=0, DioPortDefMaskInPkgG=0, DioPortDefMaskInPkgH=0, DioPortDefMaskInPkgI=0, DioPortDefMaskInPkgJ=0:
      DioPortGioA: DioPortDefName=GIOA, DioPortDefPortId=12046, DioPortDefMaskInPkgA=255, DioPortDefMaskInPkgB=231
      DioPortGioB: DioPortDefName=GIOB, DioPortDefPortId=12054, DioPortDefMaskInPkgA=255, DioPortDefMaskInPkgB=255
      DioPortNHet1: DioPortDefName=NHET1, DioPortDefPortId=11796, DioPortDefMaskInPkgA=4294967295, DioPortDefMaskInPkgB=4292870143
      DioPortNHet2: DioPortDefName=NHET2, DioPortDefPortId=11860, DioPortDefMaskInPkgA=393215, DioPortDefMaskInPkgB=2796171
      DioPortCan1Tx: DioPortDefName=CAN1, DioPortDefPortId=79736, DioPortDefMaskInPkgA=1, DioPortDefMaskInPkgB=1
      DioPortCan1Rx: DioPortDefName=CAN1, DioPortDefPortId=79737, DioPortDefMaskInPkgA=1, DioPortDefMaskInPkgB=1
      DioPortCan2Tx: DioPortDefName=CAN2, DioPortDefPortId=79864, DioPortDefMaskInPkgA=1, DioPortDefMaskInPkgB=1
      DioPortCan2Rx: DioPortDefName=CAN2, DioPortDefPortId=79865, DioPortDefMaskInPkgA=1, DioPortDefMaskInPkgB=1
      DioPortCan3Tx: DioPortDefName=CAN3, DioPortDefPortId=79992, DioPortDefMaskInPkgA=1, DioPortDefMaskInPkgB=1
      DioPortCan3Rx: DioPortDefName=CAN3, DioPortDefPortId=79993, DioPortDefMaskInPkgA=1, DioPortDefMaskInPkgB=1
      DioPortAdc1: DioPortDefName=ADC1, DioPortDefPortId=274496, DioPortDefMaskInPkgA=1, DioPortDefMaskInPkgB=1
      DioPortAdc2: DioPortDefName=ADC2, DioPortDefPortId=274624, DioPortDefMaskInPkgA=1, DioPortDefMaskInPkgB=1
      DioPortLin: DioPortDefName=LIN, DioPortDefPortId=14609, DioPortDefMaskInPkgA=6, DioPortDefMaskInPkgB=6
      DioPortSci: DioPortDefName=SCI, DioPortDefPortId=14673, DioPortDefMaskInPkgA=6, DioPortDefMaskInPkgB=6
      DioPortIic: DioPortDefName=IIC, DioPortDefPortId=13588, DioPortDefMaskInPkgA=3, DioPortDefMaskInPkgB=3
      DioPortSpi1: DioPortDefName=SPI1, DioPortDefPortId=15623, DioPortDefMaskInPkgA=33689407, DioPortDefMaskInPkgB=33689399
      DioPortSpi2: DioPortDefName=SPI2, DioPortDefPortId=15751, DioPortDefMaskInPkgA=3843, DioPortDefMaskInPkgB=0
      DioPortSpi3: DioPortDefName=SPI3, DioPortDefPortId=15879, DioPortDefMaskInPkgA=3903, DioPortDefMaskInPkgB=3903
      DioPortSpi4: DioPortDefName=SPI4, DioPortDefPortId=16007, DioPortDefMaskInPkgA=3841, DioPortDefMaskInPkgB=3841
      DioPortSpi5: DioPortDefName=SPI5, DioPortDefPortId=16135, DioPortDefMaskInPkgA=235802383, DioPortDefMaskInPkgB=3841
      DioPortRtp: DioPortDefName=RTP, DioPortDefPortId=147087, DioPortDefMaskInPkgA=524287, DioPortDefMaskInPkgB=0
      DioPortEclk: DioPortDefName=SYS, DioPortDefPortId=147394, DioPortDefMaskInPkgA=1, DioPortDefMaskInPkgB=1
      DioPortDmm: DioPortDefName=DMMDATA, DioPortDefPortId=146909, DioPortDefMaskInPkgA=524287, DioPortDefMaskInPkgB=36224
      DioPortEsm: DioPortDefName=ESMEPSR, DioPortDefPortId=146761, DioPortDefMaskInPkgA=1, DioPortDefMaskInPkgB=1
    6 x DioPort, all with DioPortId=0:
      NHet: DioPortDefRef=DioPortNHet1
        7 x DioChannel:
          NHet_Ch4: DioChannelId=4
          NHet_Ch8: DioChannelId=8
          NHet_Ch15: DioChannelId=15
          NHet_Ch20: DioChannelId=20
          NHet_Ch22: DioChannelId=22
          NHet_Ch24: DioChannelId=24
          NHet_Ch26: DioChannelId=26
        DioChGrpNHet (DioChannelGroup): DioChannelGroupIdentification=&DioChGrpNHet, DioPortMask=1, DioPortOffset=0
      Adc1: DioPortDefRef=DioPortAdc1
        ADC1_Ch0 (DioChannel): DioChannelId=0
        DioChannelGroupAdc1 (DioChannelGroup): DioChannelGroupIdentification=&DioChannelGroupAdc1, DioPortMask=1, DioPortOffset=0
      Spi3: DioPortDefRef=DioPortSpi3
        SPI3_NCS1 (DioChannel): DioChannelId=1
        DioChannelGroupSpi3 (DioChannelGroup): DioChannelGroupIdentification=&DioChannelGroupSpi3, DioPortMask=1, DioPortOffset=0
      CAN3_Rx: DioPortDefRef=DioPortCan3Rx
        Can3Rx (DioChannel): DioChannelId=0
        DioChannelGroupCan3Rx (DioChannelGroup): DioChannelGroupIdentification=&DioChannelGroupCan3Rx, DioPortMask=1, DioPortOffset=0
      CAN3_Tx: DioPortDefRef=DioPortCan3Tx
        Can3Tx (DioChannel): DioChannelId=0
        DioChannelGroupCan3Tx (DioChannelGroup): DioChannelGroupIdentification=&DioChannelGroupCan3Tx, DioPortMask=1, DioPortOffset=0
      Esm: DioPortDefRef=DioPortEsm
        nERROR (DioChannel): DioChannelId=0
        DioChannelGroupEsm (DioChannelGroup): DioChannelGroupIdentification=&DioChannelGroupEsm, DioPortMask=1, DioPortOffset=0
  module config ElePwr: implementation-config-variant=VARIANT-POST-BUILD
    ElePwrGeneral
    CommonPublishedInformation: ArMajorVersion=3, ArMinorVersion=2, ArPatchVersion=0, SwMajorVersion=0, SwMinorVersion=0, SwPatchVersion=0, ModuleId=0, VendorId=0
  module config EOTActuatorMng: implementation-config-variant=VARIANT-POST-BUILD
    EOTActuatorMngGeneral
    CommonPublishedInformation: ArMajorVersion=3, ArMinorVersion=2, ArPatchVersion=0, SwMajorVersion=0, SwMinorVersion=0, SwPatchVersion=0, ModuleId=0, VendorId=0
  module config EtDmpFw: implementation-config-variant=VARIANT-POST-BUILD
    EtDmpFwGeneral
    CommonPublishedInformation: ArMajorVersion=3, ArMinorVersion=2, ArPatchVersion=0, SwMajorVersion=0, SwMinorVersion=0, SwPatchVersion=0, ModuleId=0, VendorId=0
  module config Fee: implementation-config-variant=VARIANT-PRE-COMPILE, module-description=BSWMD
    FeePublishedInformation:
      FeeBlockOverhead = 24
      FeeMaximumBlockingTime = 600
      FeePageOverhead = 0
      FeeVirtualSectorOverhead = 16
      FeeIncludeFile = Fee.h
      FeeSetModeApi = Fee_SetMode
      FeeReadApi = Fee_Read
      FeeWriteApi = Fee_Write
      FeeCancelApi = Fee_Cancel
      FeeGetStatusApi = Fee_GetStatus
      FeeGetJobResultApi = Fee_GetJobResult
      FeeEraseImmediateBlockApi = Fee_EraseImmediateBlock
      FeeInvalidateBlockApi = Fee_InvalidateBlock
    FeeGeneral:
      FeeDevErrorDetect = false
      FeeDeviceIndex = 0
      FeeNvmJobEndNotification = NvM_JobEndNotification
      FeeNvmJobErrorNotification = NvM_JobErrorNotification
      FeePollingMode = true
      FeeVersionInfoApi = false
      FeeEnableErrorCorrection = false
      FeeVirtualPageSize = 8
      FeeFrequency = 160
      FeeCRCEnable = false
      FeeWriteCounterSave = false
      FeeNumberOfVirtualSectors = 4
      FeeNumberOfVirtualSectorsEEP1 = 2
      FeeNumberOfUnconfiguredBlocksToCopy = 20
      FeeNumberOfEightByteWrites = 128
      FeeCheckBank7Access = false
      FeeGenerateDeviceandvirtualsectorstruc = true
      FeeVirtualsectorSize = VS_16
      FeePhysicalsectorSize = PS_4
    110 x FeeBlockConfiguration, all with FeeImmediateData=false, FeeNumberOfWriteCycles=1, FeeDeviceIndex=0:
      FeeBlockConfiguration42: FeeDataset=2, FeeBlockNumber=32, FeeBlockSize=4, FeeBlockName=Fee_Block_ConfigBlock, FeeBlockConfiguration=1, FeeEEPNumber=0
        Fee
          FeeBlockConfiguration: FeeNvmBlockName=ConfigBlock
      FeeBlockConfiguration44: FeeDataset=1, FeeBlockNumber=64, FeeBlockSize=4102, FeeBlockName=Fee_Block_DigMSB_DigMSBEOLData, FeeBlockConfiguration=2, FeeEEPNumber=0
        Fee
          FeeBlockConfiguration: FeeNvmBlockName=Rte_NvmBlock_DigMSB_DigMSBEOLData
      FeeBlockConfiguration45: FeeDataset=1, FeeBlockNumber=96, FeeBlockSize=5, FeeBlockName=Deprecated_Block_DigHwTrqSENT_DigTrqTrim, FeeBlockConfiguration=3, FeeEEPNumber=0
        Fee
          FeeBlockConfiguration: FeeNvmBlockName=Deprecated_NvmBlock_DigHwTrqSENT_DigTrqTrim
      FeeBlockConfiguration4: FeeDataset=1, FeeBlockNumber=128, FeeBlockSize=4, FeeBlockName=Fee_Block_Polarity_Polarity_Cnt_Str, FeeBlockConfiguration=4, FeeEEPNumber=0
        Fee
          FeeBlockConfiguration: FeeNvmBlockName=Rte_NvmBlock_Polarity_Polarity_Cnt_Str
      FeeBlockConfiguration7: FeeDataset=1, FeeBlockNumber=160, FeeBlockSize=4, FeeBlockName=Fee_Block_EpsDefeats, FeeBlockConfiguration=5, FeeEEPNumber=0
        Fee
          FeeBlockConfiguration: FeeNvmBlockName=NVM_BLOCK_EPSDEFEATS
      FeeBlockConfiguration54: FeeDataset=1, FeeBlockNumber=192, FeeBlockSize=96, FeeBlockName=Fee_Block_CmMtrCurr_CurrTempOffset, FeeBlockConfiguration=6, FeeEEPNumber=0
        Fee
          FeeBlockConfiguration: FeeNvmBlockName=Rte_NvmBlock_CmMtrCurr_CurrTempOffset
      FeeBlockConfiguration12: FeeDataset=1, FeeBlockNumber=224, FeeBlockSize=28, FeeBlockName=Deprecated_Block_CmMtrCurr_ShCurrCal, FeeBlockConfiguration=7, FeeEEPNumber=0
        Fee
          FeeBlockConfiguration: FeeNvmBlockName=Deprecated_NvmBlock_CmMtrCurr_ShCurrCal
      FeeBlockConfiguration13: FeeDataset=1, FeeBlockNumber=256, FeeBlockSize=8, FeeBlockName=Fee_Block_CurrParamComp_EOLNomMtrParam, FeeBlockConfiguration=8, FeeEEPNumber=0
        Fee
          FeeBlockConfiguration: FeeNvmBlockName=Rte_NvmBlock_CurrParamComp_EOLNomMtrParam
      FeeBlockConfiguration15: FeeDataset=1, FeeBlockNumber=288, FeeBlockSize=1024, FeeBlockName=Deprecated_Block_TrqCanc_CogTrqCal, FeeBlockConfiguration=9, FeeEEPNumber=0
        Fee
          FeeBlockConfiguration: FeeNvmBlockName=Deprecated_NvmBlock_TrqCanc_CogTrqCal
      FeeBlockConfiguration33: FeeDataset=1, FeeBlockNumber=320, FeeBlockSize=1, FeeBlockName=Fee_Block_CMS_NxtrMEC, FeeBlockConfiguration=10, FeeEEPNumber=0
        Fee
          FeeBlockConfiguration: FeeNvmBlockName=NVM_BLOCK_CMS_NXTRMEC
      FeeBlockConfiguration34: FeeDataset=1, FeeBlockNumber=352, FeeBlockSize=4, FeeBlockName=Fee_Block_CMS_EcuSrlNum, FeeBlockConfiguration=11, FeeEEPNumber=0
        Fee
          FeeBlockConfiguration: FeeNvmBlockName=NVM_BLOCK_CMS_ECUSRLNUM
      FeeBlockConfiguration35: FeeDataset=1, FeeBlockNumber=384, FeeBlockSize=4, FeeBlockName=Fee_Block_CMS_EpsSrlNum, FeeBlockConfiguration=12, FeeEEPNumber=0
        Fee
          FeeBlockConfiguration: FeeNvmBlockName=NVM_BLOCK_CMS_EPSSRLNUM
      FeeBlockConfiguration36: FeeDataset=1, FeeBlockNumber=416, FeeBlockSize=12, FeeBlockName=Fee_Block_CMS_EcuHwPN, FeeBlockConfiguration=13, FeeEEPNumber=0
        Fee
          FeeBlockConfiguration: FeeNvmBlockName=NVM_BLOCK_CMS_ECUHWPN
      FeeBlockConfiguration37: FeeDataset=1, FeeBlockNumber=448, FeeBlockSize=64, FeeBlockName=Fee_Block_CMS_NxtrManufScratchpad, FeeBlockConfiguration=14, FeeEEPNumber=0
        Fee
          FeeBlockConfiguration: FeeNvmBlockName=NVM_BLOCK_CMS_NXTRMANUFSCRATCHPAD
      FeeBlockConfiguration38: FeeDataset=1, FeeBlockNumber=480, FeeBlockSize=2, FeeBlockName=Fee_Block_CMS_IgnCntr, FeeBlockConfiguration=15, FeeEEPNumber=1
        Fee
          FeeBlockConfiguration: FeeNvmBlockName=NVM_BLOCK_CMS_IGNCNTR
      FeeBlockConfiguration6: FeeDataset=1, FeeBlockNumber=512, FeeBlockSize=60, FeeBlockName=Fee_Block_DiagMgr_NTCStrg, FeeBlockConfiguration=16, FeeEEPNumber=1
        Fee
          FeeBlockConfiguration: FeeNvmBlockName=NVM_BLOCK_DIAGMGR_NTCSTRG
      FeeBlockConfiguration40: FeeDataset=1, FeeBlockNumber=544, FeeBlockSize=192, FeeBlockName=Fee_Block_DiagMgr_Blackbox, FeeBlockConfiguration=17, FeeEEPNumber=1
        Fee
          FeeBlockConfiguration: FeeNvmBlockName=NVM_BLOCK_DIAGMGR_BLACKBOX
      FeeBlockConfiguration10: FeeDataset=1, FeeBlockNumber=576, FeeBlockSize=4, FeeBlockName=Deprecated_Block_TrqCmdScl_TorqueCmdSF_Uls_f32, FeeBlockConfiguration=18, FeeEEPNumber=1
        Fee
          FeeBlockConfiguration: FeeNvmBlockName=Deprecated_NvmBlock_TrqCmdScl_TorqueCmdSF_Uls_f32
      FeeBlockConfiguration14: FeeDataset=1, FeeBlockNumber=608, FeeBlockSize=10, FeeBlockName=Deprecated_Block_LrnEOT_LearnedEOT, FeeBlockConfiguration=19, FeeEEPNumber=1
        Fee
          FeeBlockConfiguration: FeeNvmBlockName=Deprecated_NvmBlock_LrnEOT_LearnedEOT
      FeeBlockConfiguration41: FeeDataset=1, FeeBlockNumber=640, FeeBlockSize=203, FeeBlockName=Deprecated_Block_AvgFricLrn_AvgFricLrnData, FeeBlockConfiguration=20, FeeEEPNumber=1
        Fee
          FeeBlockConfiguration: FeeNvmBlockName=Deprecated_NvmBlock_AvgFricLrn_AvgFricLrnData
      FeeBlockConfiguration43: FeeDataset=1, FeeBlockNumber=672, FeeBlockSize=6, FeeBlockName=Fee_Block_BatteryVoltage_OvervoltageData, FeeBlockConfiguration=21, FeeEEPNumber=1
        Fee
          FeeBlockConfiguration: FeeNvmBlockName=Rte_NvmBlock_BatteryVoltage_OvervoltageData
      FeeBlockConfiguration39: FeeDataset=1, FeeBlockNumber=704, FeeBlockSize=4, FeeBlockName=Fee_Block_StaMd_CloseCheckData, FeeBlockConfiguration=22, FeeEEPNumber=1
        Fee
          FeeBlockConfiguration: FeeNvmBlockName=Rte_NvmBlock_StaMd_CloseCheckData
      FeeBlockConfiguration9: FeeDataset=1, FeeBlockNumber=736, FeeBlockSize=100, FeeBlockName=Fee_Block_StaMd_TypeHRamBuffer, FeeBlockConfiguration=23, FeeEEPNumber=1
        Fee
          FeeBlockConfiguration: FeeNvmBlockName=Rte_NvmBlock_StaMd_TypeHRamBuffer
      FeeBlockConfiguration8: FeeDataset=1, FeeBlockNumber=768, FeeBlockSize=245, FeeBlockName=Fee_Block_Dem, FeeBlockConfiguration=24, FeeEEPNumber=1
        Fee
          FeeBlockConfiguration: FeeNvmBlockName=NvM_NVM_BLOCK_DEM
      FeeBlockConfiguration48: FeeDataset=1, FeeBlockNumber=800, FeeBlockSize=5, FeeBlockName=Deprecated_Block_AbsHwPos_EOLVehCntrOffset, FeeBlockConfiguration=25, FeeEEPNumber=1
        Fee
          FeeBlockConfiguration: FeeNvmBlockName=Deprecated_NvmBlock_AbsHwPos_EOLVehCntrOffset
      FeeBlockConfiguration47: FeeDataset=1, FeeBlockNumber=832, FeeBlockSize=2, FeeBlockName=Fee_Block_DiagSvc_TuningSetSelect, FeeBlockConfiguration=26, FeeEEPNumber=0
        Fee
          FeeBlockConfiguration: FeeNvmBlockName=Rte_NvmBlock_DiagSvc_TuningSetSelectData
      FeeBlockConfiguration46: FeeDataset=1, FeeBlockNumber=864, FeeBlockSize=6, FeeBlockName=Deprecated_Block_AbsHwPos_EOLVehCntrOffset1, FeeBlockConfiguration=27, FeeEEPNumber=1
        Fee
          FeeBlockConfiguration: FeeNvmBlockName=Deprecated_NvmBlock_AbsHwPos_EOLVehCntrOffset1
      FeeBlockConfiguration49: FeeDataset=1, FeeBlockNumber=896, FeeBlockSize=18, FeeBlockName=Deprecated_Block_TrqCanc_CogTrqRplComp, FeeBlockConfiguration=28, FeeEEPNumber=0
        Fee
          FeeBlockConfiguration: FeeNvmBlockName=Deprecated_NvmBlock_TrqCanc_CogTrqRplComp
      FeeBlockConfiguration58: FeeDataset=1, FeeBlockNumber=928, FeeBlockSize=1, FeeBlockName=Fee_Block_AstLmt_SteerAsstDefeat, FeeBlockConfiguration=29, FeeEEPNumber=0
        Fee
          FeeBlockConfiguration: FeeNvmBlockName=Rte_NvmBlock_AstLmt_SteerAsstDefeat
      FeeBlockConfiguration51: FeeDataset=1, FeeBlockNumber=960, FeeBlockSize=4, FeeBlockName=Fee_Block_ThrmlDutyCycle_FltStVal, FeeBlockConfiguration=30, FeeEEPNumber=1
        Fee
          FeeBlockConfiguration: FeeNvmBlockName=Rte_NvmBlock_ThrmlDutyCycle_ThrmlDutyCycle_FltStVal
      FeeBlockConfiguration52: FeeDataset=1, FeeBlockNumber=992, FeeBlockSize=16, FeeBlockName=Fee_Block_DiagMgr_LatchCntrs, FeeBlockConfiguration=31, FeeEEPNumber=1
        Fee
          FeeBlockConfiguration: FeeNvmBlockName=NVM_BLOCK_DIAGMGR_LATCHCNTRS
      FeeBlockConfiguration53: FeeDataset=1, FeeBlockNumber=1024, FeeBlockSize=10, FeeBlockName=Fee_Block_DigHwTrqSENT_DigTrqTrim, FeeBlockConfiguration=32, FeeEEPNumber=0
        Fee
          FeeBlockConfiguration: FeeNvmBlockName=Rte_NvmBlock_DigHwTrqSENT_DigTrqTrim
      FeeBlockConfiguration11: FeeDataset=1, FeeBlockNumber=1056, FeeBlockSize=98, FeeBlockName=Deprecated_Block_CmMtrCurr_CurrTempOffset, FeeBlockConfiguration=33, FeeEEPNumber=0
        Fee
          FeeBlockConfiguration: FeeNvmBlockName=Deprecated_NvmBlock_CmMtrCurr_CurrTempOffset
      FeeBlockConfiguration55: FeeDataset=1, FeeBlockNumber=1088, FeeBlockSize=30, FeeBlockName=Fee_Block_CmMtrCurr_ShCurrCal, FeeBlockConfiguration=34, FeeEEPNumber=0
        Fee
          FeeBlockConfiguration: FeeNvmBlockName=Rte_NvmBlock_CmMtrCurr_ShCurrCal
      FeeBlockConfiguration56: FeeDataset=1, FeeBlockNumber=1120, FeeBlockSize=1026, FeeBlockName=Fee_Block_TrqCanc_CogTrqCal, FeeBlockConfiguration=35, FeeEEPNumber=0
        Fee
          FeeBlockConfiguration: FeeNvmBlockName=Rte_NvmBlock_TrqCanc_CogTrqCal
      FeeBlockConfiguration57: FeeDataset=1, FeeBlockNumber=1152, FeeBlockSize=20, FeeBlockName=Fee_Block_TrqCanc_CogTrqRplComp, FeeBlockConfiguration=36, FeeEEPNumber=0
        Fee
          FeeBlockConfiguration: FeeNvmBlockName=Rte_NvmBlock_TrqCanc_CogTrqRplComp
      FeeBlockConfiguration50: FeeDataset=1, FeeBlockNumber=1184, FeeBlockSize=2, FeeBlockName=Deprecated_Block_AstLmt_SteerAsstDefeat, FeeBlockConfiguration=37, FeeEEPNumber=0
        Fee
          FeeBlockConfiguration: FeeNvmBlockName=Deprecated_NvmBlock_AstLmt_SteerAsstDefeat
      FeeBlockConfiguration59: FeeDataset=1, FeeBlockNumber=1216, FeeBlockSize=8, FeeBlockName=Fee_Block_TrqCmdScl_TorqueCmdSF_Uls_f32, FeeBlockConfiguration=38, FeeEEPNumber=1
        Fee
          FeeBlockConfiguration: FeeNvmBlockName=Rte_NvmBlock_TrqCmdScl_TorqueCmdSF_Uls_f32
      FeeBlockConfiguration60: FeeDataset=1, FeeBlockNumber=1248, FeeBlockSize=12, FeeBlockName=Fee_Block_LrnEOT_LearnedEOT, FeeBlockConfiguration=39, FeeEEPNumber=1
        Fee
          FeeBlockConfiguration: FeeNvmBlockName=Rte_NvmBlock_LrnEOT_LearnedEOT
      FeeBlockConfiguration61: FeeDataset=1, FeeBlockNumber=1280, FeeBlockSize=205, FeeBlockName=Fee_Block_AvgFricLrn_AvgFricLrnData, FeeBlockConfiguration=40, FeeEEPNumber=1
        Fee
          FeeBlockConfiguration: FeeNvmBlockName=Rte_NvmBlock_AvgFricLrn_AvgFricLrnData
      FeeBlockConfiguration62: FeeDataset=1, FeeBlockNumber=1312, FeeBlockSize=10, FeeBlockName=Fee_Block_AbsHwPos_EOLVehCntrOffset, FeeBlockConfiguration=41, FeeEEPNumber=1
        Fee
          FeeBlockConfiguration: FeeNvmBlockName=Rte_NvmBlock_AbsHwPos_EOLVehCntrOffset
      FeeBlockConfiguration63: FeeDataset=1, FeeBlockNumber=1344, FeeBlockSize=10, FeeBlockName=Fee_Block_Boot_SupplierIdentifier, FeeBlockConfiguration=42, FeeEEPNumber=0
        Fee
          FeeBlockConfiguration: FeeNvmBlockName=Rte_NvmBlock_Boot_SupplierIdentifierData
      FeeBlockConfiguration64: FeeDataset=1, FeeBlockNumber=1376, FeeBlockSize=10, FeeBlockName=Fee_Block_Boot_SparePartNumber, FeeBlockConfiguration=43, FeeEEPNumber=0
        Fee
          FeeBlockConfiguration: FeeNvmBlockName=Rte_NvmBlock_Boot_SparePartNumberData
      FeeBlockConfiguration65: FeeDataset=1, FeeBlockNumber=1408, FeeBlockSize=5, FeeBlockName=Fee_Block_VehDyn_MtrPosReset, FeeBlockConfiguration=44, FeeEEPNumber=1
        Fee
          FeeBlockConfiguration: FeeNvmBlockName=Rte_NvmBlock_VehDyn_MotPosReset
      FeeBlockConfiguration66: FeeDataset=1, FeeBlockNumber=1440, FeeBlockSize=14, FeeBlockName=Fee_Block_DiagSvc_BootSwFingerprint, FeeBlockConfiguration=45, FeeEEPNumber=1
        Fee
          FeeBlockConfiguration: FeeNvmBlockName=Rte_NvmBlock_DiagSvc_BootSwFingerPrint
      FeeBlockConfiguration67: FeeDataset=1, FeeBlockNumber=1472, FeeBlockSize=14, FeeBlockName=Fee_Block_DiagSvc_AppSwFingerprint, FeeBlockConfiguration=46, FeeEEPNumber=1
        Fee
          FeeBlockConfiguration: FeeNvmBlockName=Rte_NvmBlock_DiagSvc_AppSwFingerPrint
      FeeBlockConfiguration68: FeeDataset=1, FeeBlockNumber=1504, FeeBlockSize=2, FeeBlockName=Fee_Block_DiagSvc_SupplierIdentification, FeeBlockConfiguration=47, FeeEEPNumber=1
        Fee
          FeeBlockConfiguration: FeeNvmBlockName=Rte_NvmBlock_DiagSvc_SupplierIdentification
      FeeBlockConfiguration69: FeeDataset=1, FeeBlockNumber=1536, FeeBlockSize=11, FeeBlockName=Fee_Block_DiagSvc_ECUSparePartNo, FeeBlockConfiguration=48, FeeEEPNumber=1
        Fee
          FeeBlockConfiguration: FeeNvmBlockName=Rte_NvmBlock_DiagSvc_ECUSparePartNo
      FeeBlockConfiguration70: FeeDataset=1, FeeBlockNumber=1568, FeeBlockSize=11, FeeBlockName=Fee_Block_Boot_VehicleManfSwNo, FeeBlockConfiguration=49, FeeEEPNumber=1
        Fee
          FeeBlockConfiguration: FeeNvmBlockName=Rte_NvmBlock_Boot_VehicleManfSwNo
      FeeBlockConfiguration71: FeeDataset=1, FeeBlockNumber=1600, FeeBlockSize=11, FeeBlockName=Fee_Block_Boot_VehicleManfHwNo, FeeBlockConfiguration=50, FeeEEPNumber=1
        Fee
          FeeBlockConfiguration: FeeNvmBlockName=Rte_NvmBlock_Boot_VehicleManfHwNo
      FeeBlockConfiguration72: FeeDataset=1, FeeBlockNumber=1632, FeeBlockSize=17, FeeBlockName=Fee_Block_DiagSvc_VINCurrent, FeeBlockConfiguration=51, FeeEEPNumber=1
        Fee
          FeeBlockConfiguration: FeeNvmBlockName=Rte_NvmBlock_DiagSvc_VINCurrent
      FeeBlockConfiguration73: FeeDataset=1, FeeBlockNumber=1664, FeeBlockSize=4, FeeBlockName=Fee_Block_Boot_VehicleIdentificationNo, FeeBlockConfiguration=52, FeeEEPNumber=1
        Fee
          FeeBlockConfiguration: FeeNvmBlockName=Rte_NvmBlock_Boot_VehicleIdentificationNo
      FeeBlockConfiguration74: FeeDataset=1, FeeBlockNumber=1696, FeeBlockSize=7, FeeBlockName=Fee_Block_Boot_DiagnosticIdentificationNo, FeeBlockConfiguration=53, FeeEEPNumber=1
        Fee
          FeeBlockConfiguration: FeeNvmBlockName=Rte_NvmBlock_Boot_DiagnosticIdentificationNo
      FeeBlockConfiguration75: FeeDataset=1, FeeBlockNumber=1728, FeeBlockSize=6, FeeBlockName=Fee_Block_Boot_ExhaustRegNo, FeeBlockConfiguration=54, FeeEEPNumber=1
        Fee
          FeeBlockConfiguration: FeeNvmBlockName=Rte_NvmBlock_Boot_ExhaustRegNo
      FeeBlockConfiguration76: FeeDataset=1, FeeBlockNumber=1760, FeeBlockSize=13, FeeBlockName=Fee_Block_Boot_SwVersionNo, FeeBlockConfiguration=55, FeeEEPNumber=1
        Fee
          FeeBlockConfiguration: FeeNvmBlockName=Rte_NvmBlock_Boot_SwVersionNo
      FeeBlockConfiguration77: FeeDataset=1, FeeBlockNumber=1792, FeeBlockSize=1, FeeBlockName=Fee_Block_Boot_FeeInitFlag, FeeBlockConfiguration=56, FeeEEPNumber=1
        Fee
          FeeBlockConfiguration: FeeNvmBlockName=Rte_NvmBlock_Boot_FeeInitFlag
      FeeBlockConfiguration78: FeeDataset=1, FeeBlockNumber=1824, FeeBlockSize=1, FeeBlockName=Fee_Block_DiagSvc_EraseRoutineStatus, FeeBlockConfiguration=57, FeeEEPNumber=1
        Fee
          FeeBlockConfiguration: FeeNvmBlockName=Rte_NvmBlock_DiagSvc_EraseRoutineStatus
      FeeBlockConfiguration79: FeeDataset=1, FeeBlockNumber=1856, FeeBlockSize=1, FeeBlockName=Fee_Block_DiagSvc_ProgrammingStatus, FeeBlockConfiguration=58, FeeEEPNumber=1
        Fee
          FeeBlockConfiguration: FeeNvmBlockName=Rte_NvmBlock_DiagSvc_ProgrammingStatus
      FeeBlockConfiguration80: FeeDataset=1, FeeBlockNumber=1888, FeeBlockSize=1, FeeBlockName=Fee_Block_Boot_NvValidityFlag, FeeBlockConfiguration=59, FeeEEPNumber=1
        Fee
          FeeBlockConfiguration: FeeNvmBlockName=Rte_NvmBlock_Boot_NvValidityFlag
      FeeBlockConfiguration81: FeeDataset=1, FeeBlockNumber=1920, FeeBlockSize=1, FeeBlockName=Fee_Block_Boot_ApplValidityFlag, FeeBlockConfiguration=60, FeeEEPNumber=1
        Fee
          FeeBlockConfiguration: FeeNvmBlockName=Rte_NvmBlock_Boot_ApplValidityFlag
      FeeBlockConfiguration82: FeeDataset=1, FeeBlockNumber=1952, FeeBlockSize=1, FeeBlockName=Fee_Block_Boot_UpdateFlag, FeeBlockConfiguration=61, FeeEEPNumber=1
        Fee
          FeeBlockConfiguration: FeeNvmBlockName=Rte_NvmBlock_Boot_UpdateFlag
      FeeBlockConfiguration83: FeeDataset=1, FeeBlockNumber=1984, FeeBlockSize=2, FeeBlockName=Deprecated_Fee_Block_Boot_ProgrAttemptsCounter, FeeBlockConfiguration=62, FeeEEPNumber=1
        Fee
          FeeBlockConfiguration: FeeNvmBlockName=Deprecated_Boot_ProgAttemptsCounter
      FeeBlockConfiguration84: FeeDataset=1, FeeBlockNumber=2016, FeeBlockSize=2, FeeBlockName=Fee_Block_Boot_ResetResponse, FeeBlockConfiguration=63, FeeEEPNumber=1
        Fee
          FeeBlockConfiguration: FeeNvmBlockName=Rte_NvmBlock_Boot_ResetResponse
      FeeBlockConfiguration85: FeeDataset=1, FeeBlockNumber=2048, FeeBlockSize=4, FeeBlockName=Fee_Block_Boot_LbAddress, FeeBlockConfiguration=64, FeeEEPNumber=1
        Fee
          FeeBlockConfiguration: FeeNvmBlockName=Rte_NvmBlock_Boot_LbAddress
      FeeBlockConfiguration86: FeeDataset=1, FeeBlockNumber=2080, FeeBlockSize=4, FeeBlockName=Fee_Block_Boot_LbLength, FeeBlockConfiguration=65, FeeEEPNumber=1
        Fee
          FeeBlockConfiguration: FeeNvmBlockName=Rte_NvmBlock_Boot_LbLength
      FeeBlockConfiguration87: FeeDataset=1, FeeBlockNumber=2112, FeeBlockSize=4, FeeBlockName=Fee_Block_Boot_NvCrc, FeeBlockConfiguration=66, FeeEEPNumber=1
        Fee
          FeeBlockConfiguration: FeeNvmBlockName=Rte_NvmBlock_Boot_NvCrc
      FeeBlockConfiguration88: FeeDataset=1, FeeBlockNumber=2144, FeeBlockSize=20, FeeBlockName=Fee_Block_DigColPsEol, FeeBlockConfiguration=67, FeeEEPNumber=0
        Fee
          FeeBlockConfiguration: FeeNvmBlockName=Rte_NvmBlock_Sa_DigColPs_DigColPsEOL
      FeeBlockConfiguration111: FeeDataset=1, FeeBlockNumber=2176, FeeBlockSize=4, FeeBlockName=Fee_Block_Boot, FeeBlockConfiguration=68, FeeEEPNumber=1
        Fee
          FeeBlockConfiguration: FeeNvmBlockName=Rte_NvmBlock_Boot
      FeeBlockConfiguration101: FeeDataset=1, FeeBlockNumber=2208, FeeBlockSize=1, FeeBlockName=Deprecated_Fee_Block_Dem_AdminData, FeeBlockConfiguration=69, FeeEEPNumber=1
        Fee
          FeeBlockConfiguration: FeeNvmBlockName=Deprecated_Dem_NvBlock_AdminData
      FeeBlockConfiguration102: FeeDataset=1, FeeBlockNumber=2240, FeeBlockSize=1, FeeBlockName=Deprecated_Fee_Block_Dem_EventData, FeeBlockConfiguration=70, FeeEEPNumber=1
        Fee
          FeeBlockConfiguration: FeeNvmBlockName=Deprecated_Dem_NvBlock_EventData
      FeeBlockConfiguration103: FeeDataset=1, FeeBlockNumber=2272, FeeBlockSize=1, FeeBlockName=Deprecated_Fee_Block_Dem_PrimaryEntry1, FeeBlockConfiguration=71, FeeEEPNumber=1
        Fee
          FeeBlockConfiguration: FeeNvmBlockName=Deprecated_Dem_NvBlock_PrimaryEntry1
      FeeBlockConfiguration104: FeeDataset=1, FeeBlockNumber=2304, FeeBlockSize=1, FeeBlockName=Deprecated_Fee_Block_Dem_PrimaryEntry2, FeeBlockConfiguration=72, FeeEEPNumber=1
        Fee
          FeeBlockConfiguration: FeeNvmBlockName=Deprecated_Dem_NvBlock_PrimaryEntry2
      FeeBlockConfiguration105: FeeDataset=1, FeeBlockNumber=2336, FeeBlockSize=1, FeeBlockName=Deprecated_Fee_Block_Dem_PrimaryEntry3, FeeBlockConfiguration=73, FeeEEPNumber=1
        Fee
          FeeBlockConfiguration: FeeNvmBlockName=Deprecated_Dem_NvBlock_PrimaryEntry3
      FeeBlockConfiguration106: FeeDataset=1, FeeBlockNumber=2368, FeeBlockSize=1, FeeBlockName=Deprecated_Fee_Block_Dem_PrimaryEntry4, FeeBlockConfiguration=74, FeeEEPNumber=1
        Fee
          FeeBlockConfiguration: FeeNvmBlockName=Deprecated_Dem_NvBlock_PrimaryEntry4
      FeeBlockConfiguration107: FeeDataset=1, FeeBlockNumber=2400, FeeBlockSize=1, FeeBlockName=Deprecated_Fee_Block_Dem_PrimaryEntry5, FeeBlockConfiguration=75, FeeEEPNumber=1
        Fee
          FeeBlockConfiguration: FeeNvmBlockName=Deprecated_Dem_NvBlock_PrimaryEntry5
      FeeBlockConfiguration108: FeeDataset=1, FeeBlockNumber=2432, FeeBlockSize=1, FeeBlockName=Deprecated_Fee_Block_Dem_PrimaryEntry6, FeeBlockConfiguration=76, FeeEEPNumber=1
        Fee
          FeeBlockConfiguration: FeeNvmBlockName=Deprecated_Dem_NvBlock_PrimaryEntry6
      FeeBlockConfiguration109: FeeDataset=1, FeeBlockNumber=2464, FeeBlockSize=1, FeeBlockName=Deprecated_Fee_Block_Dem_PrimaryEntry7, FeeBlockConfiguration=77, FeeEEPNumber=1
        Fee
          FeeBlockConfiguration: FeeNvmBlockName=Deprecated_Dem_NvBlock_PrimaryEntry7
      FeeBlockConfiguration110: FeeDataset=1, FeeBlockNumber=2496, FeeBlockSize=1, FeeBlockName=Deprecated_Fee_Block_Dem_PrimaryEntry8, FeeBlockConfiguration=78, FeeEEPNumber=1
        Fee
          FeeBlockConfiguration: FeeNvmBlockName=Deprecated_Dem_NvBlock_PrimaryEntry8
      FeeBlockConfiguration89: FeeDataset=1, FeeBlockNumber=2528, FeeBlockSize=6, FeeBlockName=Deprecated_Fee_Block_DiagSvc_ProxiDataConfiguration, FeeBlockConfiguration=79, FeeEEPNumber=0
        Fee
          FeeBlockConfiguration: FeeNvmBlockName=Deprecated_Rte_NvmBlock_DiagSvc_ProxiConfigurationData
      FeeBlockConfiguration90: FeeDataset=1, FeeBlockNumber=2560, FeeBlockSize=12, FeeBlockName=Fee_Block_Dem_AdminData, FeeBlockConfiguration=80, FeeEEPNumber=1
        Fee
          FeeBlockConfiguration: FeeNvmBlockName=Dem_NvBlock_AdminData
      FeeBlockConfiguration91: FeeDataset=1, FeeBlockNumber=2592, FeeBlockSize=72, FeeBlockName=Fee_Block_Dem_EventData, FeeBlockConfiguration=81, FeeEEPNumber=1
        Fee
          FeeBlockConfiguration: FeeNvmBlockName=Dem_NvBlock_EventData
      FeeBlockConfiguration92: FeeDataset=1, FeeBlockNumber=2624, FeeBlockSize=40, FeeBlockName=Fee_Block_Dem_PrimaryEntry1, FeeBlockConfiguration=82, FeeEEPNumber=1
        Fee
          FeeBlockConfiguration: FeeNvmBlockName=Dem_NvBlock_PrimaryEntry1
      FeeBlockConfiguration93: FeeDataset=1, FeeBlockNumber=2656, FeeBlockSize=40, FeeBlockName=Fee_Block_Dem_PrimaryEntry2, FeeBlockConfiguration=83, FeeEEPNumber=1
        Fee
          FeeBlockConfiguration: FeeNvmBlockName=Dem_NvBlock_PrimaryEntry2
      FeeBlockConfiguration94: FeeDataset=1, FeeBlockNumber=2688, FeeBlockSize=40, FeeBlockName=Fee_Block_Dem_PrimaryEntry3, FeeBlockConfiguration=84, FeeEEPNumber=1
        Fee
          FeeBlockConfiguration: FeeNvmBlockName=Dem_NvBlock_PrimaryEntry3
      FeeBlockConfiguration95: FeeDataset=1, FeeBlockNumber=2720, FeeBlockSize=40, FeeBlockName=Fee_Block_Dem_PrimaryEntry4, FeeBlockConfiguration=85, FeeEEPNumber=1
        Fee
          FeeBlockConfiguration: FeeNvmBlockName=Dem_NvBlock_PrimaryEntry4
      FeeBlockConfiguration96: FeeDataset=1, FeeBlockNumber=2752, FeeBlockSize=40, FeeBlockName=Fee_Block_Dem_PrimaryEntry5, FeeBlockConfiguration=86, FeeEEPNumber=1
        Fee
          FeeBlockConfiguration: FeeNvmBlockName=Dem_NvBlock_PrimaryEntry5
      FeeBlockConfiguration97: FeeDataset=1, FeeBlockNumber=2784, FeeBlockSize=40, FeeBlockName=Fee_Block_Dem_PrimaryEntry6, FeeBlockConfiguration=87, FeeEEPNumber=1
        Fee
          FeeBlockConfiguration: FeeNvmBlockName=Dem_NvBlock_PrimaryEntry6
      FeeBlockConfiguration98: FeeDataset=1, FeeBlockNumber=2816, FeeBlockSize=40, FeeBlockName=Fee_Block_Dem_PrimaryEntry7, FeeBlockConfiguration=88, FeeEEPNumber=1
        Fee
          FeeBlockConfiguration: FeeNvmBlockName=Dem_NvBlock_PrimaryEntry7
      FeeBlockConfiguration99: FeeDataset=1, FeeBlockNumber=2848, FeeBlockSize=40, FeeBlockName=Fee_Block_Dem_PrimaryEntry8, FeeBlockConfiguration=89, FeeEEPNumber=1
        Fee
          FeeBlockConfiguration: FeeNvmBlockName=Dem_NvBlock_PrimaryEntry8
      FeeBlockConfiguration100: FeeDataset=1, FeeBlockNumber=2880, FeeBlockSize=40, FeeBlockName=Fee_Block_Dem_PrimaryEntry9, FeeBlockConfiguration=90, FeeEEPNumber=1
        Fee
          FeeBlockConfiguration: FeeNvmBlockName=Dem_NvBlock_PrimaryEntry9
      FeeBlockConfiguration112: FeeDataset=1, FeeBlockNumber=2912, FeeBlockSize=40, FeeBlockName=Fee_Block_Dem_PrimaryEntry10, FeeBlockConfiguration=91, FeeEEPNumber=1
        Fee
          FeeBlockConfiguration: FeeNvmBlockName=Dem_NvBlock_PrimaryEntry10
      FeeBlockConfiguration113: FeeDataset=1, FeeBlockNumber=2944, FeeBlockSize=255, FeeBlockName=Fee_Block_DiagSvc_ProxiConfiguration, FeeBlockConfiguration=92, FeeEEPNumber=0
        Fee
          FeeBlockConfiguration: FeeNvmBlockName=Rte_NvmBlock_DiagSvc_ProxiConfigurationData
      FeeBlockConfiguration114: FeeDataset=1, FeeBlockNumber=2976, FeeBlockSize=1, FeeBlockName=Fee_Block_DiagSvc_ProxiCounter, FeeBlockConfiguration=93, FeeEEPNumber=0
        Fee
          FeeBlockConfiguration: FeeNvmBlockName=Rte_NvmBlock_DiagSvc_ProxiCounter
      FeeBlockConfiguration115: FeeDataset=1, FeeBlockNumber=3008, FeeBlockSize=14, FeeBlockName=Fee_Block_DiagSvc_CalSwFingerPrint, FeeBlockConfiguration=94, FeeEEPNumber=0
        Fee
          FeeBlockConfiguration: FeeNvmBlockName=Rte_NvmBlock_DiagSvc_CalSwFingerPrint
      FeeBlockConfiguration116: FeeDataset=1, FeeBlockNumber=3040, FeeBlockSize=4, FeeBlockName=Fee_Block_DiagSvc_ECULifeTimeMins, FeeBlockConfiguration=95, FeeEEPNumber=1
        Fee
          FeeBlockConfiguration: FeeNvmBlockName=Rte_NvmBlock_DiagSvc_ECULifeTimeMins
      FeeBlockConfiguration117: FeeDataset=1, FeeBlockNumber=3072, FeeBlockSize=4, FeeBlockName=Fee_Block_DiagSvc_FirstDTCDetectMins, FeeBlockConfiguration=96, FeeEEPNumber=1
        Fee
          FeeBlockConfiguration: FeeNvmBlockName=Rte_NvmBlock_DiagSvc_FirstDTCDetectMins
      FeeBlockConfiguration118: FeeDataset=1, FeeBlockNumber=3104, FeeBlockSize=2, FeeBlockName=Fee_Block_DiagSvc_FirstDTCDetectSecs, FeeBlockConfiguration=97, FeeEEPNumber=1
        Fee
          FeeBlockConfiguration: FeeNvmBlockName=Rte_NvmBlock_DiagSvc_FirstDTCDetectSecs
      FeeBlockConfiguration119: FeeDataset=1, FeeBlockNumber=3136, FeeBlockSize=9, FeeBlockName=Fee_Block_DiagSvc_EOLConfigData, FeeBlockConfiguration=98, FeeEEPNumber=0
        Fee
          FeeBlockConfiguration: FeeNvmBlockName=Rte_NvmBlock_DiagSvc_EOLConfigData
      FeeBlockConfiguration120: FeeDataset=1, FeeBlockNumber=3168, FeeBlockSize=8, FeeBlockName=Fee_Block_DiagSvc_ProgrAttemptsCounter, FeeBlockConfiguration=99, FeeEEPNumber=0
        Fee
          FeeBlockConfiguration: FeeNvmBlockName=Rte_NvmBlock_DiagSvc_ProgAttemptsCounter
      FeeBlockConfiguration121: FeeDataset=1, FeeBlockNumber=3200, FeeBlockSize=17, FeeBlockName=Fee_Block_DiagSvc_VINOriginal, FeeBlockConfiguration=100, FeeEEPNumber=0
        Fee
          FeeBlockConfiguration: FeeNvmBlockName=Rte_NvmBlock_DiagSvc_VINOriginal
      FeeBlockConfiguration122: FeeDataset=1, FeeBlockNumber=3232, FeeBlockSize=16, FeeBlockName=Fee_Block_DiagSvc_ECUSerialNumber, FeeBlockConfiguration=101, FeeEEPNumber=0
        Fee
          FeeBlockConfiguration: FeeNvmBlockName=Rte_NvmBlock_DiagSvc_ECUSerialNumber
      FeeBlockConfiguration123: FeeDataset=1, FeeBlockNumber=3264, FeeBlockSize=2, FeeBlockName=Fee_Block_DiagSvc_TotalOdometer, FeeBlockConfiguration=102, FeeEEPNumber=0
        Fee
          FeeBlockConfiguration: FeeNvmBlockName=Rte_NvmBlock_DiagSvc_TotalOdometer
      FeeBlockConfiguration124: FeeDataset=1, FeeBlockNumber=3296, FeeBlockSize=2, FeeBlockName=Fee_Block_DiagSvc_OdometerFlashProg, FeeBlockConfiguration=103, FeeEEPNumber=0
        Fee
          FeeBlockConfiguration: FeeNvmBlockName=Rte_NvmBlock_DiagSvc_OdometerFlashProg
      FeeBlockConfiguration125: FeeDataset=1, FeeBlockNumber=3328, FeeBlockSize=7, FeeBlockName=Fee_Block_Boot_DIDF100, FeeBlockConfiguration=104, FeeEEPNumber=0
        Fee
          FeeBlockConfiguration: FeeNvmBlockName=Rte_NvmBlock_Boot_DIDF100
      FeeBlockConfiguration126: FeeDataset=1, FeeBlockNumber=3360, FeeBlockSize=14, FeeBlockName=Fee_Block_Boot_DIDF181, FeeBlockConfiguration=105, FeeEEPNumber=0
        Fee
          FeeBlockConfiguration: FeeNvmBlockName=Rte_NvmBlock_Boot_DIDF181
      FeeBlockConfiguration127: FeeDataset=1, FeeBlockNumber=3392, FeeBlockSize=14, FeeBlockName=Fee_Block_Boot_DIDF182, FeeBlockConfiguration=106, FeeEEPNumber=0
        Fee
          FeeBlockConfiguration: FeeNvmBlockName=Rte_NvmBlock_Boot_DIDF182
      FeeBlockConfiguration128: FeeDataset=1, FeeBlockNumber=3424, FeeBlockSize=11, FeeBlockName=Fee_Block_Boot_DIDF187, FeeBlockConfiguration=107, FeeEEPNumber=0
        Fee
          FeeBlockConfiguration: FeeNvmBlockName=Rte_NvmBlock_Boot_DIDF187
      FeeBlockConfiguration129: FeeDataset=1, FeeBlockNumber=3456, FeeBlockSize=11, FeeBlockName=Fee_Block_Boot_DIDF188, FeeBlockConfiguration=108, FeeEEPNumber=0
        Fee
          FeeBlockConfiguration: FeeNvmBlockName=Rte_NvmBlock_Boot_DIDF188
      FeeBlockConfiguration130: FeeDataset=1, FeeBlockNumber=3488, FeeBlockSize=11, FeeBlockName=Fee_Block_Boot_DIDF191, FeeBlockConfiguration=109, FeeEEPNumber=0
        Fee
          FeeBlockConfiguration: FeeNvmBlockName=Rte_NvmBlock_Boot_DIDF191
      FeeBlockConfiguration131: FeeDataset=1, FeeBlockNumber=3520, FeeBlockSize=11, FeeBlockName=Fee_Block_Boot_DIDF192, FeeBlockConfiguration=110, FeeEEPNumber=0
        Fee
          FeeBlockConfiguration: FeeNvmBlockName=Rte_NvmBlock_Boot_DIDF192
    FeeTypes: FeeFlashErrCorrHandlingType=Fee_None
    FeeFlashConfiguration: FeeDeviceName=TMS570LS07xx
  module config FlsTst: implementation-config-variant=VARIANT-PRE-COMPILE
    Runtime (FlsTstConfigSet): FlsTstBlockNumberBgnd=2, FlsTstBlockNumberFgnd=0, FlsTstTestCompletedNotification=Appl_FlsTstCompletedNotif
      FlsTstBlockBgndConfigSet
        3 x FlsTstBlock, all with FlsTstBlockBaseAddress=(unset), FlsTstBlockIndex=(unset), FlsTstNumberOfTestedCells=(unset), FlsTstSignatureAddress=(unset), FlsTstTestAlgorithm=FLSTST_64BIT_CRC:
          Cal: FlsTstBlockBaseSymbol=CCT_Range_11_Start, FlsTstBlockSize=262136, FlsTstSignatureSymbol=CCT_Range_11_Address
          App: FlsTstBlockBaseSymbol=CCT_Range_10_Start, FlsTstBlockSize=458720, FlsTstSignatureSymbol=CCT_Range_10_Address
          Boot: FlsTstBlockBaseSymbol=BootCRC_Start, FlsTstBlockSize=65520, FlsTstSignatureSymbol=BootCRC_Address
    FlsTstConfigurationOfOptApiServices:
      FlsTstGetCurrentStateApi = false
      FlsTstGetErrorDetailsApi = false
      FlsTstGetTestResultBgndApi = false
      FlsTstGetTestResultFgndApi = false
      FlsTstGetTestSignatureBgndApi = false
      FlsTstGetTestSignatureFgndApi = false
      FlsTstStartFgndApi = false
      FlsTstSuspendResumeApi = true
      FlsTstTestEccApi = false
      FlsTstVersionInfoApi = false
    FlsTstDemEventParameterRefs:
      FLSTST_E_FLSTST_FAILURE = NTC_Num_FlashCRCMemFault
      FLSTST_E_FLSTST_INFO = 1
      FLSTST_E_SELFTEST_FAILURE = NTC_Num_CPU_CoreInitFlt
      FLSTST_E_SELFTEST_INFO = 8
      FLSTST_E_MPU_FAILURE = NTC_Num_PerDiag_DMAFlt
      FLSTST_E_MPU_INFO = 128
      FLSTST_E_UNEXPECTEDIRQ_FAILURE = NTC_Num_FlashCRCMemFault
      FLSTST_E_UNEXPECTEDIRQ_INFO = 1
      FlsTstDemInclude = Ap_DiagMgr.h
      FailureAPI = NxtrDiagMgr10_ReportNTCStatus
    FlsTstGeneral:
      FlsTstDevErrorDetect = false
      FlsTstNumberOfTestedCellsAtomic = 1
      FlsTstTestCompletedNotificationSupported = true
      FlsTstTestIntervalIdEndValue = 4294967295
      FlsTstTestResultSignature = false
    CommonPublishedInformation: ArMajorVersion=1, ArMinorVersion=2, ArPatchVersion=0, SwMajorVersion=1, SwMinorVersion=0, SwPatchVersion=0, ModuleId=104, VendorId=0
  module config FrqDepDmpnInrtCmp: implementation-config-variant=VARIANT-POST-BUILD
    FrqDepDmpnInrtCmpGeneral
    CommonPublishedInformation: ArMajorVersion=3, ArMinorVersion=2, ArPatchVersion=0, SwMajorVersion=0, SwMinorVersion=0, SwPatchVersion=0, ModuleId=0, VendorId=0
  module config Gpt: implementation-config-variant=VARIANT-POST-BUILD, module-description=Gpt_Impl
    Gpt_Runtime (GptChannelConfigSet):
      GptChannelPrescaleClk0 = 79
      GptChannelPrescaleClk1 = 79
      GptMcuVariant = McuModuleConfiguration
      GptMcuClockconfig = McuClockSettingConfig
      GptMainclock = RTICLK1
      GptClockFrequency = 80
      SystemTime_uS (GptChannelConfiguration):
        GptChannelClkSrc = 0
        GptChannelMode = GPT_MODE_CONTINUOUS
        GptChannelPrescale = 0
        GptEnableWakeup = false
        GptNotification = SystemTick
        GptHwChannel = 0
        GptChannelId = 0
        GptResolution = 1
        GptWakeupConfiguration
    GptConfigurationOfOptApiServices:
      GptDeinitApi = true
      GptEnableDisableNotificationApi = true
      GptTimeElapsedApi = true
      GptTimeRemainingApi = true
      GptVersionInfoApi = false
      GptWakeupFunctionalityApi = true
    GptDriverConfiguration:
      GptDevErrorDetect = false
      GptReportWakeupSource = true
      GptCfgWakeupInclude = EcuM_Cbk.h
      GptErrorhook = Det_ReportError
      GptCfgIncludeDet = Det.h
      GptCfgChkUninit = true
      GptCfgChkParamChl = false
      GptCfgChkParamMode = true
      GptCfgChkParamValue = true
      GptCfgChkParamVinfo = true
      GptCfgChkBusy = true
      GptCfgIncludeList = ApplCallbacks.h
      GptCfgChkParamConfig = true
      GptCfgDoParamChk = true
      GptCfgChkParamWakeupchl = false
      GptCfgChkNotifptr = true
      GptCfgDebugReporting = true
      GptCfgChkAlreadyInit = true
      GptCfgChkNotStarted = true
      GptSpecRegAccEnabled = true
      GptSpecRegAccOnlyForWrite = true
      GptSpecRegAccOnlyForPrivModeReg = true
      GptSpecRegAccNotInInit = false
      GptNativeIsr = GPT_ISR_CAT2
      GptIrqHandling = InterruptFunctionSet
  module config Gsod: implementation-config-variant=VARIANT-POST-BUILD
    GsodGeneral
    CommonPublishedInformation: ArMajorVersion=3, ArMinorVersion=2, ArPatchVersion=0, SwMajorVersion=0, SwMinorVersion=0, SwPatchVersion=0, ModuleId=0, VendorId=0
  module config HighFreqAssist: implementation-config-variant=VARIANT-POST-BUILD
    HighFreqAssistGeneral
    CommonPublishedInformation: ArMajorVersion=3, ArMinorVersion=2, ArPatchVersion=0, SwMajorVersion=0, SwMinorVersion=0, SwPatchVersion=0, ModuleId=0, VendorId=0
  module config HiLoadStall: implementation-config-variant=VARIANT-POST-BUILD
    HiLoadStallGeneral
    CommonPublishedInformation: ArMajorVersion=3, ArMinorVersion=2, ArPatchVersion=0, SwMajorVersion=0, SwMinorVersion=0, SwPatchVersion=0, ModuleId=0, VendorId=0
  module config HwPwUp: implementation-config-variant=VARIANT-POST-BUILD
    HwPwUpGeneral: HwPwUpPgmSpecMask=0
    CommonPublishedInformation: ArMajorVersion=3, ArMinorVersion=2, ArPatchVersion=0, SwMajorVersion=0, SwMinorVersion=0, SwPatchVersion=0, ModuleId=0, VendorId=0
  module config HystComp: implementation-config-variant=VARIANT-POST-BUILD
    HystCompGeneral
    CommonPublishedInformation: ArMajorVersion=3, ArMinorVersion=2, ArPatchVersion=0, SwMajorVersion=0, SwMinorVersion=0, SwPatchVersion=0, ModuleId=0, VendorId=0
  module config IoHwAb: definition=IoHwAbstraction, implementation-config-variant=VARIANT-PRE-COMPILE, module-description=IoHwAbstraction_Impl
    IoHwAbCalSignals
      11 x IoHwAbDiscrete, all with IoHwAbCreateOpDiag=false, IoHwAbDcmAccess=false, IoHwAbCalSourceType=DioChannel, IoHwAbRequirementId=(unset), IoHwAbDcmDefaultValue=0:
        EpsEn: IoHwAbCreateOpSet=false, IoHwAbCreateOpGet=true, IoHwAbDioEntity=ADC1_Ch0
        PwrSwitchEn: IoHwAbCreateOpSet=false, IoHwAbCreateOpGet=true, IoHwAbDioEntity=NHet_Ch8
        FetDrvCntl: IoHwAbCreateOpSet=false, IoHwAbCreateOpGet=true, IoHwAbDioEntity=NHet_Ch4
        FetFlt2Clk: IoHwAbCreateOpSet=true, IoHwAbCreateOpGet=true, IoHwAbDioEntity=NHet_Ch26
        FetFlt1Data: IoHwAbCreateOpSet=false, IoHwAbCreateOpGet=true, IoHwAbDioEntity=NHet_Ch24
        SysFault2: IoHwAbCreateOpSet=true, IoHwAbCreateOpGet=true, IoHwAbDioEntity=NHet_Ch15
        WdMonitor: IoHwAbCreateOpSet=true, IoHwAbCreateOpGet=false, IoHwAbDioEntity=Can3Rx
        FetDrvReset: IoHwAbCreateOpSet=true, IoHwAbCreateOpGet=true, IoHwAbDioEntity=SPI3_NCS1
        WdReset: IoHwAbCreateOpSet=true, IoHwAbCreateOpGet=false, IoHwAbDioEntity=Can3Tx
        TODReset: IoHwAbCreateOpSet=true, IoHwAbCreateOpGet=false, IoHwAbDioEntity=NHet_Ch20
        OvrVoltFdbk: IoHwAbCreateOpSet=false, IoHwAbCreateOpGet=true, IoHwAbDioEntity=NHet_Ch22
    IoHwAbUserDefSignals
      IoHwAbPortConfig (IoHwAbUserDefPort)
        SetFetFlt2ToOutput (IoHwAbUserDefinedOp):
          IoHwAbAccess = Output
          IoHwAbDataType = IoHwAbBoolType
          IoHwAbUnit = None
          IoHwAbRangeMin = (unset)
          IoHwAbRangeMax = (unset)
          IoHwAbResolution = (unset)
          IoHwAbDcmAccess = false
          IoHwAbRequirementId = (unset)
          IoHwAbDcmDefaultValue = 0
      SysFault3 (IoHwAbUserDefPort)
        OP_GET (IoHwAbUserDefinedOp):
          IoHwAbAccess = Input
          IoHwAbDataType = IoHwAbBoolType
          IoHwAbUnit = None
          IoHwAbRangeMin = 0
          IoHwAbRangeMax = (unset)
          IoHwAbResolution = (unset)
          IoHwAbDcmAccess = false
          IoHwAbRequirementId = (unset)
        OP_SET (IoHwAbUserDefinedOp):
          IoHwAbAccess = Output
          IoHwAbDataType = IoHwAbBoolType
          IoHwAbUnit = None
          IoHwAbRangeMin = 0
          IoHwAbRangeMax = (unset)
          IoHwAbResolution = (unset)
          IoHwAbDcmAccess = false
          IoHwAbRequirementId = (unset)
    IoHwAbHandlers
    IoHwAbGeneral:
      IoHwAbDevErrorDetect = true
      IoHwAbDevErrorReport = true
      IoHwAbVersionInfoApi = true
      IoHwAbUseInitFunction = false
      IoHwAbUseRte = true
      IoHwAbUseServicePorts = false
      IoHwAbServiceComponentName = IoHwAbstraction
      IoHwAbErrorhook = Det_ReportError
      IoHwAbCfgIncludeDet = Det.h
      IoHwAbCfgIncludeList = Dio.h
      IoHwAbIrqHandling = SuspendAllInterrupts
      IoHwAbErrorChecks: IoHwAbCfgChkParamPointer=true
      IoHwAbDataTypeSizes:
        IoHwAbDiscreteGroupSize = IOHWAB_UINT8
        IoHwAbCurrentType = IOHWAB_UINT16
        IoHwAbVoltageType = IOHWAB_UINT16
        IoHwAbResistanceType = IOHWAB_UINT16
        IoHwAbSignalDiagnosisType = IOHWAB_UINT16
        IoHwAbPwxPeriodType = IOHWAB_UINT16
        IoHwAbPwxDutyCycleType = IOHWAB_UINT16
    VectorCommonData: BswmdVersion=1.04.06
  module config LmtCod: implementation-config-variant=VARIANT-POST-BUILD
    LmtCodGeneral
    CommonPublishedInformation: ArMajorVersion=3, ArMinorVersion=2, ArPatchVersion=0, SwMajorVersion=0, SwMinorVersion=0, SwPatchVersion=0, ModuleId=0, VendorId=0
  module config LrnEOT: implementation-config-variant=VARIANT-POST-BUILD
    LrnEOTGeneral
    CommonPublishedInformation: ArMajorVersion=3, ArMinorVersion=2, ArPatchVersion=0, SwMajorVersion=0, SwMinorVersion=0, SwPatchVersion=0, ModuleId=0, VendorId=0

[part 4 of 4: package /ActiveEcuC]
AUTOSAR XML (schema 3.0.2)
package /ActiveEcuC  (continued)
  module config Dem: implementation-config-variant=VARIANT-PRE-COMPILE, module-description=Dem_Impl
    VectorCommonData: BswmdVersion=1.06.03
    DemGeneral:
      DemBswErrorBufferSize = 30
      DemAddErrorBufferSize = 1
      DemDevErrorDetect = false
      DemDtcStatusAvailabilityMask = 255
      DemFFDataIDLength = 2
      DemMaxNumberEventEntryMir = 1
      DemMaxNumberEventEntryPrm = 10
      DemMaxNumberEventEntrySec = 0
      DemNvmAccessRetry = 0
      DemNvmAccessRetryTimeDelay = 0
      DemVersionInfoApi = false
      DemSnapshotsPerDTC = 2
      DemUseRte = false
      DemPostbuildStartAddress = 0
      DemUseDcmCompatiblePorts = false
      DemUserConfigFile = 
      DemPreInitHasConfigParam = false
      DemSoftwareComponentName = Dem
      DemSupportGetEventIdApi = false
      DemNvWriteAfterConfirmation = false
      DemNvWriteAfterClear = false
      DemAmdRuntimeMeasurement = false
      DemVariantModeSelection = SIMPLE_ECU
      DemMaxNumberPrestoredFF = 0
      DemTaskTime = 10
      DemTypeOfDTCSupported = 1
      DemTimeBasedDebouncingDataType = TIME_BASED_DEBOUNCING_16_BIT
      DemEnableFailStateNotification = true
      10 x DemNvramBlockId:
        Dem_AdminData: DemNvramBlockIdUsageType=DEM_NVRAM_BLOCK_CORE, DemNvramBlockIdUsageIndex=0, DemNvramBlockIdRef=Dem_NvBlock_AdminData
        Dem_EventData: DemNvramBlockIdUsageType=DEM_NVRAM_BLOCK_EVENTDATA, DemNvramBlockIdUsageIndex=0, DemNvramBlockIdRef=Dem_NvBlock_EventData
        Dem_PrimaryEntry{1..8}: DemNvramBlockIdUsageType=DEM_NVRAM_BLOCK_PRIMARY, DemNvramBlockIdUsageIndex={1..8}, DemNvramBlockIdRef=Dem_NvBlock_PrimaryEntry{1..8}
      4 x DemOperationCycleTgt:
        DEM_IGNITION: DemOperationCycle=DEM_IGNITION
        DEM_POWER: DemOperationCycle=DEM_POWER
        DEM_OBD_DCY: DemOperationCycle=DEM_OBD_DCY
        DEM_WARMUP: DemOperationCycle=DEM_WARMUP
      8 x DemFreezeFrameIdClass, all with DemCreatePortInterface=true:
        DID_0x1008: DemFreezeFrameIdDataSize=3, DemDataID=4104
          DemGetDataValByDataIdTgt: DemGetDataValByDataIdTgtRef=CBValByDID_0x1008
        DID_0x1009: DemFreezeFrameIdDataSize=2, DemDataID=4105
          DemGetDataValByDataIdTgt: DemGetDataValByDataIdTgtRef=CBValByDID_0x1009
        DID_0x200a: DemFreezeFrameIdDataSize=3, DemDataID=8202
          DemGetDataValByDataIdTgt: DemGetDataValByDataIdTgtRef=CBValByDID_0x200a
        DID_0x2001: DemFreezeFrameIdDataSize=2, DemDataID=8193
          DemGetDataValByDataIdTgt: DemGetDataValByDataIdTgtRef=CBValByDID_0x2001
        DID_0x1004: DemFreezeFrameIdDataSize=1, DemDataID=4100
          DemGetDataValByDataIdTgt: DemGetDataValByDataIdTgtRef=CBValByDID_0x1004
        DID_0x1002: DemFreezeFrameIdDataSize=1, DemDataID=4098
          DemGetDataValByDataIdTgt: DemGetDataValByDataIdTgtRef=CBValByDID_0x1002
        DID_0x0885: DemFreezeFrameIdDataSize=2, DemDataID=2181
          DemGetDataValByDataIdTgt: DemGetDataValByDataIdTgtRef=CBValByDID_0x0885
        DID_0x0ad8: DemFreezeFrameIdDataSize=1, DemDataID=2776
          DemGetDataValByDataIdTgt: DemGetDataValByDataIdTgtRef=CBValByDID_0x0ad8
      FFTYPE_NEW38 (DemFreezeFrameClass):
        DemFreezeFrameRecordNum = 0
        DemFreezeFrameKind = (unset)
        DemFreezeFrameIdClassRef = DID_0x1008
        DemFreezeFrameIdClassRef = DID_0x1009
        DemFreezeFrameIdClassRef = DID_0x200a
        DemFreezeFrameIdClassRef = DID_0x2001
        DemFreezeFrameIdClassRef = DID_0x1004
        DemFreezeFrameIdClassRef = DID_0x1002
        DemFreezeFrameIdClassRef = DID_0x0885
        DemFreezeFrameIdClassRef = DID_0x0ad8
      8 x DemGetDataValByDataId:
        CBValByDID_0x1008: DemGetDataValByDataIdListFnc=CBValByDID_0x1008
        CBValByDID_0x1009: DemGetDataValByDataIdListFnc=CBValByDID_0x1009
        CBValByDID_0x200a: DemGetDataValByDataIdListFnc=CBValByDID_0x200a
        CBValByDID_0x2001: DemGetDataValByDataIdListFnc=CBValByDID_0x2001
        CBValByDID_0x1004: DemGetDataValByDataIdListFnc=CBValByDID_0x1004
        CBValByDID_0x1002: DemGetDataValByDataIdListFnc=CBValByDID_0x1002
        CBValByDID_0x0885: DemGetDataValByDataIdListFnc=CBValByDID_0x0885
        CBValByDID_0x0ad8: DemGetDataValByDataIdListFnc=CBValByDID_0x0ad8
      38 x DemFreezeFrameClass, all with DemFreezeFrameRecordNum=0, DemFreezeFrameKind=(unset), DemFreezeFrameIdClassRef=DID_0x1008, DemFreezeFrameIdClassRef=DID_0x1009, DemFreezeFrameIdClassRef=DID_0x200a, DemFreezeFrameIdClassRef=DID_0x2001, DemFreezeFrameIdClassRef=DID_0x1004, DemFreezeFrameIdClassRef=DID_0x1002, DemFreezeFrameIdClassRef=DID_0x0885, DemFreezeFrameIdClassRef=DID_0x0ad8:
        FFTYPE_NEW38_{1..38}
      Dem_PrimaryEntry9 (DemNvramBlockId): DemNvramBlockIdUsageType=DEM_NVRAM_BLOCK_PRIMARY, DemNvramBlockIdUsageIndex=9, DemNvramBlockIdRef=Dem_NvBlock_PrimaryEntry9
      Dem_PrimaryEntry10 (DemNvramBlockId): DemNvramBlockIdUsageType=DEM_NVRAM_BLOCK_PRIMARY, DemNvramBlockIdUsageIndex=10, DemNvramBlockIdRef=Dem_NvBlock_PrimaryEntry10
      RECORD0 (DemExtendedDataRecClass):
        DemExtendedDataRecordDataSize = 6
        DemExtendedDataRecordNumber = 1
        DemExtendedDataRecordType = GENERIC
        DemExtendedDataRecordSemantics = NONE
        DemGetExtendedDataTargetRef = CBExtDataRec_0x01
      DemExtendedDataClass: DemExtendedDataClassRef=RECORD0
      CBExtDataRec_0x01 (DemGetExtDataRecord): DemCreatePortInterface=true, DemGetExtDataRecordFnc=CBExtDataRec_0x01
    DemConfigSet: DemActiveDsdServiceTableRef=CommonDiagnostics
      DEM_DTC_GROUP_ALL_DTCS (DemGroupOfDTC): DemGroupDTCs=(unset)
      ECUM_E_ALL_RUN_REQUESTS_KILLED (DemEventParameter):
        DemEventID = 40
        DemInitMonitorName = (unset)
        DemEventKind = DEM_EVENT_KIND_BSW
        DemImportedEvent = false
        DemExtendedDataRef = (unset)
        DemDTCClassRef = DtcClass0
        DemEventClass:
          DemEventPriority = 0
          DemFFPrestorageSupported = false
          DemHealingAllowed = false
          DemHealingCycleCounter = 40
          DemIndicatorHealingCycleCount = 0
          DemMaturationTime = 0
          DemMaturationMonitorRate = 0
          DemDematurationTime = 0
          DemDematurationMonitorRate = 0
          DemHealingCycleRef = (unset)
          DemIndicatorHealingCycleRef = (unset)
          DemOperationCycleRef = DEM_IGNITION
          DemPredebounceAlgorithmClass
            DemPreDebounceCounterBased: DemJumpUp=true, DemJumpDown=true, DemCountOutStepSize=1, DemCountInStepSize=1, DemPreDebounceName=DEM_PRE_DEBOUNCE_COUNTER_BASED
      DtcClass0 (DemDTCClass): DemDTC=0, DemDTCKind=DEM_DTC_KIND_ALL_DTCS, DemDTCSeverity=DEM_DTC_SEV_NO_SEVERITY, DemDTCFunctionalUnit=0, DemDTCSupportWarningIndicator=false
      ECUM_E_RAM_CHECK_FAILED (DemEventParameter):
        DemEventID = 41
        DemInitMonitorName = (unset)
        DemEventKind = DEM_EVENT_KIND_BSW
        DemImportedEvent = false
        DemExtendedDataRef = (unset)
        DemDTCClassRef = DtcClass1
        DemEventClass:
          DemEventPriority = 0
          DemFFPrestorageSupported = false
          DemHealingAllowed = false
          DemHealingCycleCounter = 40
          DemIndicatorHealingCycleCount = 0
          DemMaturationTime = 0
          DemMaturationMonitorRate = 0
          DemDematurationTime = 0
          DemDematurationMonitorRate = 0
          DemHealingCycleRef = (unset)
          DemIndicatorHealingCycleRef = (unset)
          DemOperationCycleRef = DEM_IGNITION
          DemPredebounceAlgorithmClass
            DemPreDebounceCounterBased: DemJumpUp=true, DemJumpDown=true, DemCountOutStepSize=1, DemCountInStepSize=1, DemPreDebounceName=DEM_PRE_DEBOUNCE_COUNTER_BASED
      DtcClass1 (DemDTCClass): DemDTC=0, DemDTCKind=DEM_DTC_KIND_ALL_DTCS, DemDTCSeverity=DEM_DTC_SEV_NO_SEVERITY, DemDTCFunctionalUnit=0, DemDTCSupportWarningIndicator=false
      FLS_E_READ_FAILED (DemEventParameter):
        DemEventID = 42
        DemInitMonitorName = (unset)
        DemEventKind = DEM_EVENT_KIND_BSW
        DemImportedEvent = false
        DemExtendedDataRef = (unset)
        DemDTCClassRef = DtcClass2
        DemEventClass:
          DemEventPriority = 0
          DemFFPrestorageSupported = false
          DemHealingAllowed = false
          DemHealingCycleCounter = 40
          DemIndicatorHealingCycleCount = 0
          DemMaturationTime = 0
          DemMaturationMonitorRate = 0
          DemDematurationTime = 0
          DemDematurationMonitorRate = 0
          DemHealingCycleRef = (unset)
          DemIndicatorHealingCycleRef = (unset)
          DemOperationCycleRef = DEM_IGNITION
          DemPredebounceAlgorithmClass
            DemPreDebounceCounterBased: DemJumpUp=true, DemJumpDown=true, DemCountOutStepSize=1, DemCountInStepSize=1, DemPreDebounceName=DEM_PRE_DEBOUNCE_COUNTER_BASED
      DtcClass2 (DemDTCClass): DemDTC=0, DemDTCKind=DEM_DTC_KIND_ALL_DTCS, DemDTCSeverity=DEM_DTC_SEV_NO_SEVERITY, DemDTCFunctionalUnit=0, DemDTCSupportWarningIndicator=false
      FLS_E_WRITE_FAILED (DemEventParameter):
        DemEventID = 43
        DemInitMonitorName = (unset)
        DemEventKind = DEM_EVENT_KIND_BSW
        DemImportedEvent = false
        DemExtendedDataRef = (unset)
        DemDTCClassRef = DtcClass3
        DemEventClass:
          DemEventPriority = 0
          DemFFPrestorageSupported = false
          DemHealingAllowed = false
          DemHealingCycleCounter = 40
          DemIndicatorHealingCycleCount = 0
          DemMaturationTime = 0
          DemMaturationMonitorRate = 0
          DemDematurationTime = 0
          DemDematurationMonitorRate = 0
          DemHealingCycleRef = (unset)
          DemIndicatorHealingCycleRef = (unset)
          DemOperationCycleRef = DEM_IGNITION
          DemPredebounceAlgorithmClass
            DemPreDebounceCounterBased: DemJumpUp=true, DemJumpDown=true, DemCountOutStepSize=1, DemCountInStepSize=1, DemPreDebounceName=DEM_PRE_DEBOUNCE_COUNTER_BASED
      DtcClass3 (DemDTCClass): DemDTC=0, DemDTCKind=DEM_DTC_KIND_ALL_DTCS, DemDTCSeverity=DEM_DTC_SEV_NO_SEVERITY, DemDTCFunctionalUnit=0, DemDTCSupportWarningIndicator=false
      FLS_E_ERASE_FAILED (DemEventParameter):
        DemEventID = 44
        DemInitMonitorName = (unset)
        DemEventKind = DEM_EVENT_KIND_BSW
        DemImportedEvent = false
        DemExtendedDataRef = (unset)
        DemDTCClassRef = DtcClass4
        DemEventClass:
          DemEventPriority = 0
          DemFFPrestorageSupported = false
          DemHealingAllowed = false
          DemHealingCycleCounter = 40
          DemIndicatorHealingCycleCount = 0
          DemMaturationTime = 0
          DemMaturationMonitorRate = 0
          DemDematurationTime = 0
          DemDematurationMonitorRate = 0
          DemHealingCycleRef = (unset)
          DemIndicatorHealingCycleRef = (unset)
          DemOperationCycleRef = DEM_IGNITION
          DemPredebounceAlgorithmClass
            DemPreDebounceCounterBased: DemJumpUp=true, DemJumpDown=true, DemCountOutStepSize=1, DemCountInStepSize=1, DemPreDebounceName=DEM_PRE_DEBOUNCE_COUNTER_BASED
      DtcClass4 (DemDTCClass): DemDTC=0, DemDTCKind=DEM_DTC_KIND_ALL_DTCS, DemDTCSeverity=DEM_DTC_SEV_NO_SEVERITY, DemDTCFunctionalUnit=0, DemDTCSupportWarningIndicator=false
      MCU_E_CLOCK_FAILURE (DemEventParameter):
        DemEventID = 45
        DemInitMonitorName = (unset)
        DemEventKind = DEM_EVENT_KIND_BSW
        DemImportedEvent = false
        DemExtendedDataRef = (unset)
        DemDTCClassRef = DtcClass5
        DemEventClass:
          DemEventPriority = 0
          DemFFPrestorageSupported = false
          DemHealingAllowed = false
          DemHealingCycleCounter = 40
          DemIndicatorHealingCycleCount = 0
          DemMaturationTime = 0
          DemMaturationMonitorRate = 0
          DemDematurationTime = 0
          DemDematurationMonitorRate = 0
          DemHealingCycleRef = (unset)
          DemIndicatorHealingCycleRef = (unset)
          DemOperationCycleRef = DEM_IGNITION
          DemPredebounceAlgorithmClass
            DemPreDebounceCounterBased: DemJumpUp=true, DemJumpDown=true, DemCountOutStepSize=1, DemCountInStepSize=1, DemPreDebounceName=DEM_PRE_DEBOUNCE_COUNTER_BASED
      DtcClass5 (DemDTCClass): DemDTC=0, DemDTCKind=DEM_DTC_KIND_ALL_DTCS, DemDTCSeverity=DEM_DTC_SEV_NO_SEVERITY, DemDTCFunctionalUnit=0, DemDTCSupportWarningIndicator=false
      NVM_E_REQ_FAILED (DemEventParameter):
        DemEventID = 46
        DemInitMonitorName = (unset)
        DemEventKind = DEM_EVENT_KIND_BSW
        DemImportedEvent = false
        DemExtendedDataRef = (unset)
        DemDTCClassRef = DtcClass6
        DemEventClass:
          DemEventPriority = 0
          DemFFPrestorageSupported = false
          DemHealingAllowed = false
          DemHealingCycleCounter = 40
          DemIndicatorHealingCycleCount = 0
          DemMaturationTime = 0
          DemMaturationMonitorRate = 0
          DemDematurationTime = 0
          DemDematurationMonitorRate = 0
          DemHealingCycleRef = (unset)
          DemIndicatorHealingCycleRef = (unset)
          DemOperationCycleRef = DEM_IGNITION
          DemPredebounceAlgorithmClass
            DemPreDebounceCounterBased: DemJumpUp=true, DemJumpDown=true, DemCountOutStepSize=1, DemCountInStepSize=1, DemPreDebounceName=DEM_PRE_DEBOUNCE_COUNTER_BASED
      DtcClass6 (DemDTCClass): DemDTC=0, DemDTCKind=DEM_DTC_KIND_ALL_DTCS, DemDTCSeverity=DEM_DTC_SEV_NO_SEVERITY, DemDTCFunctionalUnit=0, DemDTCSupportWarningIndicator=false
      NVM_E_INTEGRITY_FAILED (DemEventParameter):
        DemEventID = 47
        DemInitMonitorName = (unset)
        DemEventKind = DEM_EVENT_KIND_BSW
        DemImportedEvent = false
        DemExtendedDataRef = (unset)
        DemDTCClassRef = DtcClass7
        DemEventClass:
          DemEventPriority = 0
          DemFFPrestorageSupported = false
          DemHealingAllowed = false
          DemHealingCycleCounter = 40
          DemIndicatorHealingCycleCount = 0
          DemMaturationTime = 0
          DemMaturationMonitorRate = 0
          DemDematurationTime = 0
          DemDematurationMonitorRate = 0
          DemHealingCycleRef = (unset)
          DemIndicatorHealingCycleRef = (unset)
          DemOperationCycleRef = DEM_IGNITION
          DemPredebounceAlgorithmClass
            DemPreDebounceCounterBased: DemJumpUp=true, DemJumpDown=true, DemCountOutStepSize=1, DemCountInStepSize=1, DemPreDebounceName=DEM_PRE_DEBOUNCE_COUNTER_BASED
      DtcClass7 (DemDTCClass): DemDTC=0, DemDTCKind=DEM_DTC_KIND_ALL_DTCS, DemDTCSeverity=DEM_DTC_SEV_NO_SEVERITY, DemDTCFunctionalUnit=0, DemDTCSupportWarningIndicator=false
      SPI_E_SEQ_FAILED (DemEventParameter):
        DemEventID = 48
        DemInitMonitorName = (unset)
        DemEventKind = DEM_EVENT_KIND_BSW
        DemImportedEvent = false
        DemExtendedDataRef = (unset)
        DemDTCClassRef = DtcClass8
        DemEventClass:
          DemEventPriority = 0
          DemFFPrestorageSupported = false
          DemHealingAllowed = false
          DemHealingCycleCounter = 40
          DemIndicatorHealingCycleCount = 0
          DemMaturationTime = 0
          DemMaturationMonitorRate = 0
          DemDematurationTime = 0
          DemDematurationMonitorRate = 0
          DemHealingCycleRef = (unset)
          DemIndicatorHealingCycleRef = (unset)
          DemOperationCycleRef = DEM_IGNITION
          DemPredebounceAlgorithmClass
            DemPreDebounceCounterBased: DemJumpUp=true, DemJumpDown=true, DemCountOutStepSize=1, DemCountInStepSize=1, DemPreDebounceName=DEM_PRE_DEBOUNCE_COUNTER_BASED
      DtcClass8 (DemDTCClass): DemDTC=0, DemDTCKind=DEM_DTC_KIND_ALL_DTCS, DemDTCSeverity=DEM_DTC_SEV_NO_SEVERITY, DemDTCFunctionalUnit=0, DemDTCSupportWarningIndicator=false
      WDGM_E_SET_MODE (DemEventParameter):
        DemEventID = 49
        DemInitMonitorName = (unset)
        DemEventKind = DEM_EVENT_KIND_BSW
        DemImportedEvent = false
        DemExtendedDataRef = (unset)
        DemDTCClassRef = DtcClass9
        DemEventClass:
          DemEventPriority = 0
          DemFFPrestorageSupported = false
          DemHealingAllowed = false
          DemHealingCycleCounter = 40
          DemIndicatorHealingCycleCount = 0
          DemMaturationTime = 0
          DemMaturationMonitorRate = 0
          DemDematurationTime = 0
          DemDematurationMonitorRate = 0
          DemHealingCycleRef = (unset)
          DemIndicatorHealingCycleRef = (unset)
          DemOperationCycleRef = DEM_IGNITION
          DemPredebounceAlgorithmClass
            DemPreDebounceCounterBased: DemJumpUp=true, DemJumpDown=true, DemCountOutStepSize=1, DemCountInStepSize=1, DemPreDebounceName=DEM_PRE_DEBOUNCE_COUNTER_BASED
      DtcClass9 (DemDTCClass): DemDTC=0, DemDTCKind=DEM_DTC_KIND_ALL_DTCS, DemDTCSeverity=DEM_DTC_SEV_NO_SEVERITY, DemDTCFunctionalUnit=0, DemDTCSupportWarningIndicator=false
      WDGM_E_ALIVE_SUPERVISION (DemEventParameter):
        DemEventID = 50
        DemInitMonitorName = (unset)
        DemEventKind = DEM_EVENT_KIND_BSW
        DemImportedEvent = false
        DemExtendedDataRef = (unset)
        DemDTCClassRef = DtcClass10
        DemEventClass:
          DemEventPriority = 0
          DemFFPrestorageSupported = false
          DemHealingAllowed = false
          DemHealingCycleCounter = 40
          DemIndicatorHealingCycleCount = 0
          DemMaturationTime = 0
          DemMaturationMonitorRate = 0
          DemDematurationTime = 0
          DemDematurationMonitorRate = 0
          DemHealingCycleRef = (unset)
          DemIndicatorHealingCycleRef = (unset)
          DemOperationCycleRef = DEM_IGNITION
          DemPredebounceAlgorithmClass
            DemPreDebounceCounterBased: DemJumpUp=true, DemJumpDown=true, DemCountOutStepSize=1, DemCountInStepSize=1, DemPreDebounceName=DEM_PRE_DEBOUNCE_COUNTER_BASED
      DtcClass10 (DemDTCClass): DemDTC=0, DemDTCKind=DEM_DTC_KIND_ALL_DTCS, DemDTCSeverity=DEM_DTC_SEV_NO_SEVERITY, DemDTCFunctionalUnit=0, DemDTCSupportWarningIndicator=false
      CAN_E_TIMEOUT (DemEventParameter):
        DemEventID = 51
        DemInitMonitorName = (unset)
        DemEventKind = DEM_EVENT_KIND_BSW
        DemImportedEvent = false
        DemExtendedDataRef = (unset)
        DemDTCClassRef = DtcClass11
        DemEventClass:
          DemEventPriority = 0
          DemFFPrestorageSupported = false
          DemHealingAllowed = false
          DemHealingCycleCounter = 40
          DemIndicatorHealingCycleCount = 0
          DemMaturationTime = 0
          DemMaturationMonitorRate = 0
          DemDematurationTime = 0
          DemDematurationMonitorRate = 0
          DemHealingCycleRef = (unset)
          DemIndicatorHealingCycleRef = (unset)
          DemOperationCycleRef = DEM_IGNITION
          DemPredebounceAlgorithmClass
            DemPreDebounceCounterBased: DemJumpUp=true, DemJumpDown=true, DemCountOutStepSize=1, DemCountInStepSize=1, DemPreDebounceName=DEM_PRE_DEBOUNCE_COUNTER_BASED
      DtcClass11 (DemDTCClass): DemDTC=0, DemDTCKind=DEM_DTC_KIND_ALL_DTCS, DemDTCSeverity=DEM_DTC_SEV_NO_SEVERITY, DemDTCFunctionalUnit=0, DemDTCSupportWarningIndicator=false
      CANIF_E_SLEEP_REQ_FAILED (DemEventParameter):
        DemEventID = 52
        DemInitMonitorName = (unset)
        DemEventKind = DEM_EVENT_KIND_BSW
        DemImportedEvent = false
        DemExtendedDataRef = (unset)
        DemDTCClassRef = DtcClass12
        DemEventClass:
          DemEventPriority = 0
          DemFFPrestorageSupported = false
          DemHealingAllowed = false
          DemHealingCycleCounter = 40
          DemIndicatorHealingCycleCount = 0
          DemMaturationTime = 0
          DemMaturationMonitorRate = 0
          DemDematurationTime = 0
          DemDematurationMonitorRate = 0
          DemHealingCycleRef = (unset)
          DemIndicatorHealingCycleRef = (unset)
          DemOperationCycleRef = DEM_IGNITION
          DemPredebounceAlgorithmClass
            DemPreDebounceCounterBased: DemJumpUp=true, DemJumpDown=true, DemCountOutStepSize=1, DemCountInStepSize=1, DemPreDebounceName=DEM_PRE_DEBOUNCE_COUNTER_BASED
      DtcClass12 (DemDTCClass): DemDTC=0, DemDTCKind=DEM_DTC_KIND_ALL_DTCS, DemDTCSeverity=DEM_DTC_SEV_NO_SEVERITY, DemDTCFunctionalUnit=0, DemDTCSupportWarningIndicator=false
      CANIF_E_FULL_TX_BUFFER (DemEventParameter):
        DemEventID = 53
        DemInitMonitorName = (unset)
        DemEventKind = DEM_EVENT_KIND_BSW
        DemImportedEvent = false
        DemExtendedDataRef = (unset)
        DemDTCClassRef = DtcClass13
        DemEventClass:
          DemEventPriority = 0
          DemFFPrestorageSupported = false
          DemHealingAllowed = false
          DemHealingCycleCounter = 40
          DemIndicatorHealingCycleCount = 0
          DemMaturationTime = 0
          DemMaturationMonitorRate = 0
          DemDematurationTime = 0
          DemDematurationMonitorRate = 0
          DemHealingCycleRef = (unset)
          DemIndicatorHealingCycleRef = (unset)
          DemOperationCycleRef = DEM_IGNITION
          DemPredebounceAlgorithmClass
            DemPreDebounceCounterBased: DemJumpUp=true, DemJumpDown=true, DemCountOutStepSize=1, DemCountInStepSize=1, DemPreDebounceName=DEM_PRE_DEBOUNCE_COUNTER_BASED
      DtcClass13 (DemDTCClass): DemDTC=0, DemDTCKind=DEM_DTC_KIND_ALL_DTCS, DemDTCSeverity=DEM_DTC_SEV_NO_SEVERITY, DemDTCFunctionalUnit=0, DemDTCSupportWarningIndicator=false
      CANIF_E_INVALID_DLC (DemEventParameter):
        DemEventID = 54
        DemInitMonitorName = (unset)
        DemEventKind = DEM_EVENT_KIND_BSW
        DemImportedEvent = false
        DemExtendedDataRef = (unset)
        DemDTCClassRef = DtcClass14
        DemEventClass:
          DemEventPriority = 0
          DemFFPrestorageSupported = false
          DemHealingAllowed = false
          DemHealingCycleCounter = 40
          DemIndicatorHealingCycleCount = 0
          DemMaturationTime = 0
          DemMaturationMonitorRate = 0
          DemDematurationTime = 0
          DemDematurationMonitorRate = 0
          DemHealingCycleRef = (unset)
          DemIndicatorHealingCycleRef = (unset)
          DemOperationCycleRef = DEM_IGNITION
          DemPredebounceAlgorithmClass
            DemPreDebounceCounterBased: DemJumpUp=true, DemJumpDown=true, DemCountOutStepSize=1, DemCountInStepSize=1, DemPreDebounceName=DEM_PRE_DEBOUNCE_COUNTER_BASED
      DtcClass14 (DemDTCClass): DemDTC=0, DemDTCKind=DEM_DTC_KIND_ALL_DTCS, DemDTCSeverity=DEM_DTC_SEV_NO_SEVERITY, DemDTCFunctionalUnit=0, DemDTCSupportWarningIndicator=false
      CANIF_E_STOPPED (DemEventParameter):
        DemEventID = 55
        DemInitMonitorName = (unset)
        DemEventKind = DEM_EVENT_KIND_BSW
        DemImportedEvent = false
        DemExtendedDataRef = (unset)
        DemDTCClassRef = DtcClass15
        DemEventClass:
          DemEventPriority = 0
          DemFFPrestorageSupported = false
          DemHealingAllowed = false
          DemHealingCycleCounter = 40
          DemIndicatorHealingCycleCount = 0
          DemMaturationTime = 0
          DemMaturationMonitorRate = 0
          DemDematurationTime = 0
          DemDematurationMonitorRate = 0
          DemHealingCycleRef = (unset)
          DemIndicatorHealingCycleRef = (unset)
          DemOperationCycleRef = DEM_IGNITION
          DemPredebounceAlgorithmClass
            DemPreDebounceCounterBased: DemJumpUp=true, DemJumpDown=true, DemCountOutStepSize=1, DemCountInStepSize=1, DemPreDebounceName=DEM_PRE_DEBOUNCE_COUNTER_BASED
      3 x DemDTCClass, all with DemDTC=0, DemDTCKind=DEM_DTC_KIND_ALL_DTCS, DemDTCSeverity=DEM_DTC_SEV_NO_SEVERITY, DemDTCFunctionalUnit=0, DemDTCSupportWarningIndicator=false:
        DtcClass{15..17}
      CANSM_E_MODE_CHANGE_NETWORK_0 (DemEventParameter):
        DemEventID = 60
        DemInitMonitorName = (unset)
        DemEventKind = DEM_EVENT_KIND_BSW
        DemImportedEvent = false
        DemExtendedDataRef = (unset)
        DemDTCClassRef = DtcClass20
        DemEventClass:
          DemEventPriority = 0
          DemFFPrestorageSupported = false
          DemHealingAllowed = false
          DemHealingCycleCounter = 40
          DemIndicatorHealingCycleCount = 0
          DemMaturationTime = 0
          DemMaturationMonitorRate = 0
          DemDematurationTime = 0
          DemDematurationMonitorRate = 0
          DemHealingCycleRef = (unset)
          DemIndicatorHealingCycleRef = (unset)
          DemOperationCycleRef = DEM_IGNITION
          DemPredebounceAlgorithmClass
            DemPreDebounceCounterBased: DemJumpUp=true, DemJumpDown=true, DemCountOutStepSize=1, DemCountInStepSize=1, DemPreDebounceName=DEM_PRE_DEBOUNCE_COUNTER_BASED
      DtcClass18 (DemDTCClass): DemDTC=0, DemDTCKind=DEM_DTC_KIND_ALL_DTCS, DemDTCSeverity=DEM_DTC_SEV_NO_SEVERITY, DemDTCFunctionalUnit=0, DemDTCSupportWarningIndicator=false
      DtcClass19 (DemDTCClass): DemDTC=0, DemDTCKind=DEM_DTC_KIND_ALL_DTCS, DemDTCSeverity=DEM_DTC_SEV_NO_SEVERITY, DemDTCFunctionalUnit=0, DemDTCSupportWarningIndicator=false
      CANSM_E_BUSOFF_NETWORK_0 (DemEventParameter):
        DemEventID = 61
        DemInitMonitorName = (unset)
        DemEventKind = DEM_EVENT_KIND_BSW
        DemImportedEvent = false
        DemExtendedDataRef = (unset)
        DemDTCClassRef = DtcClass21
        DemEventClass:
          DemEventPriority = 0
          DemFFPrestorageSupported = false
          DemHealingAllowed = false
          DemHealingCycleCounter = 40
          DemIndicatorHealingCycleCount = 0
          DemMaturationTime = 0
          DemMaturationMonitorRate = 0
          DemDematurationTime = 0
          DemDematurationMonitorRate = 0
          DemHealingCycleRef = (unset)
          DemIndicatorHealingCycleRef = (unset)
          DemOperationCycleRef = DEM_IGNITION
          DemPredebounceAlgorithmClass
            DemPreDebounceCounterBased: DemJumpUp=true, DemJumpDown=true, DemCountOutStepSize=1, DemCountInStepSize=1, DemPreDebounceName=DEM_PRE_DEBOUNCE_COUNTER_BASED
      DtcClass20 (DemDTCClass): DemDTC=0, DemDTCKind=DEM_DTC_KIND_ALL_DTCS, DemDTCSeverity=DEM_DTC_SEV_NO_SEVERITY, DemDTCFunctionalUnit=0, DemDTCSupportWarningIndicator=false
      PDUR_E_INIT_FAILED (DemEventParameter):
        DemEventID = 58
        DemInitMonitorName = (unset)
        DemEventKind = DEM_EVENT_KIND_BSW
        DemImportedEvent = false
        DemExtendedDataRef = (unset)
        DemDTCClassRef = DtcClass18
        DemEventClass:
          DemEventPriority = 0
          DemFFPrestorageSupported = false
          DemHealingAllowed = false
          DemHealingCycleCounter = 40
          DemIndicatorHealingCycleCount = 0
          DemMaturationTime = 0
          DemMaturationMonitorRate = 0
          DemDematurationTime = 0
          DemDematurationMonitorRate = 0
          DemHealingCycleRef = (unset)
          DemIndicatorHealingCycleRef = (unset)
          DemOperationCycleRef = DEM_IGNITION
          DemPredebounceAlgorithmClass
            DemPreDebounceCounterBased: DemJumpUp=true, DemJumpDown=true, DemCountOutStepSize=1, DemCountInStepSize=1, DemPreDebounceName=DEM_PRE_DEBOUNCE_COUNTER_BASED
      DtcClass21 (DemDTCClass): DemDTC=0, DemDTCKind=DEM_DTC_KIND_ALL_DTCS, DemDTCSeverity=DEM_DTC_SEV_NO_SEVERITY, DemDTCFunctionalUnit=0, DemDTCSupportWarningIndicator=false
      PDUR_E_PDU_INSTANCE_LOST (DemEventParameter):
        DemEventID = 59
        DemInitMonitorName = (unset)
        DemEventKind = DEM_EVENT_KIND_BSW
        DemImportedEvent = false
        DemExtendedDataRef = (unset)
        DemDTCClassRef = DtcClass19
        DemEventClass:
          DemEventPriority = 0
          DemFFPrestorageSupported = false
          DemHealingAllowed = false
          DemHealingCycleCounter = 40
          DemIndicatorHealingCycleCount = 0
          DemMaturationTime = 0
          DemMaturationMonitorRate = 0
          DemDematurationTime = 0
          DemDematurationMonitorRate = 0
          DemHealingCycleRef = (unset)
          DemIndicatorHealingCycleRef = (unset)
          DemOperationCycleRef = DEM_IGNITION
          DemPredebounceAlgorithmClass
            DemPreDebounceCounterBased: DemJumpUp=true, DemJumpDown=true, DemCountOutStepSize=1, DemCountInStepSize=1, DemPreDebounceName=DEM_PRE_DEBOUNCE_COUNTER_BASED
      CANTP_E_COMM (DemEventParameter):
        DemEventID = 62
        DemInitMonitorName = (unset)
        DemEventKind = DEM_EVENT_KIND_BSW
        DemImportedEvent = false
        DemExtendedDataRef = (unset)
        DemDTCClassRef = DtcClass22
        DemEventClass:
          DemEventPriority = 0
          DemFFPrestorageSupported = false
          DemHealingAllowed = false
          DemHealingCycleCounter = 40
          DemIndicatorHealingCycleCount = 0
          DemMaturationTime = 0
          DemMaturationMonitorRate = 0
          DemDematurationTime = 0
          DemDematurationMonitorRate = 0
          DemHealingCycleRef = (unset)
          DemIndicatorHealingCycleRef = (unset)
          DemOperationCycleRef = DEM_IGNITION
          DemPredebounceAlgorithmClass
            DemPreDebounceCounterBased: DemJumpUp=true, DemJumpDown=true, DemCountOutStepSize=1, DemCountInStepSize=1, DemPreDebounceName=DEM_PRE_DEBOUNCE_COUNTER_BASED
      DtcClass22 (DemDTCClass): DemDTC=0, DemDTCKind=DEM_DTC_KIND_ALL_DTCS, DemDTCSeverity=DEM_DTC_SEV_NO_SEVERITY, DemDTCFunctionalUnit=0, DemDTCSupportWarningIndicator=false
      DTC_0x500386 (DemEventParameter):
        DemEventID = 39
        DemInitMonitorName = (unset)
        DemEventKind = DEM_EVENT_KIND_SWC
        DemImportedEvent = true
        DemExtendedDataRef = (unset)
        DemDTCClassRef = DtcClass23
        DemFreezeFrameClassRef = FFTYPE_NEW38
        DemEventClass:
          DemEventPriority = 0
          DemFFPrestorageSupported = false
          DemHealingAllowed = true
          DemEventDestination = DEM_DTC_ORIGIN_PRIMARY_MEMORY
          DemHealingCycleCounter = 40
          DemIndicatorHealingCycleCount = 0
          DemMaturationTime = 100000
          DemMaturationMonitorRate = 10
          DemDematurationTime = 100000
          DemDematurationMonitorRate = 10
          DemHealingCycleRef = DEM_IGNITION
          DemOperationCycleRef = DEM_IGNITION
          DemIndicatorHealingCycleRef = DEM_IGNITION
          DemPredebounceAlgorithmClass
            DemPreDebounceTimeBase: DemTimeFailedThreshold=100000, DemTimePassedThreshold=100000, DemPreDebounceName=DEM_PRE_DEBOUNCE_TIME_BASED
      DtcClass23 (DemDTCClass):
        DemDTC = 5243782
        DemDTCKind = DEM_DTC_KIND_ALL_DTCS
        DemDTCSeverity = DEM_DTC_SEV_MAINTENANCE_ONLY
        DemDTCFunctionalUnit = 255
        DemDTCSupportWarningIndicator = true
      DTC_0x500568 (DemEventParameter):
        DemEventID = 38
        DemInitMonitorName = (unset)
        DemEventKind = DEM_EVENT_KIND_SWC
        DemImportedEvent = true
        DemExtendedDataRef = (unset)
        DemDTCClassRef = DtcClass24
        DemFreezeFrameClassRef = FFTYPE_NEW38_1
        DemEventClass:
          DemEventPriority = 0
          DemFFPrestorageSupported = false
          DemHealingAllowed = true
          DemEventDestination = DEM_DTC_ORIGIN_PRIMARY_MEMORY
          DemHealingCycleCounter = 40
          DemIndicatorHealingCycleCount = 0
          DemMaturationTime = 0
          DemMaturationMonitorRate = 10
          DemDematurationTime = 0
          DemDematurationMonitorRate = 10
          DemHealingCycleRef = DEM_IGNITION
          DemOperationCycleRef = DEM_IGNITION
          DemIndicatorHealingCycleRef = DEM_IGNITION
          DemPredebounceAlgorithmClass
            DemPreDebounceCounterBased: DemJumpUp=true, DemJumpDown=true, DemCountOutStepSize=127, DemCountInStepSize=127, DemPreDebounceName=DEM_PRE_DEBOUNCE_COUNTER_BASED
      DtcClass24 (DemDTCClass):
        DemDTC = 5244264
        DemDTCKind = DEM_DTC_KIND_ALL_DTCS
        DemDTCSeverity = DEM_DTC_SEV_MAINTENANCE_ONLY
        DemDTCFunctionalUnit = 255
        DemDTCSupportWarningIndicator = true
      DTC_0x500909 (DemEventParameter):
        DemEventID = 37
        DemInitMonitorName = (unset)
        DemEventKind = DEM_EVENT_KIND_SWC
        DemImportedEvent = true
        DemExtendedDataRef = (unset)
        DemDTCClassRef = DtcClass25
        DemFreezeFrameClassRef = FFTYPE_NEW38_2
        DemEventClass:
          DemEventPriority = 0
          DemFFPrestorageSupported = false
          DemHealingAllowed = true
          DemEventDestination = DEM_DTC_ORIGIN_PRIMARY_MEMORY
          DemHealingCycleCounter = 40
          DemIndicatorHealingCycleCount = 0
          DemMaturationTime = 0
          DemMaturationMonitorRate = 10
          DemDematurationTime = 0
          DemDematurationMonitorRate = 10
          DemHealingCycleRef = DEM_IGNITION
          DemOperationCycleRef = DEM_IGNITION
          DemIndicatorHealingCycleRef = DEM_IGNITION
          DemPredebounceAlgorithmClass
            DemPreDebounceCounterBased: DemJumpUp=true, DemJumpDown=true, DemCountOutStepSize=127, DemCountInStepSize=127, DemPreDebounceName=DEM_PRE_DEBOUNCE_COUNTER_BASED
      DtcClass25 (DemDTCClass):
        DemDTC = 5245193
        DemDTCKind = DEM_DTC_KIND_ALL_DTCS
        DemDTCSeverity = DEM_DTC_SEV_IMMEDIATELY
        DemDTCFunctionalUnit = 255
        DemDTCSupportWarningIndicator = true
      DTC_0x52192f (DemEventParameter):
        DemEventID = 36
        DemInitMonitorName = (unset)
        DemEventKind = DEM_EVENT_KIND_SWC
        DemImportedEvent = true
        DemExtendedDataRef = (unset)
        DemDTCClassRef = DtcClass26
        DemFreezeFrameClassRef = FFTYPE_NEW38_3
        DemEventClass:
          DemEventPriority = 0
          DemFFPrestorageSupported = false
          DemHealingAllowed = true
          DemEventDestination = DEM_DTC_ORIGIN_PRIMARY_MEMORY
          DemHealingCycleCounter = 40
          DemIndicatorHealingCycleCount = 0
          DemMaturationTime = 0
          DemMaturationMonitorRate = 10
          DemDematurationTime = 0
          DemDematurationMonitorRate = 10
          DemHealingCycleRef = DEM_IGNITION
          DemOperationCycleRef = DEM_IGNITION
          DemIndicatorHealingCycleRef = DEM_IGNITION
          DemPredebounceAlgorithmClass
            DemPreDebounceCounterBased: DemJumpUp=true, DemJumpDown=true, DemCountOutStepSize=127, DemCountInStepSize=127, DemPreDebounceName=DEM_PRE_DEBOUNCE_COUNTER_BASED
      DtcClass26 (DemDTCClass):
        DemDTC = 5380399
        DemDTCKind = DEM_DTC_KIND_ALL_DTCS
        DemDTCSeverity = DEM_DTC_SEV_CHECK_AT_NEXT_HALT
        DemDTCFunctionalUnit = 255
        DemDTCSupportWarningIndicator = true
      DTC_0x521a54 (DemEventParameter):
        DemEventID = 35
        DemInitMonitorName = (unset)
        DemEventKind = DEM_EVENT_KIND_SWC
        DemImportedEvent = true
        DemExtendedDataRef = (unset)
        DemDTCClassRef = DtcClass27
        DemFreezeFrameClassRef = FFTYPE_NEW38_4
        DemEventClass:
          DemEventPriority = 0
          DemFFPrestorageSupported = false
          DemHealingAllowed = true
          DemEventDestination = DEM_DTC_ORIGIN_PRIMARY_MEMORY
          DemHealingCycleCounter = 40
          DemIndicatorHealingCycleCount = 0
          DemMaturationTime = 0
          DemMaturationMonitorRate = 10
          DemDematurationTime = 0
          DemDematurationMonitorRate = 10
          DemHealingCycleRef = DEM_IGNITION
          DemOperationCycleRef = DEM_IGNITION
          DemIndicatorHealingCycleRef = DEM_IGNITION
          DemPredebounceAlgorithmClass
            DemPreDebounceCounterBased: DemJumpUp=true, DemJumpDown=true, DemCountOutStepSize=127, DemCountInStepSize=127, DemPreDebounceName=DEM_PRE_DEBOUNCE_COUNTER_BASED
      DtcClass27 (DemDTCClass):
        DemDTC = 5380692
        DemDTCKind = DEM_DTC_KIND_ALL_DTCS
        DemDTCSeverity = DEM_DTC_SEV_IMMEDIATELY
        DemDTCFunctionalUnit = 255
        DemDTCSupportWarningIndicator = true
      DTC_0x559201 (DemEventParameter):
        DemEventID = 34
        DemInitMonitorName = (unset)
        DemEventKind = DEM_EVENT_KIND_SWC
        DemImportedEvent = true
        DemExtendedDataRef = (unset)
        DemDTCClassRef = DtcClass28
        DemFreezeFrameClassRef = FFTYPE_NEW38_5
        DemEventClass:
          DemEventPriority = 0
          DemFFPrestorageSupported = false
          DemHealingAllowed = true
          DemEventDestination = DEM_DTC_ORIGIN_PRIMARY_MEMORY
          DemHealingCycleCounter = 40
          DemIndicatorHealingCycleCount = 0
          DemMaturationTime = 0
          DemMaturationMonitorRate = 10
          DemDematurationTime = 0
          DemDematurationMonitorRate = 10
          DemHealingCycleRef = DEM_IGNITION
          DemOperationCycleRef = DEM_IGNITION
          DemIndicatorHealingCycleRef = DEM_IGNITION
          DemPredebounceAlgorithmClass
            DemPreDebounceCounterBased: DemJumpUp=true, DemJumpDown=true, DemCountOutStepSize=127, DemCountInStepSize=127, DemPreDebounceName=DEM_PRE_DEBOUNCE_COUNTER_BASED
      DtcClass28 (DemDTCClass):
        DemDTC = 5607937
        DemDTCKind = DEM_DTC_KIND_ALL_DTCS
        DemDTCSeverity = DEM_DTC_SEV_IMMEDIATELY
        DemDTCFunctionalUnit = 255
        DemDTCSupportWarningIndicator = true
      DTC_0x559211 (DemEventParameter):
        DemEventID = 33
        DemInitMonitorName = (unset)
        DemEventKind = DEM_EVENT_KIND_SWC
        DemImportedEvent = true
        DemExtendedDataRef = (unset)
        DemDTCClassRef = DtcClass29
        DemFreezeFrameClassRef = FFTYPE_NEW38_6
        DemEventClass:
          DemEventPriority = 0
          DemFFPrestorageSupported = false
          DemHealingAllowed = true
          DemEventDestination = DEM_DTC_ORIGIN_PRIMARY_MEMORY
          DemHealingCycleCounter = 40
          DemIndicatorHealingCycleCount = 0
          DemMaturationTime = 0
          DemMaturationMonitorRate = 10
          DemDematurationTime = 0
          DemDematurationMonitorRate = 10
          DemHealingCycleRef = DEM_IGNITION
          DemOperationCycleRef = DEM_IGNITION
          DemIndicatorHealingCycleRef = DEM_IGNITION
          DemPredebounceAlgorithmClass
            DemPreDebounceCounterBased: DemJumpUp=true, DemJumpDown=true, DemCountOutStepSize=127, DemCountInStepSize=127, DemPreDebounceName=DEM_PRE_DEBOUNCE_COUNTER_BASED
      DtcClass29 (DemDTCClass):
        DemDTC = 5607953
        DemDTCKind = DEM_DTC_KIND_ALL_DTCS
        DemDTCSeverity = DEM_DTC_SEV_IMMEDIATELY
        DemDTCFunctionalUnit = 255
        DemDTCSupportWarningIndicator = true
      DTC_0x559212 (DemEventParameter):
        DemEventID = 32
        DemInitMonitorName = (unset)
        DemEventKind = DEM_EVENT_KIND_SWC
        DemImportedEvent = true
        DemExtendedDataRef = (unset)
        DemDTCClassRef = DtcClass30
        DemFreezeFrameClassRef = FFTYPE_NEW38_7
        DemEventClass:
          DemEventPriority = 0
          DemFFPrestorageSupported = false
          DemHealingAllowed = true
          DemEventDestination = DEM_DTC_ORIGIN_PRIMARY_MEMORY
          DemHealingCycleCounter = 40
          DemIndicatorHealingCycleCount = 0
          DemMaturationTime = 0
          DemMaturationMonitorRate = 10
          DemDematurationTime = 0
          DemDematurationMonitorRate = 10
          DemHealingCycleRef = DEM_IGNITION
          DemOperationCycleRef = DEM_IGNITION
          DemIndicatorHealingCycleRef = DEM_IGNITION
          DemPredebounceAlgorithmClass
            DemPreDebounceCounterBased: DemJumpUp=true, DemJumpDown=true, DemCountOutStepSize=127, DemCountInStepSize=127, DemPreDebounceName=DEM_PRE_DEBOUNCE_COUNTER_BASED
      DtcClass30 (DemDTCClass):
        DemDTC = 5607954
        DemDTCKind = DEM_DTC_KIND_ALL_DTCS
        DemDTCSeverity = DEM_DTC_SEV_IMMEDIATELY
        DemDTCFunctionalUnit = 255
        DemDTCSupportWarningIndicator = true
      DTC_0x559213 (DemEventParameter):
        DemEventID = 31
        DemInitMonitorName = (unset)
        DemEventKind = DEM_EVENT_KIND_SWC
        DemImportedEvent = true
        DemExtendedDataRef = (unset)
        DemDTCClassRef = DtcClass31
        DemFreezeFrameClassRef = FFTYPE_NEW38_8
        DemEventClass:
          DemEventPriority = 0
          DemFFPrestorageSupported = false
          DemHealingAllowed = true
          DemEventDestination = DEM_DTC_ORIGIN_PRIMARY_MEMORY
          DemHealingCycleCounter = 40
          DemIndicatorHealingCycleCount = 0
          DemMaturationTime = 0
          DemMaturationMonitorRate = 10
          DemDematurationTime = 0
          DemDematurationMonitorRate = 10
          DemHealingCycleRef = DEM_IGNITION
          DemOperationCycleRef = DEM_IGNITION
          DemIndicatorHealingCycleRef = DEM_IGNITION
          DemPredebounceAlgorithmClass
            DemPreDebounceCounterBased: DemJumpUp=true, DemJumpDown=true, DemCountOutStepSize=127, DemCountInStepSize=127, DemPreDebounceName=DEM_PRE_DEBOUNCE_COUNTER_BASED
      DtcClass31 (DemDTCClass):
        DemDTC = 5607955
        DemDTCKind = DEM_DTC_KIND_ALL_DTCS
        DemDTCSeverity = DEM_DTC_SEV_IMMEDIATELY
        DemDTCFunctionalUnit = 255
        DemDTCSupportWarningIndicator = true
      DTC_0x559219 (DemEventParameter):
        DemEventID = 30
        DemInitMonitorName = (unset)
        DemEventKind = DEM_EVENT_KIND_SWC
        DemImportedEvent = true
        DemExtendedDataRef = (unset)
        DemDTCClassRef = DtcClass32
        DemFreezeFrameClassRef = FFTYPE_NEW38_9
        DemEventClass:
          DemEventPriority = 0
          DemFFPrestorageSupported = false
          DemHealingAllowed = true
          DemEventDestination = DEM_DTC_ORIGIN_PRIMARY_MEMORY
          DemHealingCycleCounter = 40
          DemIndicatorHealingCycleCount = 0
          DemMaturationTime = 0
          DemMaturationMonitorRate = 10
          DemDematurationTime = 0
          DemDematurationMonitorRate = 10
          DemHealingCycleRef = DEM_IGNITION
          DemOperationCycleRef = DEM_IGNITION
          DemIndicatorHealingCycleRef = DEM_IGNITION
          DemPredebounceAlgorithmClass
            DemPreDebounceCounterBased: DemJumpUp=true, DemJumpDown=true, DemCountOutStepSize=127, DemCountInStepSize=127, DemPreDebounceName=DEM_PRE_DEBOUNCE_COUNTER_BASED
      DtcClass32 (DemDTCClass):
        DemDTC = 5607961
        DemDTCKind = DEM_DTC_KIND_ALL_DTCS
        DemDTCSeverity = DEM_DTC_SEV_IMMEDIATELY
        DemDTCFunctionalUnit = 255
        DemDTCSupportWarningIndicator = true
      DTC_0x559311 (DemEventParameter):
        DemEventID = 29
        DemInitMonitorName = (unset)
        DemEventKind = DEM_EVENT_KIND_SWC
        DemImportedEvent = true
        DemExtendedDataRef = (unset)
        DemDTCClassRef = DtcClass33
        DemFreezeFrameClassRef = FFTYPE_NEW38_10
        DemEventClass:
          DemEventPriority = 0
          DemFFPrestorageSupported = false
          DemHealingAllowed = true
          DemEventDestination = DEM_DTC_ORIGIN_PRIMARY_MEMORY
          DemHealingCycleCounter = 40
          DemIndicatorHealingCycleCount = 0
          DemMaturationTime = 0
          DemMaturationMonitorRate = 10
          DemDematurationTime = 0
          DemDematurationMonitorRate = 10
          DemHealingCycleRef = DEM_IGNITION
          DemOperationCycleRef = DEM_IGNITION
          DemIndicatorHealingCycleRef = DEM_IGNITION
          DemPredebounceAlgorithmClass
            DemPreDebounceCounterBased: DemJumpUp=true, DemJumpDown=true, DemCountOutStepSize=127, DemCountInStepSize=127, DemPreDebounceName=DEM_PRE_DEBOUNCE_COUNTER_BASED
      DtcClass33 (DemDTCClass):
        DemDTC = 5608209
        DemDTCKind = DEM_DTC_KIND_ALL_DTCS
        DemDTCSeverity = DEM_DTC_SEV_IMMEDIATELY
        DemDTCFunctionalUnit = 255
        DemDTCSupportWarningIndicator = true
      DTC_0x559312 (DemEventParameter):
        DemEventID = 28
        DemInitMonitorName = (unset)
        DemEventKind = DEM_EVENT_KIND_SWC
        DemImportedEvent = true
        DemExtendedDataRef = (unset)
        DemDTCClassRef = DtcClass34
        DemFreezeFrameClassRef = FFTYPE_NEW38_11
        DemEventClass:
          DemEventPriority = 0
          DemFFPrestorageSupported = false
          DemHealingAllowed = true
          DemEventDestination = DEM_DTC_ORIGIN_PRIMARY_MEMORY
          DemHealingCycleCounter = 40
          DemIndicatorHealingCycleCount = 0
          DemMaturationTime = 0
          DemMaturationMonitorRate = 10
          DemDematurationTime = 0
          DemDematurationMonitorRate = 10
          DemHealingCycleRef = DEM_IGNITION
          DemOperationCycleRef = DEM_IGNITION
          DemIndicatorHealingCycleRef = DEM_IGNITION
          DemPredebounceAlgorithmClass
            DemPreDebounceCounterBased: DemJumpUp=true, DemJumpDown=true, DemCountOutStepSize=127, DemCountInStepSize=127, DemPreDebounceName=DEM_PRE_DEBOUNCE_COUNTER_BASED
      DtcClass34 (DemDTCClass):
        DemDTC = 5608210
        DemDTCKind = DEM_DTC_KIND_ALL_DTCS
        DemDTCSeverity = DEM_DTC_SEV_IMMEDIATELY
        DemDTCFunctionalUnit = 255
        DemDTCSupportWarningIndicator = true
      DTC_0x559313 (DemEventParameter):
        DemEventID = 27
        DemInitMonitorName = (unset)
        DemEventKind = DEM_EVENT_KIND_SWC
        DemImportedEvent = true
        DemExtendedDataRef = (unset)
        DemDTCClassRef = DtcClass35
        DemFreezeFrameClassRef = FFTYPE_NEW38_12
        DemEventClass:
          DemEventPriority = 0
          DemFFPrestorageSupported = false
          DemHealingAllowed = true
          DemEventDestination = DEM_DTC_ORIGIN_PRIMARY_MEMORY
          DemHealingCycleCounter = 40
          DemIndicatorHealingCycleCount = 0
          DemMaturationTime = 0
          DemMaturationMonitorRate = 10
          DemDematurationTime = 0
          DemDematurationMonitorRate = 10
          DemHealingCycleRef = DEM_IGNITION
          DemOperationCycleRef = DEM_IGNITION
          DemIndicatorHealingCycleRef = DEM_IGNITION
          DemPredebounceAlgorithmClass
            DemPreDebounceCounterBased: DemJumpUp=true, DemJumpDown=true, DemCountOutStepSize=127, DemCountInStepSize=127, DemPreDebounceName=DEM_PRE_DEBOUNCE_COUNTER_BASED
      DtcClass35 (DemDTCClass):
        DemDTC = 5608211
        DemDTCKind = DEM_DTC_KIND_ALL_DTCS
        DemDTCSeverity = DEM_DTC_SEV_IMMEDIATELY
        DemDTCFunctionalUnit = 255
        DemDTCSupportWarningIndicator = true
      DTC_0x559349 (DemEventParameter):
        DemEventID = 26
        DemInitMonitorName = (unset)
        DemEventKind = DEM_EVENT_KIND_SWC
        DemImportedEvent = true
        DemExtendedDataRef = (unset)
        DemDTCClassRef = DtcClass36
        DemFreezeFrameClassRef = FFTYPE_NEW38_13
        DemEventClass:
          DemEventPriority = 0
          DemFFPrestorageSupported = false
          DemHealingAllowed = true
          DemEventDestination = DEM_DTC_ORIGIN_PRIMARY_MEMORY
          DemHealingCycleCounter = 40
          DemIndicatorHealingCycleCount = 0
          DemMaturationTime = 0
          DemMaturationMonitorRate = 10
          DemDematurationTime = 0
          DemDematurationMonitorRate = 10
          DemHealingCycleRef = DEM_IGNITION
          DemOperationCycleRef = DEM_IGNITION
          DemIndicatorHealingCycleRef = DEM_IGNITION
          DemPredebounceAlgorithmClass
            DemPreDebounceCounterBased: DemJumpUp=true, DemJumpDown=true, DemCountOutStepSize=127, DemCountInStepSize=127, DemPreDebounceName=DEM_PRE_DEBOUNCE_COUNTER_BASED
      DtcClass36 (DemDTCClass):
        DemDTC = 5608265
        DemDTCKind = DEM_DTC_KIND_ALL_DTCS
        DemDTCSeverity = DEM_DTC_SEV_IMMEDIATELY
        DemDTCFunctionalUnit = 255
        DemDTCSupportWarningIndicator = true
      DTC_0x620525 (DemEventParameter):
        DemEventID = 25
        DemInitMonitorName = (unset)
        DemEventKind = DEM_EVENT_KIND_SWC
        DemImportedEvent = true
        DemExtendedDataRef = (unset)
        DemDTCClassRef = DtcClass37
        DemFreezeFrameClassRef = FFTYPE_NEW38_14
        DemEventClass:
          DemEventPriority = 0
          DemFFPrestorageSupported = false
          DemHealingAllowed = true
          DemEventDestination = DEM_DTC_ORIGIN_PRIMARY_MEMORY
          DemHealingCycleCounter = 40
          DemIndicatorHealingCycleCount = 0
          DemMaturationTime = 0
          DemMaturationMonitorRate = 10
          DemDematurationTime = 0
          DemDematurationMonitorRate = 10
          DemHealingCycleRef = DEM_IGNITION
          DemOperationCycleRef = DEM_IGNITION
          DemIndicatorHealingCycleRef = DEM_IGNITION
          DemPredebounceAlgorithmClass
            DemPreDebounceCounterBased: DemJumpUp=true, DemJumpDown=true, DemCountOutStepSize=127, DemCountInStepSize=127, DemPreDebounceName=DEM_PRE_DEBOUNCE_COUNTER_BASED
      DtcClass37 (DemDTCClass):
        DemDTC = 6423845
        DemDTCKind = DEM_DTC_KIND_ALL_DTCS
        DemDTCSeverity = DEM_DTC_SEV_CHECK_AT_NEXT_HALT
        DemDTCFunctionalUnit = 255
        DemDTCSupportWarningIndicator = true
      DTC_0x621068 (DemEventParameter):
        DemEventID = 24
        DemInitMonitorName = (unset)
        DemEventKind = DEM_EVENT_KIND_SWC
        DemImportedEvent = true
        DemExtendedDataRef = (unset)
        DemDTCClassRef = DtcClass38
        DemFreezeFrameClassRef = FFTYPE_NEW38_15
        DemEventClass:
          DemEventPriority = 0
          DemFFPrestorageSupported = false
          DemHealingAllowed = true
          DemEventDestination = DEM_DTC_ORIGIN_PRIMARY_MEMORY
          DemHealingCycleCounter = 40
          DemIndicatorHealingCycleCount = 0
          DemMaturationTime = 0
          DemMaturationMonitorRate = 10
          DemDematurationTime = 0
          DemDematurationMonitorRate = 10
          DemHealingCycleRef = DEM_IGNITION
          DemOperationCycleRef = DEM_IGNITION
          DemIndicatorHealingCycleRef = DEM_IGNITION
          DemPredebounceAlgorithmClass
            DemPreDebounceCounterBased: DemJumpUp=true, DemJumpDown=true, DemCountOutStepSize=127, DemCountInStepSize=127, DemPreDebounceName=DEM_PRE_DEBOUNCE_COUNTER_BASED
      DtcClass38 (DemDTCClass):
        DemDTC = 6426728
        DemDTCKind = DEM_DTC_KIND_ALL_DTCS
        DemDTCSeverity = DEM_DTC_SEV_CHECK_AT_NEXT_HALT
        DemDTCFunctionalUnit = 255
        DemDTCSupportWarningIndicator = true
      DTC_0x621098 (DemEventParameter):
        DemEventID = 23
        DemInitMonitorName = (unset)
        DemEventKind = DEM_EVENT_KIND_SWC
        DemImportedEvent = true
        DemExtendedDataRef = (unset)
        DemDTCClassRef = DtcClass39
        DemFreezeFrameClassRef = FFTYPE_NEW38_16
        DemEventClass:
          DemEventPriority = 0
          DemFFPrestorageSupported = false
          DemHealingAllowed = true
          DemEventDestination = DEM_DTC_ORIGIN_PRIMARY_MEMORY
          DemHealingCycleCounter = 40
          DemIndicatorHealingCycleCount = 0
          DemMaturationTime = 0
          DemMaturationMonitorRate = 10
          DemDematurationTime = 0
          DemDematurationMonitorRate = 10
          DemHealingCycleRef = DEM_IGNITION
          DemOperationCycleRef = DEM_IGNITION
          DemIndicatorHealingCycleRef = DEM_IGNITION
          DemPredebounceAlgorithmClass
            DemPreDebounceCounterBased: DemJumpUp=true, DemJumpDown=true, DemCountOutStepSize=127, DemCountInStepSize=127, DemPreDebounceName=DEM_PRE_DEBOUNCE_COUNTER_BASED
      DtcClass39 (DemDTCClass):
        DemDTC = 6426776
        DemDTCKind = DEM_DTC_KIND_ALL_DTCS
        DemDTCSeverity = DEM_DTC_SEV_CHECK_AT_NEXT_HALT
        DemDTCFunctionalUnit = 255
        DemDTCSupportWarningIndicator = true
      DTC_0x621748 (DemEventParameter):
        DemEventID = 22
        DemInitMonitorName = (unset)
        DemEventKind = DEM_EVENT_KIND_SWC
        DemImportedEvent = true
        DemExtendedDataRef = (unset)
        DemDTCClassRef = DtcClass40
        DemFreezeFrameClassRef = FFTYPE_NEW38_17
        DemEventClass:
          DemEventPriority = 0
          DemFFPrestorageSupported = false
          DemHealingAllowed = true
          DemEventDestination = DEM_DTC_ORIGIN_PRIMARY_MEMORY
          DemHealingCycleCounter = 40
          DemIndicatorHealingCycleCount = 0
          DemMaturationTime = 0
          DemMaturationMonitorRate = 10
          DemDematurationTime = 0
          DemDematurationMonitorRate = 10
          DemHealingCycleRef = DEM_IGNITION
          DemOperationCycleRef = DEM_IGNITION
          DemIndicatorHealingCycleRef = DEM_IGNITION
          DemPredebounceAlgorithmClass
            DemPreDebounceCounterBased: DemJumpUp=true, DemJumpDown=true, DemCountOutStepSize=127, DemCountInStepSize=127, DemPreDebounceName=DEM_PRE_DEBOUNCE_COUNTER_BASED
      DtcClass40 (DemDTCClass):
        DemDTC = 6428488
        DemDTCKind = DEM_DTC_KIND_ALL_DTCS
        DemDTCSeverity = DEM_DTC_SEV_IMMEDIATELY
        DemDTCFunctionalUnit = 255
        DemDTCSupportWarningIndicator = true
      DTC_0x621749 (DemEventParameter):
        DemEventID = 21
        DemInitMonitorName = (unset)
        DemEventKind = DEM_EVENT_KIND_SWC
        DemImportedEvent = true
        DemExtendedDataRef = (unset)
        DemDTCClassRef = DtcClass41
        DemFreezeFrameClassRef = FFTYPE_NEW38_18
        DemEventClass:
          DemEventPriority = 0
          DemFFPrestorageSupported = false
          DemHealingAllowed = true
          DemEventDestination = DEM_DTC_ORIGIN_PRIMARY_MEMORY
          DemHealingCycleCounter = 40
          DemIndicatorHealingCycleCount = 0
          DemMaturationTime = 0
          DemMaturationMonitorRate = 10
          DemDematurationTime = 0
          DemDematurationMonitorRate = 10
          DemHealingCycleRef = DEM_IGNITION
          DemOperationCycleRef = DEM_IGNITION
          DemIndicatorHealingCycleRef = DEM_IGNITION
          DemPredebounceAlgorithmClass
            DemPreDebounceCounterBased: DemJumpUp=true, DemJumpDown=true, DemCountOutStepSize=127, DemCountInStepSize=127, DemPreDebounceName=DEM_PRE_DEBOUNCE_COUNTER_BASED
      DtcClass41 (DemDTCClass):
        DemDTC = 6428489
        DemDTCKind = DEM_DTC_KIND_ALL_DTCS
        DemDTCSeverity = DEM_DTC_SEV_IMMEDIATELY
        DemDTCFunctionalUnit = 255
        DemDTCSupportWarningIndicator = true
      DTC_0xa19916 (DemEventParameter):
        DemEventID = 20
        DemInitMonitorName = (unset)
        DemEventKind = DEM_EVENT_KIND_SWC
        DemImportedEvent = true
        DemExtendedDataRef = (unset)
        DemDTCClassRef = DtcClass42
        DemFreezeFrameClassRef = FFTYPE_NEW38_19
        DemEventClass:
          DemEventPriority = 0
          DemFFPrestorageSupported = false
          DemHealingAllowed = true
          DemEventDestination = DEM_DTC_ORIGIN_PRIMARY_MEMORY
          DemHealingCycleCounter = 40
          DemIndicatorHealingCycleCount = 0
          DemMaturationTime = 1000
          DemMaturationMonitorRate = 10
          DemDematurationTime = 1000
          DemDematurationMonitorRate = 10
          DemHealingCycleRef = DEM_IGNITION
          DemOperationCycleRef = DEM_IGNITION
          DemIndicatorHealingCycleRef = DEM_IGNITION
          DemPredebounceAlgorithmClass
            DemPreDebounceTimeBase: DemTimeFailedThreshold=1000, DemTimePassedThreshold=1000, DemPreDebounceName=DEM_PRE_DEBOUNCE_TIME_BASED
      DtcClass42 (DemDTCClass):
        DemDTC = 10590486
        DemDTCKind = DEM_DTC_KIND_ALL_DTCS
        DemDTCSeverity = DEM_DTC_SEV_IMMEDIATELY
        DemDTCFunctionalUnit = 255
        DemDTCSupportWarningIndicator = true
      DTC_0xa19917 (DemEventParameter):
        DemEventID = 19
        DemInitMonitorName = (unset)
        DemEventKind = DEM_EVENT_KIND_SWC
        DemImportedEvent = true
        DemExtendedDataRef = (unset)
        DemDTCClassRef = DtcClass43
        DemFreezeFrameClassRef = FFTYPE_NEW38_20
        DemEventClass:
          DemEventPriority = 0
          DemFFPrestorageSupported = false
          DemHealingAllowed = true
          DemEventDestination = DEM_DTC_ORIGIN_PRIMARY_MEMORY
          DemHealingCycleCounter = 40
          DemIndicatorHealingCycleCount = 0
          DemMaturationTime = 1000
          DemMaturationMonitorRate = 10
          DemDematurationTime = 1000
          DemDematurationMonitorRate = 10
          DemHealingCycleRef = DEM_IGNITION
          DemOperationCycleRef = DEM_IGNITION
          DemIndicatorHealingCycleRef = DEM_IGNITION
          DemPredebounceAlgorithmClass
            DemPreDebounceTimeBase: DemTimeFailedThreshold=1000, DemTimePassedThreshold=1000, DemPreDebounceName=DEM_PRE_DEBOUNCE_TIME_BASED
      DtcClass43 (DemDTCClass):
        DemDTC = 10590487
        DemDTCKind = DEM_DTC_KIND_ALL_DTCS
        DemDTCSeverity = DEM_DTC_SEV_IMMEDIATELY
        DemDTCFunctionalUnit = 255
        DemDTCSupportWarningIndicator = true
      DTC_0xa1991c (DemEventParameter):
        DemEventID = 18
        DemInitMonitorName = (unset)
        DemEventKind = DEM_EVENT_KIND_SWC
        DemImportedEvent = true
        DemExtendedDataRef = (unset)
        DemDTCClassRef = DtcClass44
        DemFreezeFrameClassRef = FFTYPE_NEW38_21
        DemEventClass:
          DemEventPriority = 0
          DemFFPrestorageSupported = false
          DemHealingAllowed = true
          DemEventDestination = DEM_DTC_ORIGIN_PRIMARY_MEMORY
          DemHealingCycleCounter = 40
          DemIndicatorHealingCycleCount = 0
          DemMaturationTime = 400000
          DemMaturationMonitorRate = 10
          DemDematurationTime = 1000
          DemDematurationMonitorRate = 10
          DemHealingCycleRef = DEM_IGNITION
          DemOperationCycleRef = DEM_IGNITION
          DemIndicatorHealingCycleRef = DEM_IGNITION
          DemPredebounceAlgorithmClass
            DemPreDebounceTimeBase: DemTimeFailedThreshold=400000, DemTimePassedThreshold=1000, DemPreDebounceName=DEM_PRE_DEBOUNCE_TIME_BASED
      DtcClass44 (DemDTCClass):
        DemDTC = 10590492
        DemDTCKind = DEM_DTC_KIND_ALL_DTCS
        DemDTCSeverity = DEM_DTC_SEV_IMMEDIATELY
        DemDTCFunctionalUnit = 255
        DemDTCSupportWarningIndicator = true
      DTC_0xa22c51 (DemEventParameter):
        DemEventID = 17
        DemInitMonitorName = (unset)
        DemEventKind = DEM_EVENT_KIND_SWC
        DemImportedEvent = true
        DemExtendedDataRef = (unset)
        DemDTCClassRef = DtcClass45
        DemFreezeFrameClassRef = FFTYPE_NEW38_22
        DemEventClass:
          DemEventPriority = 0
          DemFFPrestorageSupported = false
          DemHealingAllowed = true
          DemEventDestination = DEM_DTC_ORIGIN_PRIMARY_MEMORY
          DemHealingCycleCounter = 40
          DemIndicatorHealingCycleCount = 0
          DemMaturationTime = 0
          DemMaturationMonitorRate = 10
          DemDematurationTime = 0
          DemDematurationMonitorRate = 10
          DemHealingCycleRef = DEM_IGNITION
          DemOperationCycleRef = DEM_IGNITION
          DemIndicatorHealingCycleRef = DEM_IGNITION
          DemPredebounceAlgorithmClass
            DemPreDebounceCounterBased: DemJumpUp=true, DemJumpDown=true, DemCountOutStepSize=127, DemCountInStepSize=127, DemPreDebounceName=DEM_PRE_DEBOUNCE_COUNTER_BASED
      DtcClass45 (DemDTCClass):
        DemDTC = 10628177
        DemDTCKind = DEM_DTC_KIND_ALL_DTCS
        DemDTCSeverity = DEM_DTC_SEV_MAINTENANCE_ONLY
        DemDTCFunctionalUnit = 255
        DemDTCSupportWarningIndicator = true
      DTC_0xa23b05 (DemEventParameter):
        DemEventID = 16
        DemInitMonitorName = (unset)
        DemEventKind = DEM_EVENT_KIND_SWC
        DemImportedEvent = true
        DemExtendedDataRef = (unset)
        DemDTCClassRef = DtcClass46
        DemFreezeFrameClassRef = FFTYPE_NEW38_23
        DemEventClass:
          DemEventPriority = 0
          DemFFPrestorageSupported = false
          DemHealingAllowed = true
          DemEventDestination = DEM_DTC_ORIGIN_PRIMARY_MEMORY
          DemHealingCycleCounter = 40
          DemIndicatorHealingCycleCount = 0
          DemMaturationTime = 0
          DemMaturationMonitorRate = 10
          DemDematurationTime = 0
          DemDematurationMonitorRate = 10
          DemHealingCycleRef = DEM_IGNITION
          DemOperationCycleRef = DEM_IGNITION
          DemIndicatorHealingCycleRef = DEM_IGNITION
          DemPredebounceAlgorithmClass
            DemPreDebounceCounterBased: DemJumpUp=true, DemJumpDown=true, DemCountOutStepSize=127, DemCountInStepSize=127, DemPreDebounceName=DEM_PRE_DEBOUNCE_COUNTER_BASED
      DtcClass46 (DemDTCClass):
        DemDTC = 10631941
        DemDTCKind = DEM_DTC_KIND_ALL_DTCS
        DemDTCSeverity = DEM_DTC_SEV_MAINTENANCE_ONLY
        DemDTCFunctionalUnit = 255
        DemDTCSupportWarningIndicator = true
      DTC_0xc00187 (DemEventParameter):
        DemEventID = 15
        DemInitMonitorName = (unset)
        DemEventKind = DEM_EVENT_KIND_SWC
        DemImportedEvent = true
        DemExtendedDataRef = (unset)
        DemDTCClassRef = DtcClass47
        DemFreezeFrameClassRef = FFTYPE_NEW38_24
        DemEventClass:
          DemEventPriority = 0
          DemFFPrestorageSupported = false
          DemHealingAllowed = true
          DemEventDestination = DEM_DTC_ORIGIN_PRIMARY_MEMORY
          DemHealingCycleCounter = 40
          DemIndicatorHealingCycleCount = 0
          DemMaturationTime = 0
          DemMaturationMonitorRate = 10
          DemDematurationTime = 0
          DemDematurationMonitorRate = 10
          DemHealingCycleRef = DEM_IGNITION
          DemOperationCycleRef = DEM_IGNITION
          DemIndicatorHealingCycleRef = DEM_IGNITION
          DemPredebounceAlgorithmClass
            DemPreDebounceCounterBased: DemJumpUp=true, DemJumpDown=true, DemCountOutStepSize=127, DemCountInStepSize=127, DemPreDebounceName=DEM_PRE_DEBOUNCE_COUNTER_BASED
      DtcClass47 (DemDTCClass):
        DemDTC = 12583303
        DemDTCKind = DEM_DTC_KIND_ALL_DTCS
        DemDTCSeverity = DEM_DTC_SEV_MAINTENANCE_ONLY
        DemDTCFunctionalUnit = 255
        DemDTCSupportWarningIndicator = true
      DTC_0xc00188 (DemEventParameter):
        DemEventID = 14
        DemInitMonitorName = (unset)
        DemEventKind = DEM_EVENT_KIND_SWC
        DemImportedEvent = true
        DemExtendedDataRef = (unset)
        DemDTCClassRef = DtcClass48
        DemFreezeFrameClassRef = FFTYPE_NEW38_25
        DemEventClass:
          DemEventPriority = 0
          DemFFPrestorageSupported = false
          DemHealingAllowed = true
          DemEventDestination = DEM_DTC_ORIGIN_PRIMARY_MEMORY
          DemHealingCycleCounter = 40
          DemIndicatorHealingCycleCount = 0
          DemMaturationTime = 0
          DemMaturationMonitorRate = 10
          DemDematurationTime = 0
          DemDematurationMonitorRate = 10
          DemHealingCycleRef = DEM_IGNITION
          DemOperationCycleRef = DEM_IGNITION
          DemIndicatorHealingCycleRef = DEM_IGNITION
          DemPredebounceAlgorithmClass
            DemPreDebounceCounterBased: DemJumpUp=true, DemJumpDown=true, DemCountOutStepSize=127, DemCountInStepSize=127, DemPreDebounceName=DEM_PRE_DEBOUNCE_COUNTER_BASED
      DtcClass48 (DemDTCClass):
        DemDTC = 12583304
        DemDTCKind = DEM_DTC_KIND_ALL_DTCS
        DemDTCSeverity = DEM_DTC_SEV_MAINTENANCE_ONLY
        DemDTCFunctionalUnit = 255
        DemDTCSupportWarningIndicator = true
      DTC_0xc10087 (DemEventParameter):
        DemEventID = 13
        DemInitMonitorName = (unset)
        DemEventKind = DEM_EVENT_KIND_SWC
        DemImportedEvent = true
        DemExtendedDataRef = (unset)
        DemDTCClassRef = DtcClass49
        DemFreezeFrameClassRef = FFTYPE_NEW38_26
        DemEventClass:
          DemEventPriority = 0
          DemFFPrestorageSupported = false
          DemHealingAllowed = true
          DemEventDestination = DEM_DTC_ORIGIN_PRIMARY_MEMORY
          DemHealingCycleCounter = 40
          DemIndicatorHealingCycleCount = 0
          DemMaturationTime = 0
          DemMaturationMonitorRate = 10
          DemDematurationTime = 0
          DemDematurationMonitorRate = 10
          DemHealingCycleRef = DEM_IGNITION
          DemOperationCycleRef = DEM_IGNITION
          DemIndicatorHealingCycleRef = DEM_IGNITION
          DemPredebounceAlgorithmClass
            DemPreDebounceCounterBased: DemJumpUp=true, DemJumpDown=true, DemCountOutStepSize=127, DemCountInStepSize=127, DemPreDebounceName=DEM_PRE_DEBOUNCE_COUNTER_BASED
      DtcClass49 (DemDTCClass):
        DemDTC = 12648583
        DemDTCKind = DEM_DTC_KIND_ALL_DTCS
        DemDTCSeverity = DEM_DTC_SEV_MAINTENANCE_ONLY
        DemDTCFunctionalUnit = 255
        DemDTCSupportWarningIndicator = true
      DTC_0xc4012f (DemEventParameter):
        DemEventID = 12
        DemInitMonitorName = (unset)
        DemEventKind = DEM_EVENT_KIND_SWC
        DemImportedEvent = true
        DemExtendedDataRef = (unset)
        DemDTCClassRef = DtcClass50
        DemFreezeFrameClassRef = FFTYPE_NEW38_27
        DemEventClass:
          DemEventPriority = 0
          DemFFPrestorageSupported = false
          DemHealingAllowed = true
          DemEventDestination = DEM_DTC_ORIGIN_PRIMARY_MEMORY
          DemHealingCycleCounter = 40
          DemIndicatorHealingCycleCount = 0
          DemMaturationTime = 0
          DemMaturationMonitorRate = 10
          DemDematurationTime = 0
          DemDematurationMonitorRate = 10
          DemHealingCycleRef = DEM_IGNITION
          DemOperationCycleRef = DEM_IGNITION
          DemIndicatorHealingCycleRef = DEM_IGNITION
          DemPredebounceAlgorithmClass
            DemPreDebounceCounterBased: DemJumpUp=true, DemJumpDown=true, DemCountOutStepSize=127, DemCountInStepSize=127, DemPreDebounceName=DEM_PRE_DEBOUNCE_COUNTER_BASED
      DtcClass50 (DemDTCClass):
        DemDTC = 12845359
        DemDTCKind = DEM_DTC_KIND_ALL_DTCS
        DemDTCSeverity = DEM_DTC_SEV_MAINTENANCE_ONLY
        DemDTCFunctionalUnit = 255
        DemDTCSupportWarningIndicator = true
      DTC_0xc4152f (DemEventParameter):
        DemEventID = 11
        DemInitMonitorName = (unset)
        DemEventKind = DEM_EVENT_KIND_SWC
        DemImportedEvent = true
        DemExtendedDataRef = (unset)
        DemDTCClassRef = DtcClass51
        DemFreezeFrameClassRef = FFTYPE_NEW38_28
        DemEventClass:
          DemEventPriority = 0
          DemFFPrestorageSupported = false
          DemHealingAllowed = true
          DemEventDestination = DEM_DTC_ORIGIN_PRIMARY_MEMORY
          DemHealingCycleCounter = 40
          DemIndicatorHealingCycleCount = 0
          DemMaturationTime = 0
          DemMaturationMonitorRate = 10
          DemDematurationTime = 0
          DemDematurationMonitorRate = 10
          DemHealingCycleRef = DEM_IGNITION
          DemOperationCycleRef = DEM_IGNITION
          DemIndicatorHealingCycleRef = DEM_IGNITION
          DemPredebounceAlgorithmClass
            DemPreDebounceCounterBased: DemJumpUp=true, DemJumpDown=true, DemCountOutStepSize=127, DemCountInStepSize=127, DemPreDebounceName=DEM_PRE_DEBOUNCE_COUNTER_BASED
      DtcClass51 (DemDTCClass):
        DemDTC = 12850479
        DemDTCKind = DEM_DTC_KIND_ALL_DTCS
        DemDTCSeverity = DEM_DTC_SEV_MAINTENANCE_ONLY
        DemDTCFunctionalUnit = 255
        DemDTCSupportWarningIndicator = true
      DTC_0xc4222f (DemEventParameter):
        DemEventID = 10
        DemInitMonitorName = (unset)
        DemEventKind = DEM_EVENT_KIND_SWC
        DemImportedEvent = true
        DemExtendedDataRef = (unset)
        DemDTCClassRef = DtcClass52
        DemFreezeFrameClassRef = FFTYPE_NEW38_29
        DemEventClass:
          DemEventPriority = 0
          DemFFPrestorageSupported = false
          DemHealingAllowed = true
          DemEventDestination = DEM_DTC_ORIGIN_PRIMARY_MEMORY
          DemHealingCycleCounter = 40
          DemIndicatorHealingCycleCount = 0
          DemMaturationTime = 0
          DemMaturationMonitorRate = 10
          DemDematurationTime = 0
          DemDematurationMonitorRate = 10
          DemHealingCycleRef = DEM_IGNITION
          DemOperationCycleRef = DEM_IGNITION
          DemIndicatorHealingCycleRef = DEM_IGNITION
          DemPredebounceAlgorithmClass
            DemPreDebounceCounterBased: DemJumpUp=true, DemJumpDown=true, DemCountOutStepSize=127, DemCountInStepSize=127, DemPreDebounceName=DEM_PRE_DEBOUNCE_COUNTER_BASED
      DtcClass52 (DemDTCClass):
        DemDTC = 12853807
        DemDTCKind = DEM_DTC_KIND_ALL_DTCS
        DemDTCSeverity = DEM_DTC_SEV_MAINTENANCE_ONLY
        DemDTCFunctionalUnit = 255
        DemDTCSupportWarningIndicator = true
      DTC_0xc4232f (DemEventParameter):
        DemEventID = 9
        DemInitMonitorName = (unset)
        DemEventKind = DEM_EVENT_KIND_SWC
        DemImportedEvent = true
        DemExtendedDataRef = (unset)
        DemDTCClassRef = DtcClass53
        DemFreezeFrameClassRef = FFTYPE_NEW38_30
        DemEventClass:
          DemEventPriority = 0
          DemFFPrestorageSupported = false
          DemHealingAllowed = true
          DemEventDestination = DEM_DTC_ORIGIN_PRIMARY_MEMORY
          DemHealingCycleCounter = 40
          DemIndicatorHealingCycleCount = 0
          DemMaturationTime = 0
          DemMaturationMonitorRate = 10
          DemDematurationTime = 0
          DemDematurationMonitorRate = 10
          DemHealingCycleRef = DEM_IGNITION
          DemOperationCycleRef = DEM_IGNITION
          DemIndicatorHealingCycleRef = DEM_IGNITION
          DemPredebounceAlgorithmClass
            DemPreDebounceCounterBased: DemJumpUp=true, DemJumpDown=true, DemCountOutStepSize=127, DemCountInStepSize=127, DemPreDebounceName=DEM_PRE_DEBOUNCE_COUNTER_BASED
      DtcClass53 (DemDTCClass):
        DemDTC = 12854063
        DemDTCKind = DEM_DTC_KIND_ALL_DTCS
        DemDTCSeverity = DEM_DTC_SEV_MAINTENANCE_ONLY
        DemDTCFunctionalUnit = 255
        DemDTCSupportWarningIndicator = true
      DTC_0xd00587 (DemEventParameter):
        DemEventID = 8
        DemInitMonitorName = (unset)
        DemEventKind = DEM_EVENT_KIND_SWC
        DemImportedEvent = true
        DemExtendedDataRef = (unset)
        DemDTCClassRef = DtcClass54
        DemFreezeFrameClassRef = FFTYPE_NEW38_31
        DemEventClass:
          DemEventPriority = 0
          DemFFPrestorageSupported = false
          DemHealingAllowed = false
          DemEventDestination = DEM_DTC_ORIGIN_PRIMARY_MEMORY
          DemHealingCycleCounter = 40
          DemIndicatorHealingCycleCount = 0
          DemMaturationTime = 300000
          DemMaturationMonitorRate = 10
          DemDematurationTime = 0
          DemDematurationMonitorRate = 10
          DemHealingCycleRef = DEM_IGNITION
          DemOperationCycleRef = DEM_IGNITION
          DemIndicatorHealingCycleRef = DEM_IGNITION
          DemPredebounceAlgorithmClass
            DemPreDebounceTimeBase: DemTimeFailedThreshold=300000, DemTimePassedThreshold=1, DemPreDebounceName=DEM_PRE_DEBOUNCE_TIME_BASED
      DtcClass54 (DemDTCClass):
        DemDTC = 13632903
        DemDTCKind = DEM_DTC_KIND_ALL_DTCS
        DemDTCSeverity = DEM_DTC_SEV_CHECK_AT_NEXT_HALT
        DemDTCFunctionalUnit = 255
        DemDTCSupportWarningIndicator = false
      DTC_0xd00687 (DemEventParameter):
        DemEventID = 7
        DemInitMonitorName = (unset)
        DemEventKind = DEM_EVENT_KIND_SWC
        DemImportedEvent = true
        DemExtendedDataRef = (unset)
        DemDTCClassRef = DtcClass55
        DemFreezeFrameClassRef = FFTYPE_NEW38_32
        DemEventClass:
          DemEventPriority = 0
          DemFFPrestorageSupported = false
          DemHealingAllowed = false
          DemEventDestination = DEM_DTC_ORIGIN_PRIMARY_MEMORY
          DemHealingCycleCounter = 40
          DemIndicatorHealingCycleCount = 0
          DemMaturationTime = 2000
          DemMaturationMonitorRate = 10
          DemDematurationTime = 0
          DemDematurationMonitorRate = 10
          DemHealingCycleRef = DEM_IGNITION
          DemOperationCycleRef = DEM_IGNITION
          DemIndicatorHealingCycleRef = DEM_IGNITION
          DemPredebounceAlgorithmClass
            DemPreDebounceTimeBase: DemTimeFailedThreshold=2000, DemTimePassedThreshold=1, DemPreDebounceName=DEM_PRE_DEBOUNCE_TIME_BASED
      DtcClass55 (DemDTCClass):
        DemDTC = 13633159
        DemDTCKind = DEM_DTC_KIND_ALL_DTCS
        DemDTCSeverity = DEM_DTC_SEV_MAINTENANCE_ONLY
        DemDTCFunctionalUnit = 255
        DemDTCSupportWarningIndicator = false
      DTC_0xd00787 (DemEventParameter):
        DemEventID = 6
        DemInitMonitorName = (unset)
        DemEventKind = DEM_EVENT_KIND_SWC
        DemImportedEvent = true
        DemExtendedDataRef = (unset)
        DemDTCClassRef = DtcClass56
        DemFreezeFrameClassRef = FFTYPE_NEW38_33
        DemEventClass:
          DemEventPriority = 0
          DemFFPrestorageSupported = false
          DemHealingAllowed = false
          DemEventDestination = DEM_DTC_ORIGIN_PRIMARY_MEMORY
          DemHealingCycleCounter = 40
          DemIndicatorHealingCycleCount = 0
          DemMaturationTime = 300000
          DemMaturationMonitorRate = 10
          DemDematurationTime = 0
          DemDematurationMonitorRate = 10
          DemHealingCycleRef = DEM_IGNITION
          DemOperationCycleRef = DEM_IGNITION
          DemIndicatorHealingCycleRef = DEM_IGNITION
          DemPredebounceAlgorithmClass
            DemPreDebounceTimeBase: DemTimeFailedThreshold=300000, DemTimePassedThreshold=1, DemPreDebounceName=DEM_PRE_DEBOUNCE_TIME_BASED
      DtcClass56 (DemDTCClass):
        DemDTC = 13633415
        DemDTCKind = DEM_DTC_KIND_ALL_DTCS
        DemDTCSeverity = DEM_DTC_SEV_CHECK_AT_NEXT_HALT
        DemDTCFunctionalUnit = 255
        DemDTCSupportWarningIndicator = false
      DTC_0xd01087 (DemEventParameter):
        DemEventID = 5
        DemInitMonitorName = (unset)
        DemEventKind = DEM_EVENT_KIND_SWC
        DemImportedEvent = true
        DemExtendedDataRef = (unset)
        DemDTCClassRef = DtcClass57
        DemFreezeFrameClassRef = FFTYPE_NEW38_34
        DemEventClass:
          DemEventPriority = 0
          DemFFPrestorageSupported = false
          DemHealingAllowed = false
          DemEventDestination = DEM_DTC_ORIGIN_PRIMARY_MEMORY
          DemHealingCycleCounter = 40
          DemIndicatorHealingCycleCount = 0
          DemMaturationTime = 1000
          DemMaturationMonitorRate = 10
          DemDematurationTime = 0
          DemDematurationMonitorRate = 10
          DemHealingCycleRef = DEM_IGNITION
          DemOperationCycleRef = DEM_IGNITION
          DemIndicatorHealingCycleRef = DEM_IGNITION
          DemPredebounceAlgorithmClass
            DemPreDebounceTimeBase: DemTimeFailedThreshold=1000, DemTimePassedThreshold=1, DemPreDebounceName=DEM_PRE_DEBOUNCE_TIME_BASED
      DtcClass57 (DemDTCClass):
        DemDTC = 13635719
        DemDTCKind = DEM_DTC_KIND_ALL_DTCS
        DemDTCSeverity = DEM_DTC_SEV_CHECK_AT_NEXT_HALT
        DemDTCFunctionalUnit = 255
        DemDTCSupportWarningIndicator = false
      DTC_0xd01187 (DemEventParameter):
        DemEventID = 4
        DemInitMonitorName = (unset)
        DemEventKind = DEM_EVENT_KIND_SWC
        DemImportedEvent = true
        DemExtendedDataRef = (unset)
        DemDTCClassRef = DtcClass58
        DemFreezeFrameClassRef = FFTYPE_NEW38_35
        DemEventClass:
          DemEventPriority = 0
          DemFFPrestorageSupported = false
          DemHealingAllowed = false
          DemEventDestination = DEM_DTC_ORIGIN_PRIMARY_MEMORY
          DemHealingCycleCounter = 40
          DemIndicatorHealingCycleCount = 0
          DemMaturationTime = 2000
          DemMaturationMonitorRate = 10
          DemDematurationTime = 0
          DemDematurationMonitorRate = 10
          DemHealingCycleRef = DEM_IGNITION
          DemOperationCycleRef = DEM_IGNITION
          DemIndicatorHealingCycleRef = DEM_IGNITION
          DemPredebounceAlgorithmClass
            DemPreDebounceTimeBase: DemTimeFailedThreshold=2000, DemTimePassedThreshold=1, DemPreDebounceName=DEM_PRE_DEBOUNCE_TIME_BASED
      DtcClass58 (DemDTCClass):
        DemDTC = 13635975
        DemDTCKind = DEM_DTC_KIND_ALL_DTCS
        DemDTCSeverity = DEM_DTC_SEV_CHECK_AT_NEXT_HALT
        DemDTCFunctionalUnit = 255
        DemDTCSupportWarningIndicator = false
      DTC_0xd01387 (DemEventParameter):
        DemEventID = 3
        DemInitMonitorName = (unset)
        DemEventKind = DEM_EVENT_KIND_SWC
        DemImportedEvent = true
        DemExtendedDataRef = (unset)
        DemDTCClassRef = DtcClass59
        DemFreezeFrameClassRef = FFTYPE_NEW38_36
        DemEventClass:
          DemEventPriority = 0
          DemFFPrestorageSupported = false
          DemHealingAllowed = true
          DemEventDestination = DEM_DTC_ORIGIN_PRIMARY_MEMORY
          DemHealingCycleCounter = 40
          DemIndicatorHealingCycleCount = 0
          DemMaturationTime = 2000
          DemMaturationMonitorRate = 10
          DemDematurationTime = 0
          DemDematurationMonitorRate = 10
          DemHealingCycleRef = DEM_IGNITION
          DemOperationCycleRef = DEM_IGNITION
          DemIndicatorHealingCycleRef = DEM_IGNITION
          DemPredebounceAlgorithmClass
            DemPreDebounceTimeBase: DemTimeFailedThreshold=2000, DemTimePassedThreshold=1, DemPreDebounceName=DEM_PRE_DEBOUNCE_TIME_BASED
      DtcClass59 (DemDTCClass):
        DemDTC = 13636487
        DemDTCKind = DEM_DTC_KIND_ALL_DTCS
        DemDTCSeverity = DEM_DTC_SEV_MAINTENANCE_ONLY
        DemDTCFunctionalUnit = 255
        DemDTCSupportWarningIndicator = true
      3 x DemEventParameter, all with DemInitMonitorName=(unset), DemExtendedDataRef=(unset):
        DTC_0xd93286: DemEventID=2, DemEventKind=DEM_EVENT_KIND_SWC, DemImportedEvent=true, DemDTCClassRef=DtcClass60, DemFreezeFrameClassRef=FFTYPE_NEW38_37
          DemEventClass:
            DemEventPriority = 0
            DemFFPrestorageSupported = false
            DemHealingAllowed = true
            DemEventDestination = DEM_DTC_ORIGIN_PRIMARY_MEMORY
            DemHealingCycleCounter = 40
            DemIndicatorHealingCycleCount = 0
            DemMaturationTime = 0
            DemMaturationMonitorRate = 10
            DemDematurationTime = 0
            DemDematurationMonitorRate = 10
            DemHealingCycleRef = DEM_IGNITION
            DemOperationCycleRef = DEM_IGNITION
            DemIndicatorHealingCycleRef = DEM_IGNITION
            DemPredebounceAlgorithmClass
              DemPreDebounceCounterBased: DemJumpUp=true, DemJumpDown=true, DemCountOutStepSize=127, DemCountInStepSize=127, DemPreDebounceName=DEM_PRE_DEBOUNCE_COUNTER_BASED
        DTC_0xd95283: DemEventID=1, DemEventKind=DEM_EVENT_KIND_SWC, DemImportedEvent=true, DemDTCClassRef=DtcClass61, DemFreezeFrameClassRef=FFTYPE_NEW38_38
          DemEventClass:
            DemEventPriority = 0
            DemFFPrestorageSupported = false
            DemHealingAllowed = true
            DemEventDestination = DEM_DTC_ORIGIN_PRIMARY_MEMORY
            DemHealingCycleCounter = 40
            DemIndicatorHealingCycleCount = 0
            DemMaturationTime = 0
            DemMaturationMonitorRate = 10
            DemDematurationTime = 0
            DemDematurationMonitorRate = 10
            DemHealingCycleRef = DEM_IGNITION
            DemOperationCycleRef = DEM_IGNITION
            DemIndicatorHealingCycleRef = DEM_IGNITION
            DemPredebounceAlgorithmClass
              DemPreDebounceCounterBased: DemJumpUp=true, DemJumpDown=true, DemCountOutStepSize=127, DemCountInStepSize=127, DemPreDebounceName=DEM_PRE_DEBOUNCE_COUNTER_BASED
        CANNM_E_NETWORK_TIMEOUT: DemEventID=56, DemEventKind=DEM_EVENT_KIND_BSW, DemImportedEvent=false, DemDTCClassRef=DtcClass16
          DemEventClass:
            DemEventPriority = 0
            DemFFPrestorageSupported = false
            DemHealingAllowed = false
            DemHealingCycleCounter = 40
            DemIndicatorHealingCycleCount = 0
            DemMaturationTime = 0
            DemMaturationMonitorRate = 0
            DemDematurationTime = 0
            DemDematurationMonitorRate = 0
            DemHealingCycleRef = (unset)
            DemIndicatorHealingCycleRef = (unset)
            DemOperationCycleRef = DEM_IGNITION
            DemPredebounceAlgorithmClass
              DemPreDebounceCounterBased: DemJumpUp=true, DemJumpDown=true, DemCountOutStepSize=1, DemCountInStepSize=1, DemPreDebounceName=DEM_PRE_DEBOUNCE_COUNTER_BASED
      DtcClass60 (DemDTCClass):
        DemDTC = 14234246
        DemDTCKind = DEM_DTC_KIND_ALL_DTCS
        DemDTCSeverity = DEM_DTC_SEV_MAINTENANCE_ONLY
        DemDTCFunctionalUnit = 255
        DemDTCSupportWarningIndicator = true
      COMM_E_NET_START_IND_CHANNEL_0 (DemEventParameter):
        DemEventID = 57
        DemInitMonitorName = (unset)
        DemEventKind = DEM_EVENT_KIND_BSW
        DemImportedEvent = false
        DemExtendedDataRef = (unset)
        DemDTCClassRef = DtcClass17
        DemEventClass:
          DemEventPriority = 0
          DemFFPrestorageSupported = false
          DemHealingAllowed = false
          DemHealingCycleCounter = 40
          DemIndicatorHealingCycleCount = 0
          DemMaturationTime = 0
          DemMaturationMonitorRate = 0
          DemDematurationTime = 0
          DemDematurationMonitorRate = 0
          DemHealingCycleRef = (unset)
          DemIndicatorHealingCycleRef = (unset)
          DemOperationCycleRef = DEM_IGNITION
          DemPredebounceAlgorithmClass
            DemPreDebounceCounterBased: DemJumpUp=true, DemJumpDown=true, DemCountOutStepSize=1, DemCountInStepSize=1, DemPreDebounceName=DEM_PRE_DEBOUNCE_COUNTER_BASED
      DtcClass61 (DemDTCClass):
        DemDTC = 14242435
        DemDTCKind = DEM_DTC_KIND_ALL_DTCS
        DemDTCSeverity = DEM_DTC_SEV_MAINTENANCE_ONLY
        DemDTCFunctionalUnit = 255
        DemDTCSupportWarningIndicator = true
  module config Det: implementation-config-variant=VARIANT-PRE-COMPILE, module-description=Det_Impl
    VectorCommonData: BswmdVersion=1.09.01
    DetGlobalConfig:
      DetEnableDet = true
      DetVersionInfoApi = false
      DetExtDebugSupport = false
      DetGlobalFilterSize = 0
      DetBreakFilterSize = 0
      DetLogBufferSize = 0
      DetEntryCallout = false
      DetConfigurationVariant = PreCompile
  module config GenyAsrBase_Cfg: definition=GenTool_GenyAsrBase_Def, module-description=GenyAsrBase_Impl
    General: AsrBaseMaxShortnameLength=L32
  module config BswM: implementation-config-variant=VARIANT-PRE-COMPILE, module-description=BswM_Impl
    VectorCommonData: BswmdVersion=1.10.00
    BswMGeneral:
      BswMVersionInfoApi = false
      BswMDevErrorDetect = false
      BswMDcmComControl = true
      BswMDcmResteMode = true
      BswMDcmPassiveMode = false
      BswMHeaderFilesPath = 
      BswMMainFunctionPeriod = 0.01
      BswMDcmApplicationUpdated = false
      BswMDcmApplUpdateAsModePort = false
      BswMDcmResetExecutionRequest = false
      BswMAmdRuntimeMeasurement = false
      BswMSoftwareComponentName = BswM
    BswMConfig: BswMEcuMConfigurationRef=EcuMConfiguration
      BswMArbitration
        7 x BswMRule:
          StdRule_ComCtrl_Disable_NORM_CCAN: BswMRuleInitState=BSWM_FALSE, BswMRuleExpressionRef=AND_3, BswMRuleTrueActionList=ActionTrueList_6
          StdRule_ComCtrl_Enable_NORM_CCAN: BswMRuleInitState=BSWM_TRUE, BswMRuleExpressionRef=AND_0, BswMRuleTrueActionList=ActionTrueList_5
          StdRule_Switch_DM_CCAN: BswMRuleInitState=BSWM_FALSE, BswMRuleExpressionRef=LogicExpr_StdRule_Switch_DM_CCAN, BswMRuleTrueActionList=ActionTrueList_2, BswMRuleFalseActionList=ActionFalseList_2
          StdRule_Switch_Tx_CCAN: BswMRuleInitState=BSWM_FALSE, BswMRuleExpressionRef=LogicExpr_StdRule_Switch_Tx_CCAN, BswMRuleTrueActionList=ActionTrueList_1, BswMRuleFalseActionList=ActionFalseList_1
          StdRule_Switch_Rx_CCAN: BswMRuleInitState=BSWM_FALSE, BswMRuleExpressionRef=LogicExpr_StdRule_Switch_Rx_CCAN, BswMRuleTrueActionList=ActionTrueList_0, BswMRuleFalseActionList=ActionFalseList_0
          StdRule_ComCtrl_Disable_Nm_CCAN: BswMRuleInitState=BSWM_FALSE, BswMRuleExpressionRef=OR_0, BswMRuleTrueActionList=ActionTrueList_3
          StdRule_ComCtrl_Enable_Nm_CCAN: BswMRuleInitState=BSWM_TRUE, BswMRuleExpressionRef=OR_3, BswMRuleTrueActionList=ActionTrueList_4
        6 x BswMModeRequestPort:
          COMM_MODE_INDICATION_CCAN: BswMModeInitValue=COMM_NO_COMMUNICATION, BswMRequestProcessing=BSWM_IMMEDIATE, BswMModeReqPortType=BSWM_BSW_MODE
            BswMModeRequestSource
              BswMComMIndication: BswMComMChannelRef=ComM/CCAN
          CANSM_MODE_INDICATION_CCAN: BswMModeInitValue=CANSM_BSWM_NO_COMMUNICATION, BswMRequestProcessing=BSWM_IMMEDIATE, BswMModeReqPortType=BSWM_BSW_MODE
            BswMModeRequestSource
              BswMCanSMIndication: BswMCanSMChannelRef=CanStateManagerConfiguration/CCAN
          DCM_RESET_MODE_REQUEST: BswMModeInitValue=NM_STATE_BUS_SLEEP, BswMRequestProcessing=BSWM_IMMEDIATE, BswMModeReqPortType=BSWM_BSW_MODE
            BswMModeRequestSource
              BswMDcmResetModeRequest
          DCM_COM_MODE_REQUEST_CCAN: BswMModeInitValue=DCM_ENABLE_RX_TX_NORM_NM, BswMRequestProcessing=BSWM_IMMEDIATE, BswMModeReqPortType=BSWM_BSW_MODE
            BswMModeRequestSource
              BswMDcmComModeRequest: BswMDcmComMNetworkRef=ComM/CCAN
          COMM_PREVIOUS_MODE_CCAN: BswMModeInitValue=COMM_NO_COMMUNICATION, BswMModeReqPortType=BSWM_BSW_PREV_MODE
            BswMModeRequestSource
              BswMComMIndication
          CANSM_PREVIOUS_MODE_CCAN: BswMModeInitValue=CANSM_BSWM_NO_COMMUNICATION, BswMModeReqPortType=BSWM_BSW_PREV_MODE
            BswMModeRequestSource
              BswMCanSMIndication
        19 x BswMModeCondition:
          Cond18: BswMConditionType=BSWM_EQUALS, BswMConditionMode=DCM_COM_MODE_REQUEST_CCAN
            BswMConditionValue
              BswMBswMode: BswMBswRequestedMode=DCM_ENABLE_RX_DISABLE_TX_NORM_NM
          Cond17: BswMConditionType=BSWM_EQUALS, BswMConditionMode=DCM_COM_MODE_REQUEST_CCAN
            BswMConditionValue
              BswMBswMode: BswMBswRequestedMode=DCM_ENABLE_RX_DISABLE_TX_NORM
          Cond16: BswMConditionType=BSWM_EQUALS, BswMConditionMode=DCM_COM_MODE_REQUEST_CCAN
            BswMConditionValue
              BswMBswMode: BswMBswRequestedMode=DCM_DISABLE_RX_TX_NORMAL
          Cond15: BswMConditionType=BSWM_EQUALS, BswMConditionMode=DCM_COM_MODE_REQUEST_CCAN
            BswMConditionValue
              BswMBswMode: BswMBswRequestedMode=DCM_DISABLE_RX_TX_NORM_NM
          Cond14: BswMConditionType=BSWM_EQUALS, BswMConditionMode=DCM_COM_MODE_REQUEST_CCAN
            BswMConditionValue
              BswMBswMode: BswMBswRequestedMode=DCM_ENABLE_RX_TX_NORM_NM
          Cond13: BswMConditionType=BSWM_EQUALS, BswMConditionMode=DCM_COM_MODE_REQUEST_CCAN
            BswMConditionValue
              BswMBswMode: BswMBswRequestedMode=DCM_ENABLE_RX_TX_NORM
          Cond12: BswMConditionType=BSWM_EQUALS, BswMConditionMode=DCM_COM_MODE_REQUEST_CCAN
            BswMConditionValue
              BswMBswMode: BswMBswRequestedMode=DCM_DISABLE_RX_ENABLE_TX_NORM_NM
          Cond11: BswMConditionType=BSWM_EQUALS, BswMConditionMode=DCM_COM_MODE_REQUEST_CCAN
            BswMConditionValue
              BswMBswMode: BswMBswRequestedMode=DCM_DISABLE_RX_ENABLE_TX_NORM
          Cond10: BswMConditionType=BSWM_EQUALS, BswMConditionMode=CANSM_MODE_INDICATION_CCAN
            BswMConditionValue
              BswMBswMode: BswMBswRequestedMode=CANSM_BSWM_FULL_COMMUNICATION
          Cond5: BswMConditionType=BSWM_EQUALS, BswMConditionMode=CANSM_MODE_INDICATION_CCAN
            BswMConditionValue
              BswMBswMode: BswMBswRequestedMode=CANSM_BSWM_FULL_COMMUNICATION
          Cond0: BswMConditionType=BSWM_EQUALS_NOT, BswMConditionMode=CANSM_MODE_INDICATION_CCAN
            BswMConditionValue
              BswMBswMode: BswMBswRequestedMode=CANSM_BSWM_NO_COMMUNICATION
          Cond1: BswMConditionType=BSWM_EQUALS, BswMConditionMode=DCM_COM_MODE_REQUEST_CCAN
            BswMConditionValue
              BswMBswMode: BswMBswRequestedMode=DCM_ENABLE_RX_DISABLE_TX_NM
          Cond2: BswMConditionType=BSWM_EQUALS, BswMConditionMode=DCM_COM_MODE_REQUEST_CCAN
            BswMConditionValue
              BswMBswMode: BswMBswRequestedMode=DCM_DISABLE_RX_TX_NM
          Cond3: BswMConditionType=BSWM_EQUALS, BswMConditionMode=DCM_COM_MODE_REQUEST_CCAN
            BswMConditionValue
              BswMBswMode: BswMBswRequestedMode=DCM_ENABLE_RX_DISABLE_TX_NORM_NM
          Cond4: BswMConditionType=BSWM_EQUALS, BswMConditionMode=DCM_COM_MODE_REQUEST_CCAN
            BswMConditionValue
              BswMBswMode: BswMBswRequestedMode=DCM_DISABLE_RX_TX_NORM_NM
          Cond6: BswMConditionType=BSWM_EQUALS, BswMConditionMode=DCM_COM_MODE_REQUEST_CCAN
            BswMConditionValue
              BswMBswMode: BswMBswRequestedMode=DCM_ENABLE_RX_TX_NORM_NM
          Cond7: BswMConditionType=BSWM_EQUALS, BswMConditionMode=DCM_COM_MODE_REQUEST_CCAN
            BswMConditionValue
              BswMBswMode: BswMBswRequestedMode=DCM_ENABLE_RX_TX_NM
          Cond8: BswMConditionType=BSWM_EQUALS, BswMConditionMode=DCM_COM_MODE_REQUEST_CCAN
            BswMConditionValue
              BswMBswMode: BswMBswRequestedMode=DCM_DISABLE_RX_ENABLE_TX_NM
          Cond9: BswMConditionType=BSWM_EQUALS, BswMConditionMode=DCM_COM_MODE_REQUEST_CCAN
            BswMConditionValue
              BswMBswMode: BswMBswRequestedMode=DCM_DISABLE_RX_ENABLE_TX_NORM_NM
        19 x BswMLogicalExpression:
          LogicExpr_StdRule_ComCtrl_Disable_NORM_CCAN
          LogicExpr_StdRule_ComCtrl_Enable_NORM_CCAN
          LogicExpr_StdRule_Switch_DM_CCAN: BswMArgumentRef=Cond10
          LogicExpr_StdRule_Switch_Tx_CCAN: BswMArgumentRef=Cond5
          LogicExpr_StdRule_Switch_Rx_CCAN: BswMArgumentRef=Cond0
          LogicExpr_StdRule_ComCtrl_Disable_Nm_CCAN
          LogicExpr_StdRule_ComCtrl_Enable_Nm_CCAN
          AND_5: BswMLogicalOperator=BSWM_OR, BswMArgumentRef=Cond17, BswMArgumentRef=Cond18
          AND_4: BswMLogicalOperator=BSWM_OR, BswMArgumentRef=Cond16, BswMArgumentRef=AND_5
          AND_3: BswMLogicalOperator=BSWM_OR, BswMArgumentRef=Cond15, BswMArgumentRef=AND_4
          AND_2: BswMLogicalOperator=BSWM_OR, BswMArgumentRef=Cond13, BswMArgumentRef=Cond14
          AND_1: BswMLogicalOperator=BSWM_OR, BswMArgumentRef=Cond12, BswMArgumentRef=AND_2
          AND_0: BswMLogicalOperator=BSWM_OR, BswMArgumentRef=Cond11, BswMArgumentRef=AND_1
          OR_0: BswMLogicalOperator=BSWM_OR, BswMArgumentRef=Cond1, BswMArgumentRef=OR_1
          OR_1: BswMLogicalOperator=BSWM_OR, BswMArgumentRef=Cond2, BswMArgumentRef=OR_2
          OR_2: BswMLogicalOperator=BSWM_OR, BswMArgumentRef=Cond3, BswMArgumentRef=Cond4
          OR_3: BswMLogicalOperator=BSWM_OR, BswMArgumentRef=Cond6, BswMArgumentRef=OR_4
          OR_4: BswMLogicalOperator=BSWM_OR, BswMArgumentRef=Cond7, BswMArgumentRef=OR_5
          OR_5: BswMLogicalOperator=BSWM_OR, BswMArgumentRef=Cond8, BswMArgumentRef=Cond9
      BswMModeControl
        10 x BswMAction:
          ActionPduGrpSw_5
            BswMAvailableActions
              BswMPduGroupSwitch: BswMPduGroupSwitchType=BSWM_PDU_GROUP_STOP, BswMPduGroupSwitchReinit=false, BswMPduGroupRef=PduGrp_EPS__CCAN_Tx
          ActionPduGrpSw_4
            BswMAvailableActions
              BswMPduGroupSwitch: BswMPduGroupSwitchType=BSWM_PDU_GROUP_START, BswMPduGroupSwitchReinit=true, BswMPduGroupRef=PduGrp_EPS__CCAN_Tx
          ActionRxDm_1
            BswMAvailableActions
              BswMDeadlineMonitoringControl: BswMDMControl=BSWM_DISABLE_RX_DM, BswMDMPduGroupRef=PduGrp_EPS__CCAN_Rx
          ActionRxDm_0
            BswMAvailableActions
              BswMDeadlineMonitoringControl: BswMDMControl=BSWM_ENABLE_RX_DM, BswMDMPduGroupRef=PduGrp_EPS__CCAN_Rx
          ActionPduGrpSw_3
            BswMAvailableActions
              BswMPduGroupSwitch: BswMPduGroupSwitchType=BSWM_PDU_GROUP_STOP, BswMPduGroupSwitchReinit=false, BswMPduGroupRef=PduGrp_EPS__CCAN_Tx
          ActionPduGrpSw_2
            BswMAvailableActions
              BswMPduGroupSwitch: BswMPduGroupSwitchType=BSWM_PDU_GROUP_START, BswMPduGroupSwitchReinit=false, BswMPduGroupRef=PduGrp_EPS__CCAN_Tx
          ActionPduGrpSw_1
            BswMAvailableActions
              BswMPduGroupSwitch: BswMPduGroupSwitchType=BSWM_PDU_GROUP_STOP, BswMPduGroupSwitchReinit=false, BswMPduGroupRef=PduGrp_EPS__CCAN_Rx
          ActionPduGrpSw_0
            BswMAvailableActions
              BswMPduGroupSwitch: BswMPduGroupSwitchType=BSWM_PDU_GROUP_START, BswMPduGroupSwitchReinit=false, BswMPduGroupRef=PduGrp_EPS__CCAN_Rx
          ActionNmCtrl_0
            BswMAvailableActions
              BswMNMControl: BswMNMAction=BSWM_NM_DISABLE, BswMNMChannelRef=NmGlobalConfig/CCAN
          ActionNmCtrl_1
            BswMAvailableActions
              BswMNMControl: BswMNMAction=BSWM_NM_ENABLE, BswMNMChannelRef=NmGlobalConfig/CCAN
        7 x BswMTrueActionList, all with BswMActionListExecution=BSWM_TRIGGER:
          ActionTrueList_6
            BswMActionListItem_0 (BswMActionListItem): BswMAbortOnFail=false, BswMActionListItemRef=ActionPduGrpSw_5
          ActionTrueList_5
            BswMActionListItem_0 (BswMActionListItem): BswMAbortOnFail=false, BswMActionListItemRef=ActionPduGrpSw_4
          ActionTrueList_2
            BswMActionListItem_0 (BswMActionListItem): BswMAbortOnFail=false, BswMActionListItemRef=ActionRxDm_0
          ActionTrueList_1
            BswMActionListItem_0 (BswMActionListItem): BswMAbortOnFail=false, BswMActionListItemRef=ActionPduGrpSw_2
          ActionTrueList_0
            BswMActionListItem_0 (BswMActionListItem): BswMAbortOnFail=false, BswMActionListItemRef=ActionPduGrpSw_0
          ActionTrueList_3
            BswMActionListItem_0 (BswMActionListItem): BswMAbortOnFail=false, BswMActionListItemRef=ActionNmCtrl_0
          ActionTrueList_4
            BswMActionListItem_0 (BswMActionListItem): BswMAbortOnFail=false, BswMActionListItemRef=ActionNmCtrl_1
        3 x BswMFalseActionList, all with BswMActionListExecution=BSWM_TRIGGER:
          ActionFalseList_2
            BswMActionListItem_0 (BswMActionListItem): BswMAbortOnFail=false, BswMActionListItemRef=ActionRxDm_1
          ActionFalseList_1
            BswMActionListItem_0 (BswMActionListItem): BswMAbortOnFail=false, BswMActionListItemRef=ActionPduGrpSw_3
          ActionFalseList_0
            BswMActionListItem_0 (BswMActionListItem): BswMAbortOnFail=false, BswMActionListItemRef=ActionPduGrpSw_1
  module config DigColPs: implementation-config-variant=VARIANT-POST-BUILD
    DigColPsGeneral
    CommonPublishedInformation: ArMajorVersion=3, ArMinorVersion=2, ArPatchVersion=0, SwMajorVersion=0, SwMinorVersion=0, SwPatchVersion=0, ModuleId=0, VendorId=0
  module config CanNm: implementation-config-variant=VARIANT-PRE-COMPILE, module-description=CanNm_Impl
    VectorCommonData: BswmdVersion=1.16.02
    CanNmGlobalConfig:
      CanNmBusLoadReductionEnabled = true
      CanNmBusSynchronizationEnabled = false
      CanNmComControlEnabled = true
      CanNmDevErrorDetect = false
      CanNmImmediateTxconfEnabled = false
      CanNmImmediateRestartEnabled = true
      CanNmNodeDetectionEnabled = false
      CanNmPassiveModeEnabled = false
      CanNmPduRxIndicationEnabled = false
      CanNmRemoteSleepIndEnabled = false
      CanNmExtRemoteSleepIndication = false
      CanNmLimpHomeIndication = false
      CanNmRepeatMsgIndEnabled = false
      CanNmStateChangeIndEnabled = false
      CanNmUserDataEnabled = false
      CanNmVersionInfoApi = false
      CanNmUserConfigFile = C:\Users\mzjphh\Desktop\Fiasa_326_327_05.01.00\Fiasa_326_327_EPS_TMS570\Tools\AsrProject\CanNm.cfg
      CanNmProdErrorDetect = true
      CanNmTransmissionErrorReporting = false
      CanNmNodeIdEnabled = true
      CanNmApiOptimization = false
      CanNmNumberOfChannels = 1
      CanNmStartAddress = 0
      CanNmComUserDataEnabled = false
      CanNmExtBusSynchronization = false
      CanNmGatewayExtEnabled = false
      CanNmDiagGatewayExtEnabled = false
      CanNmCarWupRxFeatureEnabled = false
      CanNmCarWupFilterFeatureEnabled = false
      CanNmImmediateNmTxFeatureEnabled = false
      CanNmActiveWupBitFeatureEnabled = true
      CanNmPnFeatureEnabled = false
      CanNmPnEraCalcFeatureEnabled = false
      CanNmPnResetTime = 0.2
      CanNmPnEiraCalcFeatureEnabled = false
      CanNmPnEiraCalcEnabled = false
      CanNmDem2DetEnabled = true
      CanNmCanIfRangeConfigDLCCheck = true
      CanNmAmdRuntimeMeasurement = false
      CanNmConfigPtr = 0
      CanNmPnInfo: CanNmPnInfoOffset=1, CanNmPnInfoLength=1
        CanNmPnFilterMaskByte_0 (CanNmPnFilterMaskByte): CanNmPnFilterMaskByteIndex=0, CanNmPnFilterMaskByteValue=0
      CCAN (CanNmChannelConfig):
        CanNmBaseAddress = 506724352
        CanNmChannelActive = true
        CanNmMessageCount = 256
        CanNmMsgCycleOffset = 0.06
        CanNmMsgCycleTime = 1
        CanNmMsgReducedtime = 0.85
        CanNmNodeId = 2
        CanNmPduCbvPosition = CANNM_PDU_BYTE_1
        CanNmPduNidPosition = CANNM_PDU_BYTE_0
        CanNmRepeatMessageTime = 4.5
        CanNmTimeoutTime = 8
        CanNmUserDataLentgh = 0
        CanNmWaitBusSleepTime = 1
        CanNmPnEnabled = false
        CanNmCarWakeUpFilterEnabled = false
        CanNmCarWakeUpRxEnabled = false
        CanNmPnEraCalcEnabled = false
        CanNmActiveWakeupBitEnabled = true
        CanNmBusLoadReductionActive = true
        CanNmMainFunctionPeriod = 0.01
        CanNmMsgTimeoutTime = 0.06
        CanNmRemoteSleepIndTime = 0.5
        CanNmCarWakeUpBytePosition = 2
        CanNmCarWakeUpBitPosition = 0
        CanNmCarWakeUpFilterNodeId = 0
        CanNmImmediateNmTransmissions = 0
        CanNmImmediateNmCycleTime = 0.1
        CanNmAllNmMessagesKeepAwake = false
        CanNmPnHandleMultipleNwRequests = false
        CanNmPduLength = 2
        CanNmChannelIdRef = NmGlobalConfig/CCAN
        CanNmNetworkHandle = CanStateManagerConfiguration/CCAN
        NM_EPS__CCAN (CanNmTxPdu): CanNmTxPduId=2, CanNmTxPduRef=PduCollection/NM_EPS__CCAN
  module config Nm: implementation-config-variant=VARIANT-PRE-COMPILE, module-description=Nm_Impl
    VectorCommonData: BswmdVersion=1.21.00
    NmGlobalConfig:
      NmSupportComM21 = false
      NmBusSynchronizationEnabled = false
      NmComControlEnabled = true
      NmCoordinatorSupportEnabled = false
      NmCycletimeMainFunction = 0.01
      NmCoordinationShutdownTimer = 0
      NmDevErrorDetect = false
      NmNodeIdEnabled = true
      NmNumberOfChannels = 1
      NmOsekSupportEnabled = false
      NmPassiveModeEnabled = false
      NmPduRxIndicationEnabled = false
      NmRemoteSleepIndEnabled = false
      NmStateChangeIndEnabled = false
      NmUserDataEnabled = false
      NmVersionInfoApi = false
      NmNodeDetectionEnabled = false
      NmMacroLayerEnabled = false
      NmLimpHomeIndication = false
      NmUserConfigFile = C:\Users\mzjphh\Desktop\Fiasa_326_327_05.01.00\Fiasa_326_327_EPS_TMS570\Tools\AsrProject\Nm.cfg
      NmProdErrorDetect = true
      NmCoordinatorSyncSupport = false
      NmCoordinatorSyncPrio = Low
      NmOsekChannel = 255
      NmCallbacksPrototypeHeader = 
      NmStateChangeIndCallback = 
      NmRemoteSleepIndCallback = 
      NmRemoteSleepCancelCallback = 
      NmPduReceiveIndCallback = 
      NmRepeatMessageIndCallback = 
      NmTxTimeoutErrorCallback = 
      NmAutosarGatewayRounds = 0
      NmOsekGatewayRounds = 0
      NmComUserDataEnabled = false
      NmStateChangeIndOsekNmEnabled = false
      NmExtInitOsekNmEnabled = false
      NmExtInitOsekNmState = NM_CANSLEEP
      NmGatewayExtEnabled = false
      NmDiagGatewayExtEnabled = false
      NmCarWakeUpRxEnabled = false
      NmCarWakeUpCallback = 
      NmAmdRuntimeMeasurement = false
      CCAN (NmChannelConfig):
        NmBusType = NM_BUS_TYPE_CAN
        NmChannelId = 0
        NmSelectiveNmChannel = false
        NmPassiveCoordinatedNmChannel = false
        NmStateReportEnabled = false
        NmComMChannelRef = ComM/CCAN

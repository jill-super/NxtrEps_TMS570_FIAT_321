[part 3 of 4: package /ActiveEcuC]
AUTOSAR XML (schema 3.0.2)
package /ActiveEcuC  (continued)
  module config TrqCmdScl: implementation-config-variant=VARIANT-POST-BUILD
    TrqCmdSclGeneral
    CommonPublishedInformation: ArMajorVersion=3, ArMinorVersion=2, ArPatchVersion=0, SwMajorVersion=0, SwMinorVersion=0, SwPatchVersion=0, ModuleId=0, VendorId=0
  module config TuningSelAuth: implementation-config-variant=VARIANT-POST-BUILD
    TuningSelAuthGeneral
    CommonPublishedInformation: ArMajorVersion=3, ArMinorVersion=2, ArPatchVersion=0, SwMajorVersion=0, SwMinorVersion=0, SwPatchVersion=0, ModuleId=0, VendorId=0
  module config uDiag: implementation-config-variant=VARIANT-PRE-COMPILE
    RuntimeRegCheck (uDiagRegChkConfigSet)
      206 x uDiagRegCheck:
        GHVSRC: uDiagRegAddress=4294967112, uDiagRegValue=16842753
        RCLKSRC: uDiagRegAddress=4294967120, uDiagRegValue=9
        BMMCR1: uDiagRegAddress=4294967236, uDiagRegValue=10
        CLKCNTL: uDiagRegAddress=4294967248, uDiagRegValue=16843008
        LOGICPDPWRCTRL0: uDiagRegAddress=4294901760, uDiagRegValue=84216325
        MEMPDPWRCTRL0: uDiagRegAddress=4294901776, uDiagRegValue=84541440
        PDCLKDISREG: uDiagRegAddress=4294901792, uDiagRegValue=4
        GLOBALCTRL1: uDiagRegAddress=4294901920, uDiagRegValue=0
        PINMMR00: uDiagRegAddress=4294961936, uDiagRegValue=33685504
        PINMMR01: uDiagRegAddress=4294961940, uDiagRegValue=16843776
        PINMMR02: uDiagRegAddress=4294961944, uDiagRegValue=67174657
        PINMMR03: uDiagRegAddress=4294961948, uDiagRegValue=17039361
        PINMMR04: uDiagRegAddress=4294961952, uDiagRegValue=269484292
        PINMMR05: uDiagRegAddress=4294961956, uDiagRegValue=17302532
        PINMMR06: uDiagRegAddress=4294961960, uDiagRegValue=16843024
        PINMMR07: uDiagRegAddress=4294961964, uDiagRegValue=16843009
        PINMMR08: uDiagRegAddress=4294961968, uDiagRegValue=16843009
        PINMMR09: uDiagRegAddress=4294961972, uDiagRegValue=16843009
        PINMMR10: uDiagRegAddress=4294961976, uDiagRegValue=16843009
        PINMMR11: uDiagRegAddress=4294961980, uDiagRegValue=16843009
        PINMMR12: uDiagRegAddress=4294961984, uDiagRegValue=16843009
        PINMMR13: uDiagRegAddress=4294961988, uDiagRegValue=16843009
        PINMMR14: uDiagRegAddress=4294961992, uDiagRegValue=16843009
        PINMMR15: uDiagRegAddress=4294961996, uDiagRegValue=16843009
        PINMMR16: uDiagRegAddress=4294962000, uDiagRegValue=16843009
        PINMMR17: uDiagRegAddress=4294962004, uDiagRegValue=16843009
        PINMMR18: uDiagRegAddress=4294962008, uDiagRegValue=65537
        PINMMR19: uDiagRegAddress=4294962012, uDiagRegValue=16843009
        PINMMR20: uDiagRegAddress=4294962016, uDiagRegValue=16843009
        PINMMR21: uDiagRegAddress=4294962020, uDiagRegValue=16842753
        PINMMR22: uDiagRegAddress=4294962024, uDiagRegValue=16843009
        PINMMR23: uDiagRegAddress=4294962028, uDiagRegValue=1
        PINMMR24: uDiagRegAddress=4294962032, uDiagRegValue=0
        PINMMR25: uDiagRegAddress=4294962036, uDiagRegValue=0
        PINMMR26: uDiagRegAddress=4294962040, uDiagRegValue=16842752
        PINMMR27: uDiagRegAddress=4294962044, uDiagRegValue=16843009
        PINMMR28: uDiagRegAddress=4294962048, uDiagRegValue=16843009
        PINMMR29: uDiagRegAddress=4294962052, uDiagRegValue=257
        PINMMR30: uDiagRegAddress=4294962056, uDiagRegValue=514
        FRDCNTL: uDiagRegAddress=4294471680, uDiagRegValue=785
        FEDACTRL1: uDiagRegAddress=4294471688, uDiagRegValue=656906
        RAMCTRL_EVEN: uDiagRegAddress=4294965248, uDiagRegValue=327690
        RAMTHRESHOLD_EVEN: uDiagRegAddress=4294965252, uDiagRegValue=1
        RAMINTCTRL_EVEN: uDiagRegAddress=4294965260, uDiagRegValue=1
        RAMTEST_EVEN: uDiagRegAddress=4294965296, uDiagRegValue=5
        RAMCTRL_ODD: uDiagRegAddress=4294965504, uDiagRegValue=327690
        RAMTHRESHOLD_ODD: uDiagRegAddress=4294965508, uDiagRegValue=1
        RAMINTCTRL_ODD: uDiagRegAddress=4294965516, uDiagRegValue=1
        RAMTEST_ODD: uDiagRegAddress=4294965552, uDiagRegValue=5
        PACT: uDiagRegAddress=4294960512, uDiagRegValue=0
        STCGCR1: uDiagRegAddress=4294960644, uDiagRegValue=5
        CCMKEYR: uDiagRegAddress=4294964740, uDiagRegValue=0
        PLLCTL1: uDiagRegAddress=4294967152, uDiagRegValue=352000
        PLLCTL2: uDiagRegAddress=4294967156, uDiagRegValue=29184
        PLLCTL3: uDiagRegAddress=4294959360, uDiagRegValue=1610964736
        DCCGCTRL_DCC1: uDiagRegAddress=4294962176, uDiagRegValue=10
        DCCCNT0SEED_DCC1: uDiagRegAddress=4294962184, uDiagRegValue=9333
        DCCVALID0SEED_DCC1: uDiagRegAddress=4294962188, uDiagRegValue=39666
        DCCCNT1SEED_DCC1: uDiagRegAddress=4294962192, uDiagRegValue=9800
        DCCCNT1CLKSRC_DCC1: uDiagRegAddress=4294962212, uDiagRegValue=40963
        DCCCNT0CLKSRC_DCC1: uDiagRegAddress=4294962216, uDiagRegValue=0
        DCCGCTRL_DCC2: uDiagRegAddress=4294964224, uDiagRegValue=10
        DCCCNT0SEED_DCC2: uDiagRegAddress=4294964232, uDiagRegValue=19417
        DCCVALID0SEED_DCC2: uDiagRegAddress=4294964236, uDiagRegValue=1201
        DCCCNT1SEED_DCC2: uDiagRegAddress=4294964240, uDiagRegValue=80000
        DCCCNT1CLKSRC_DCC2: uDiagRegAddress=4294964260, uDiagRegValue=40968
        DCCCNT0CLKSRC_DCC2: uDiagRegAddress=4294964264, uDiagRegValue=0
        ESMEEPAPR1: uDiagRegAddress=4294964480, uDiagRegValue=0
        ESMIESR1: uDiagRegAddress=4294964488, uDiagRegValue=1411910606
        ESMILSR1: uDiagRegAddress=4294964496, uDiagRegValue=2048
        ESMLTCPR: uDiagRegAddress=4294964532, uDiagRegValue=16383
        ESMIEPSR4: uDiagRegAddress=4294964544, uDiagRegValue=0
        ESMIESR4: uDiagRegAddress=4294964552, uDiagRegValue=1073741860
        ESMILSR4: uDiagRegAddress=4294964560, uDiagRegValue=0
        RTIGCTRL: uDiagRegAddress=4294966272, uDiagRegValue=3
        RTITBCTRL: uDiagRegAddress=4294966276, uDiagRegValue=0
        RTISETINTENA: uDiagRegAddress=4294966400, uDiagRegValue=1
        RTIDWDCTRL: uDiagRegAddress=4294966416, uDiagRegValue=2844088794
        RTIDWDPRLD: uDiagRegAddress=4294966420, uDiagRegValue=57
        RTIWWDRXNCTRL: uDiagRegAddress=4294966436, uDiagRegValue=5
        RTIWWDSIZECTRL: uDiagRegAddress=4294966440, uDiagRegValue=5
        CRC_CTRL1: uDiagRegAddress=4261412872, uDiagRegValue=0
        PARCTL: uDiagRegAddress=4294966768, uDiagRegValue=10
        FIRQPR0_FIQ_IRQ: uDiagRegAddress=4294966800, uDiagRegValue=3
        FIRQPR1_FIQ_IRQ: uDiagRegAddress=4294966804, uDiagRegValue=0
        FIRQPR2_FIQ_IRQ: uDiagRegAddress=4294966808, uDiagRegValue=0
        CHANCTRL0: uDiagRegAddress=4294966912, uDiagRegValue=75779
        CHANCTRL23: uDiagRegAddress=4294967004, uDiagRegValue=50529027
        ADOPMODECR_ADC1: uDiagRegAddress=4294426628, uDiagRegValue=2148794369
        ADCLOCKCR_ADC1: uDiagRegAddress=4294426632, uDiagRegValue=4
        ADCALCR_ADC1: uDiagRegAddress=4294426636, uDiagRegValue=0
        ADEVMODECR_ADC1: uDiagRegAddress=4294426640, uDiagRegValue=65585
        ADG1MODECR_ADC1: uDiagRegAddress=4294426644, uDiagRegValue=65584
        ADG2MODECR_ADC1: uDiagRegAddress=4294426648, uDiagRegValue=65592
        ADEVSRC_ADC1: uDiagRegAddress=4294426652, uDiagRegValue=0
        ADG1SRC_ADC1: uDiagRegAddress=4294426656, uDiagRegValue=0
        ADG2SRC_ADC1: uDiagRegAddress=4294426660, uDiagRegValue=1
        ADEVINTENA_ADC1: uDiagRegAddress=4294426664, uDiagRegValue=0
        ADG1INTENA_ADC1: uDiagRegAddress=4294426668, uDiagRegValue=0
        ADG2INTENA_ADC1: uDiagRegAddress=4294426672, uDiagRegValue=0
        ADBNDCR_ADC1: uDiagRegAddress=4294426712, uDiagRegValue=1966110
        ADBNDEND_ADC1: uDiagRegAddress=4294426716, uDiagRegValue=2
        ADEVSAMP_ADC1: uDiagRegAddress=4294426720, uDiagRegValue=6
        ADG1SAMP_ADC1: uDiagRegAddress=4294426724, uDiagRegValue=6
        ADG2SAMP_ADC1: uDiagRegAddress=4294426728, uDiagRegValue=6
        ADEVSEL_ADC1: uDiagRegAddress=4294426744, uDiagRegValue=0
        ADG1SEL_ADC1: uDiagRegAddress=4294426748, uDiagRegValue=0
        ADG2SEL_ADC1: uDiagRegAddress=4294426752, uDiagRegValue=8481
        ADPARCR_ADC1: uDiagRegAddress=4294427008, uDiagRegValue=10
        ADOPMODECR_ADC2: uDiagRegAddress=4294427140, uDiagRegValue=2148794369
        ADCLOCKCR_ADC2: uDiagRegAddress=4294427144, uDiagRegValue=4
        ADCALCR_ADC2: uDiagRegAddress=4294427148, uDiagRegValue=0
        ADEVMODECR_ADC2: uDiagRegAddress=4294427152, uDiagRegValue=65584
        ADG1MODECR_ADC2: uDiagRegAddress=4294427156, uDiagRegValue=65592
        ADG2MODECR_ADC2: uDiagRegAddress=4294427160, uDiagRegValue=65584
        ADEVSRC_ADC2: uDiagRegAddress=4294427164, uDiagRegValue=0
        ADG1SRC_ADC2: uDiagRegAddress=4294427168, uDiagRegValue=3
        ADG2SRC_ADC2: uDiagRegAddress=4294427172, uDiagRegValue=0
        ADEVINTENA_ADC2: uDiagRegAddress=4294427176, uDiagRegValue=0
        ADG1INTENA_ADC2: uDiagRegAddress=4294427180, uDiagRegValue=0
        ADG2INTENA_ADC2: uDiagRegAddress=4294427184, uDiagRegValue=0
        ADBNDCR_ADC2: uDiagRegAddress=4294427224, uDiagRegValue=2
        ADBNDEND_ADC2: uDiagRegAddress=4294427228, uDiagRegValue=2
        ADEVSAMP_ADC2: uDiagRegAddress=4294427232, uDiagRegValue=6
        ADG1SAMP_ADC2: uDiagRegAddress=4294427236, uDiagRegValue=6
        ADG2SAMP_ADC2: uDiagRegAddress=4294427240, uDiagRegValue=6
        ADEVSEL_ADC2: uDiagRegAddress=4294427256, uDiagRegValue=0
        ADG1SEL_ADC2: uDiagRegAddress=4294427260, uDiagRegValue=8451
        ADG2SEL_ADC2: uDiagRegAddress=4294427264, uDiagRegValue=0
        ADPARCR_ADC2: uDiagRegAddress=4294427520, uDiagRegValue=10
        HETGCR_HET1: uDiagRegAddress=4294424576, uDiagRegValue=393217
        HETPFR_HET1: uDiagRegAddress=4294424580, uDiagRegValue=1792
        HETEXC1_HET1: uDiagRegAddress=4294424604, uDiagRegValue=0
        HETPRY_HET1: uDiagRegAddress=4294424612, uDiagRegValue=0
        HETAND_HET1: uDiagRegAddress=4294424620, uDiagRegValue=0
        HETHRSH_HET1: uDiagRegAddress=4294424628, uDiagRegValue=0
        HETXOR_HET1: uDiagRegAddress=4294424632, uDiagRegValue=0
        HETREQENS_HET1: uDiagRegAddress=4294424636, uDiagRegValue=22
        HETREQDS_HET1: uDiagRegAddress=4294424644, uDiagRegValue=16
        HETPCR_HET1: uDiagRegAddress=4294424692, uDiagRegValue=10
        HETPPR_HET1: uDiagRegAddress=4294424700, uDiagRegValue=0
        HETLBPSEL_HET1: uDiagRegAddress=4294424716, uDiagRegValue=0
        HETLBPDIR_HET1: uDiagRegAddress=4294424720, uDiagRegValue=327680
        HETPINDIS_HET1: uDiagRegAddress=4294424724, uDiagRegValue=0
        HETGCR_HET2: uDiagRegAddress=4294424832, uDiagRegValue=196609
        HETPFR_HET2: uDiagRegAddress=4294424836, uDiagRegValue=1024
        HETEXC1_HET2: uDiagRegAddress=4294424860, uDiagRegValue=0
        HETPRY_HET2: uDiagRegAddress=4294424868, uDiagRegValue=0
        HETAND_HET2: uDiagRegAddress=4294424876, uDiagRegValue=0
        HETHRSH_HET2: uDiagRegAddress=4294424884, uDiagRegValue=244
        HETXOR_HET2: uDiagRegAddress=4294424888, uDiagRegValue=0
        HETREQENS_HET2: uDiagRegAddress=4294424892, uDiagRegValue=0
        HETREQDS_HET2: uDiagRegAddress=4294424900, uDiagRegValue=0
        HETDIR_HET2: uDiagRegAddress=4294424908, uDiagRegValue=0
        HETPCR_HET2: uDiagRegAddress=4294424948, uDiagRegValue=10
        HETPPR_HET2: uDiagRegAddress=4294424956, uDiagRegValue=0
        HETLBPSEL_HET2: uDiagRegAddress=4294424972, uDiagRegValue=0
        HETLBPDIR_HET2: uDiagRegAddress=4294424976, uDiagRegValue=327680
        HETPINDIS_HET2: uDiagRegAddress=4294424980, uDiagRegValue=0
        HTU__GC_HTU1: uDiagRegAddress=4294419456, uDiagRegValue=65792
        HTU__MP1S_HTU1: uDiagRegAddress=4294419532, uDiagRegValue=0
        HTU__MP1E_HTU1: uDiagRegAddress=4294419536, uDiagRegValue=0
        HTU__GC_HTU2: uDiagRegAddress=4294419712, uDiagRegValue=0
        HTU_IHADDRCT_HTU1: uDiagRegAddress=4283301896, uDiagRegValue=0
        HTU_ITCOUNT_HTU1: uDiagRegAddress=4283301900, uDiagRegValue=0
        GIOGCR0: uDiagRegAddress=4294425600, uDiagRegValue=1
        GIOINTDET: uDiagRegAddress=4294425608, uDiagRegValue=0
        GIOPOL: uDiagRegAddress=4294425612, uDiagRegValue=0
        GIODIR_A_: uDiagRegAddress=4294425652, uDiagRegValue=0
        GIODIR_B_: uDiagRegAddress=4294425684, uDiagRegValue=0
        DMA_DMAMPCTRL: uDiagRegAddress=4294963632, uDiagRegValue=252250377
        DMA_DMAMPR0S: uDiagRegAddress=4294963640, uDiagRegValue=4278845440
        DMA_DMAMPR0E: uDiagRegAddress=4294963644, uDiagRegValue=4282859519
        DMA_DMAMPR1S: uDiagRegAddress=4294963648, uDiagRegValue=4244081664
        DMA_DMAMPR1E: uDiagRegAddress=4294963652, uDiagRegValue=4261413375
        DMA_DMAMPR3S: uDiagRegAddress=4294963664, uDiagRegValue=2097152
        DMA_DMAMPR3E: uDiagRegAddress=4294963668, uDiagRegValue=4294967295
        DMA_CP00_IDADDR: uDiagRegAddress=4294443012, uDiagRegValue=4261412968
        DMA_CP00_ITCOUNT: uDiagRegAddress=4294443016, uDiagRegValue=65537
        DMA_CP00_CHCTRL: uDiagRegAddress=4294443024, uDiagRegValue=61440
        DMA_CP01_IDADDR: uDiagRegAddress=4294443044, uDiagRegValue=4261412960
        DMA_CP01_CHCTRL: uDiagRegAddress=4294443056, uDiagRegValue=61704
        DMA_CP02_ISADDR: uDiagRegAddress=4294443072, uDiagRegValue=4278977026
        DMA_CP02_ITCOUNT: uDiagRegAddress=4294443080, uDiagRegValue=65539
        DMA_CP02_CHCTRL: uDiagRegAddress=4294443088, uDiagRegValue=20767
        DMA_CP02_EIOFF: uDiagRegAddress=4294443092, uDiagRegValue=131076
        DMA_CP03_ISADDR: uDiagRegAddress=4294443104, uDiagRegValue=4281991170
        DMA_CP03_ITCOUNT: uDiagRegAddress=4294443112, uDiagRegValue=65540
        DMA_CP03_CHCTRL: uDiagRegAddress=4294443120, uDiagRegValue=20767
        DMA_CP03_EIOFF: uDiagRegAddress=4294443124, uDiagRegValue=131076
        DMA_CP05_IDADDR: uDiagRegAddress=4294443172, uDiagRegValue=4282777832
        DMA_CP05_ITCOUNT: uDiagRegAddress=4294443176, uDiagRegValue=65537
        DMA_CP05_CHCTRL: uDiagRegAddress=4294443184, uDiagRegValue=499969
        DMA_CP06_IDADDR: uDiagRegAddress=4294443204, uDiagRegValue=4244081680
        DMA_CP06_ITCOUNT: uDiagRegAddress=4294443208, uDiagRegValue=262146
        DMA_CP06_CHCTRL: uDiagRegAddress=4294443216, uDiagRegValue=20767
        DMA_CP06_EIOFF: uDiagRegAddress=4294443220, uDiagRegValue=393218
        DMA_CP06_FIOFF: uDiagRegAddress=4294443224, uDiagRegValue=16777220
        DMA_CP09_ISADDR: uDiagRegAddress=4294443296, uDiagRegValue=4282253554
        DMA_CP09_ITCOUNT: uDiagRegAddress=4294443304, uDiagRegValue=65540
        DMA_CP09_CHCTRL: uDiagRegAddress=4294443312, uDiagRegValue=20767
        DMA_CP09_EIOFF: uDiagRegAddress=4294443316, uDiagRegValue=131076
        DMA_CP12_ISADDR: uDiagRegAddress=4294443392, uDiagRegValue=4278845954
        DMA_CP12_ITCOUNT: uDiagRegAddress=4294443400, uDiagRegValue=65539
        DMA_CP12_CHCTRL: uDiagRegAddress=4294443408, uDiagRegValue=20767
        DMA_CP12_EIOFF: uDiagRegAddress=4294443412, uDiagRegValue=131076
      13 x uDiagRegCheckLnk:
        FBPARERR: uDiagRegAddress=4294966776, uDiagRegValueLnk=VIM_Fallback, uDiagRegUseSizeofInOffset=false, uDiagRegValueLnkOffset=0
        DMA_CP02_IDADDR: uDiagRegAddress=4294443076, uDiagRegValueLnk=DMAData_G_str.FastSPI_Cnt_u16[0], uDiagRegUseSizeofInOffset=false, uDiagRegValueLnkOffset=0
        DMA_CP03_IDADDR: uDiagRegAddress=4294443108, uDiagRegValueLnk=DMAData_G_str.FastADC_Cnt_u16[0], uDiagRegUseSizeofInOffset=false, uDiagRegValueLnkOffset=0
        DMA_CP05_ISADDR: uDiagRegAddress=4294443168, uDiagRegValueLnk=DMAData_G_str.PWMPeriod_Cnt_u32, uDiagRegUseSizeofInOffset=false, uDiagRegValueLnkOffset=0
        DMA_CP06_ISADDR: uDiagRegAddress=4294443200, uDiagRegValueLnk=DMAData_G_str.PWMCmp_Cnt_u16[0][0], uDiagRegUseSizeofInOffset=false, uDiagRegValueLnkOffset=0
        DMA_CP09_IDADDR: uDiagRegAddress=4294443300, uDiagRegValueLnk=DMAData_G_str.SlowADC_Cnt_u16[0], uDiagRegUseSizeofInOffset=false, uDiagRegValueLnkOffset=0
        DMA_CP12_IDADDR: uDiagRegAddress=4294443396, uDiagRegValueLnk=DMAData_G_str.SlowSPI_Cnt_u16[0], uDiagRegUseSizeofInOffset=false, uDiagRegValueLnkOffset=0
        DMA_DMAMPR2S: uDiagRegAddress=4294963656, uDiagRegValueLnk=DMAData_G_str, uDiagRegUseSizeofInOffset=false, uDiagRegValueLnkOffset=0
        DMA_DMAMPR2E: uDiagRegAddress=4294963660, uDiagRegValueLnk=DMAData_G_str, uDiagRegUseSizeofInOffset=true, uDiagRegValueLnkOffset=-1
        HTU__MP0S_HTU1: uDiagRegAddress=4294419572, uDiagRegValueLnk=Nhet_HtuDataTrq_Cnt_G_str, uDiagRegUseSizeofInOffset=false, uDiagRegValueLnkOffset=0
        HTU__MP0E_HTU1: uDiagRegAddress=4294419576, uDiagRegValueLnk=Nhet_HtuDataTrq_Cnt_G_str, uDiagRegUseSizeofInOffset=false, uDiagRegValueLnkOffset=60
        HTU_IFADDRA_HTU1: uDiagRegAddress=4283301904, uDiagRegValueLnk=Nhet_HtuDataTrq_Cnt_G_str.HtuDataTrq1_Cnt_u32[0], uDiagRegUseSizeofInOffset=false, uDiagRegValueLnkOffset=0
        HTU_IFADDRB_HTU1: uDiagRegAddress=4283301920, uDiagRegValueLnk=Nhet_HtuDataTrq_Cnt_G_str.HtuDataTrq2_Cnt_u32[0], uDiagRegUseSizeofInOffset=false, uDiagRegValueLnkOffset=0
    CommonPublishedInformation: ArMajorVersion=1, ArMinorVersion=2, ArPatchVersion=0, SwMajorVersion=1, SwMinorVersion=0, SwPatchVersion=0, ModuleId=104, VendorId=0
    uDiagGeneral:
      uDiagVCLK_kHz = 80000
      uDiagEnableFPUDiag = STD_OFF
      uDiagGladiatorCompatible = STD_OFF
      uDiagVIMPerTrusted = STD_OFF
      uDiagECCPerTrusted = STD_OFF
      uDiagVimTableName = osaIRQTable
      WdgMVersion = TTTech_v2.0.3
      uDiagIncludes = Nhet.h
      uDiagIncludes = Usr_RegCkDefs.h
      uDiagIncludes = Dma.h
  module config VehDyn: implementation-config-variant=VARIANT-POST-BUILD
    VehDynGeneral
    CommonPublishedInformation: ArMajorVersion=3, ArMinorVersion=2, ArPatchVersion=0, SwMajorVersion=0, SwMinorVersion=0, SwPatchVersion=0, ModuleId=0, VendorId=0
  module config VehPwrMd: implementation-config-variant=VARIANT-POST-BUILD
    VehPwrMdGeneral
    CommonPublishedInformation: ArMajorVersion=3, ArMinorVersion=2, ArPatchVersion=0, SwMajorVersion=0, SwMinorVersion=0, SwPatchVersion=0, ModuleId=0, VendorId=0
  module config VehSpdLmt: implementation-config-variant=VARIANT-POST-BUILD
    VehSpdLmtGeneral
    CommonPublishedInformation: ArMajorVersion=3, ArMinorVersion=2, ArPatchVersion=0, SwMajorVersion=0, SwMinorVersion=0, SwPatchVersion=0, ModuleId=0, VendorId=0
  module config Wdg: implementation-config-variant=VARIANT-PRE-COMPILE, module-description=Wdg_Impl
    WdgGeneral:
      WdgDevErrorDetect = false
      WdgDemReport = false
      WdgDisableAllowed = false
      WdgVersionInfoApi = false
      WdgInternalTickCounter = true
      WdgUseOsSuspendInterrupt = true
      WdgInitialTimeout = 0.006
      WdgGlobalMemoryAppTaskRef = Ap_0
    WdgModeConfig (WdgSettingsConfig): WdgDefaultMode=WDGIF_SLOW_MODE
      WdgWindowStart: Value=0
      WdgRtiKhz: Value=80000
  module config WdgIf: implementation-config-variant=VARIANT-PRE-COMPILE, module-description=WdgIf_Impl
    Wdg_internal_TMS570LS3x (WdgIfDevice): WdgIfDeviceIndex=0, WdgIfDriverRef=WdgGeneral
    WdgIfGeneral: WdgIfDevErrorDetect=false, WdgIfDemReport=false, WdgIfVersionInfoApi=false, WdgIfInternalTickCounterRef=Wdg
  module config WdgM: implementation-config-variant=VARIANT-PRE-COMPILE, module-description=WdgM_Impl
    WdgM_Runtime (WdgMConfigSet): WdgMInitialMode=WdgMMode
      WdgMMode: WdgMExpiredSupervisionCycleTol=0, WdgMModeId=0, WdgMTicksPerSecond=1000000, WdgMSupervisionCycle=0.004, WdgMInitialTriggerModeId=0
        8 x WdgMAliveSupervision, all with WdgMMaxMargin=0, WdgMMinMargin=0:
          SE_100ms_Alive0: WdgMExpectedAliveIndications=1, WdgMSupervisionReferenceCycle=25, WdgMAliveSupervisionCheckpointRef=ChkPtAp10_100msStart_CP
          SE_100ms_Alive1: WdgMExpectedAliveIndications=1, WdgMSupervisionReferenceCycle=25, WdgMAliveSupervisionCheckpointRef=ChkPtAp9_100msEnd_CP
          SE_10ms_Alive0: WdgMExpectedAliveIndications=2, WdgMSupervisionReferenceCycle=5, WdgMAliveSupervisionCheckpointRef=ChkPtAp10_10msStart_CP
          SE_10ms_Alive1: WdgMExpectedAliveIndications=2, WdgMSupervisionReferenceCycle=5, WdgMAliveSupervisionCheckpointRef=ChkPtAp9_10msEnd_CP
          SE_4ms_Alive0: WdgMExpectedAliveIndications=1, WdgMSupervisionReferenceCycle=1, WdgMAliveSupervisionCheckpointRef=ChkPtAp10_4msStart_CP
          SE_2ms_Alive0: WdgMExpectedAliveIndications=2, WdgMSupervisionReferenceCycle=1, WdgMAliveSupervisionCheckpointRef=ChkPtAp10_2msStart_CP
          SE_2ms_Alive1: WdgMExpectedAliveIndications=2, WdgMSupervisionReferenceCycle=1, WdgMAliveSupervisionCheckpointRef=ChkPtAp9_2msEnd_CP
          SE_4ms_Alive1: WdgMExpectedAliveIndications=1, WdgMSupervisionReferenceCycle=1, WdgMAliveSupervisionCheckpointRef=ChkPtAp9_4msEnd_CP
        WdgMProgramFlowSupervision: WdgMGlobalCheckpointFinalRef=GlbFinal_CP0, WdgMGlobalCheckpointInitialRef=ChkPtAp10_2msStart_CP
          6 x WdgMGlobalTransition:
            GT_100ms_10_8: WdgMGlobalTransitionDestRef=ChkPtAp8_100msStart_CP, WdgMGlobalTransitionSourceRef=ChkPtAp10_100msEnd_CP
            GT_10ms_10_9: WdgMGlobalTransitionDestRef=ChkPtAp9_10msStart_CP, WdgMGlobalTransitionSourceRef=ChkPtAp10_10msEnd_CP
            GT_2ms_10_8: WdgMGlobalTransitionDestRef=ChkPtAp8_2msStart_CP, WdgMGlobalTransitionSourceRef=ChkPtAp10_2msEnd_CP
            GT_2ms_8_9: WdgMGlobalTransitionDestRef=ChkPtAp9_2msStart_CP, WdgMGlobalTransitionSourceRef=ChkPtAp8_2msEnd_CP
            GT_100ms_8_9: WdgMGlobalTransitionDestRef=ChkPtAp9_100msStart_CP, WdgMGlobalTransitionSourceRef=ChkPtAp8_100msEnd_CP
            GT_4ms_10_9: WdgMGlobalTransitionDestRef=ChkPtAp9_4msStart_CP, WdgMGlobalTransitionSourceRef=ChkPtAp10_4msEnd_CP
        WdgMTrigger: WdgMWatchdogMode=WDGIF_SLOW_MODE, WdgMTriggerConditionValue=6, WdgMTriggerWindowStart=2, WdgMTriggerModeId=0, WdgMTriggerWatchdogRef=WdgMWatchdog
        10 x WdgMLocalStatusParams, all with WdgMFailedSupervisionRefCycleTol=0, WdgMSupervisedEntityInitialMode=WDGM_LOCAL_STATUS_OK, WdgMFailedDeadlineRefCycleTol=0, WdgMDeadlineReferenceCycle=0, WdgMFailedProgramFlowRefCycleTol=0, WdgMProgramFlowReferenceCycle=0:
          SE_100ms_10_Status: WdgMLocalStatusSupervisedEntityRef=SE_100ms_10
          SE_100ms_9_Status: WdgMLocalStatusSupervisedEntityRef=SE_100ms_9
          SE_10ms_10_Status: WdgMLocalStatusSupervisedEntityRef=SE_10ms_10
          SE_10ms_9_Status: WdgMLocalStatusSupervisedEntityRef=SE_10ms_9
          SE_4ms_10_Status: WdgMLocalStatusSupervisedEntityRef=SE_4ms_10
          SE_2ms_10_Status: WdgMLocalStatusSupervisedEntityRef=SE_2ms_10
          SE_2ms_8_Status: WdgMLocalStatusSupervisedEntityRef=SE_2ms_8
          SE_2ms_9_Status: WdgMLocalStatusSupervisedEntityRef=SE_2ms_9
          SE_100ms_8_Status: WdgMLocalStatusSupervisedEntityRef=SE_100ms_8
          SE_4ms_9_Status: WdgMLocalStatusSupervisedEntityRef=SE_4ms_9
    WdgMGeneral:
      WdgMDevErrorDetect = false
      WdgMDemReport = false
      WdgMImmediateReset = true
      WdgMOffModeEnabled = false
      WdgMVersionInfoApi = false
      WdgMDefensiveBehavior = true
      WdgMUseRte = true
      WdgMDemSupervisionReport = false
      WdgMFirstCycleAliveCounterReset = true
      WdgMUseOsSuspendInterrupt = true
      WdgMTimebaseSource = WDGM_INTERNAL_HARDWARE_TICK
      WdgMSecondResetPath = false
      WdgMTickOverrunCorrection = true
      WdgMEntityDeactivationEnabled = false
      WdgMStateChangeNotification = false
      WdgMGlobalMemoryAppTaskRef = Ap_0
      10 x WdgMSupervisedEntity, all with WdgMEnableEntityDeactivation=false, WdgMSupportedAutosarAPI=API_4_0:
        SE_100ms_10: WdgMSupervisedEntityId=0, WdgMLocalCheckpointFinalRef=ChkPtAp10_100msEnd_CP, WdgMLocalCheckpointInitialRef=ChkPtAp10_100msStart_CP, WdgMAppTaskRef=Ap_10
          ChkPtAp10_100msStart_CP (WdgMCheckpoint): WdgMCheckpointId=0
          ChkPtAp10_100msEnd_CP (WdgMCheckpoint): WdgMCheckpointId=1
          LT_100ms_10 (WdgMLocalTransition): WdgMLocalTransitionDestRef=ChkPtAp10_100msEnd_CP, WdgMLocalTransitionSourceRef=ChkPtAp10_100msStart_CP
        SE_100ms_8: WdgMSupervisedEntityId=1, WdgMLocalCheckpointFinalRef=ChkPtAp8_100msEnd_CP, WdgMLocalCheckpointInitialRef=ChkPtAp8_100msStart_CP, WdgMAppTaskRef=Ap_8
          ChkPtAp8_100msStart_CP (WdgMCheckpoint): WdgMCheckpointId=0
          ChkPtAp8_100msEnd_CP (WdgMCheckpoint): WdgMCheckpointId=1
          LT_100ms_8 (WdgMLocalTransition): WdgMLocalTransitionDestRef=ChkPtAp8_100msEnd_CP, WdgMLocalTransitionSourceRef=ChkPtAp8_100msStart_CP
        SE_100ms_9: WdgMSupervisedEntityId=2, WdgMLocalCheckpointFinalRef=ChkPtAp9_100msEnd_CP, WdgMLocalCheckpointInitialRef=ChkPtAp9_100msStart_CP, WdgMAppTaskRef=Ap_9
          ChkPtAp9_100msStart_CP (WdgMCheckpoint): WdgMCheckpointId=0
          ChkPtAp9_100msEnd_CP (WdgMCheckpoint): WdgMCheckpointId=1
          LT_100ms_9 (WdgMLocalTransition): WdgMLocalTransitionDestRef=ChkPtAp9_100msEnd_CP, WdgMLocalTransitionSourceRef=ChkPtAp9_100msStart_CP
        SE_10ms_10: WdgMSupervisedEntityId=3, WdgMLocalCheckpointFinalRef=ChkPtAp10_10msEnd_CP, WdgMLocalCheckpointInitialRef=ChkPtAp10_10msStart_CP, WdgMAppTaskRef=Ap_10
          ChkPtAp10_10msStart_CP (WdgMCheckpoint): WdgMCheckpointId=0
          ChkPtAp10_10msEnd_CP (WdgMCheckpoint): WdgMCheckpointId=1
          LT_10ms_10 (WdgMLocalTransition): WdgMLocalTransitionDestRef=ChkPtAp10_10msEnd_CP, WdgMLocalTransitionSourceRef=ChkPtAp10_10msStart_CP
        SE_10ms_9: WdgMSupervisedEntityId=4, WdgMLocalCheckpointFinalRef=ChkPtAp9_10msEnd_CP, WdgMLocalCheckpointInitialRef=ChkPtAp9_10msStart_CP, WdgMAppTaskRef=Ap_9
          ChkPtAp9_10msStart_CP (WdgMCheckpoint): WdgMCheckpointId=0
          ChkPtAp9_10msEnd_CP (WdgMCheckpoint): WdgMCheckpointId=1
          LT_10ms_9 (WdgMLocalTransition): WdgMLocalTransitionDestRef=ChkPtAp9_10msEnd_CP, WdgMLocalTransitionSourceRef=ChkPtAp9_10msStart_CP
        SE_4ms_10: WdgMSupervisedEntityId=5, WdgMLocalCheckpointFinalRef=ChkPtAp10_4msEnd_CP, WdgMLocalCheckpointInitialRef=ChkPtAp10_4msStart_CP, WdgMAppTaskRef=Ap_10
          ChkPtAp10_4msStart_CP (WdgMCheckpoint): WdgMCheckpointId=0
          ChkPtAp10_4msEnd_CP (WdgMCheckpoint): WdgMCheckpointId=1
          LT_4ms_10 (WdgMLocalTransition): WdgMLocalTransitionDestRef=ChkPtAp10_4msEnd_CP, WdgMLocalTransitionSourceRef=ChkPtAp10_4msStart_CP
        SE_4ms_9: WdgMSupervisedEntityId=6, WdgMLocalCheckpointFinalRef=ChkPtAp9_4msEnd_CP, WdgMLocalCheckpointInitialRef=ChkPtAp9_4msStart_CP, WdgMAppTaskRef=Ap_9
          ChkPtAp9_4msStart_CP (WdgMCheckpoint): WdgMCheckpointId=0
          ChkPtAp9_4msEnd_CP (WdgMCheckpoint): WdgMCheckpointId=1
          LT_4ms_9 (WdgMLocalTransition): WdgMLocalTransitionDestRef=ChkPtAp9_4msEnd_CP, WdgMLocalTransitionSourceRef=ChkPtAp9_4msStart_CP
        SE_2ms_10: WdgMSupervisedEntityId=7, WdgMLocalCheckpointFinalRef=ChkPtAp10_2msEnd_CP, WdgMLocalCheckpointInitialRef=ChkPtAp10_2msStart_CP, WdgMAppTaskRef=Ap_10
          3 x WdgMCheckpoint:
            ChkPtAp10_2msStart_CP: WdgMCheckpointId=0
            ChkPtAp10_2msEnd_CP: WdgMCheckpointId=1
            GlbFinal_CP0: WdgMCheckpointId=2
          LT_2ms_10 (WdgMLocalTransition): WdgMLocalTransitionDestRef=ChkPtAp10_2msEnd_CP, WdgMLocalTransitionSourceRef=ChkPtAp10_2msStart_CP
        SE_2ms_8: WdgMSupervisedEntityId=8, WdgMLocalCheckpointFinalRef=ChkPtAp8_2msEnd_CP, WdgMLocalCheckpointInitialRef=ChkPtAp8_2msStart_CP, WdgMAppTaskRef=Ap_8
          ChkPtAp8_2msStart_CP (WdgMCheckpoint): WdgMCheckpointId=0
          ChkPtAp8_2msEnd_CP (WdgMCheckpoint): WdgMCheckpointId=1
          LT_2ms_8 (WdgMLocalTransition): WdgMLocalTransitionDestRef=ChkPtAp8_2msEnd_CP, WdgMLocalTransitionSourceRef=ChkPtAp8_2msStart_CP
        SE_2ms_9: WdgMSupervisedEntityId=9, WdgMLocalCheckpointFinalRef=ChkPtAp9_2msEnd_CP, WdgMLocalCheckpointInitialRef=ChkPtAp9_2msStart_CP, WdgMAppTaskRef=Ap_9
          ChkPtAp9_2msStart_CP (WdgMCheckpoint): WdgMCheckpointId=0
          ChkPtAp9_2msEnd_CP (WdgMCheckpoint): WdgMCheckpointId=1
          LT_2ms_9 (WdgMLocalTransition): WdgMLocalTransitionDestRef=ChkPtAp9_2msEnd_CP, WdgMLocalTransitionSourceRef=ChkPtAp9_2msStart_CP
      WdgMWatchdog: WdgMWatchdogName=Watchdog, WdgIfDeviceRef=Wdg_internal_TMS570LS3x
      WdgMCallerIds: WdgMCallerId=0
  module config Os: implementation-config-variant=VARIANT-PRE-COMPILE, module-description=Os_Impl
    14 x OsAlarm, all with OsAlarmAccessingApplication=Ap_0, OsAlarmAccessingApplication=Ap_9, OsAlarmCounterRef=SystemTimer:
      Rte_Al_TE_Task_100ms_10_0_100ms
        OsAlarmAction
          OsAlarmActivateTask: OsAlarmActivateTaskRef=Task_100ms_10
      Rte_Al_TE_Task_100ms_9_0_100ms
        OsAlarmAction
          OsAlarmActivateTask: OsAlarmActivateTaskRef=Task_100ms_9
      Rte_Al_TE_Task_10ms_10_0_10ms
        OsAlarmAction
          OsAlarmActivateTask: OsAlarmActivateTaskRef=Task_10ms_10
      Rte_Al_TE_Task_10ms_9_0_10ms
        OsAlarmAction
          OsAlarmActivateTask: OsAlarmActivateTaskRef=Task_10ms_9
      Rte_Al_TE_Task_2ms_10_0_2ms
        OsAlarmAction
          OsAlarmActivateTask: OsAlarmActivateTaskRef=Task_2ms_10
      Rte_Al_TE_Task_2ms_8_0_2ms
        OsAlarmAction
          OsAlarmActivateTask: OsAlarmActivateTaskRef=Task_2ms_8
      Rte_Al_TE_Task_2ms_9_0_2ms
        OsAlarmAction
          OsAlarmActivateTask: OsAlarmActivateTaskRef=Task_2ms_9
      Rte_Al_TE_Task_4ms_10_0_4ms
        OsAlarmAction
          OsAlarmActivateTask: OsAlarmActivateTaskRef=Task_4ms_10
      Al_Task_SchM_100ms_0
        OsAlarmAction
          OsAlarmActivateTask: OsAlarmActivateTaskRef=Task_SchM_100ms_0
        OsAlarmAutostart:
          OsAlarmAlarmTime = 1
          OsAlarmAutostartType = RELATIVE
          OsAlarmCycleTime = 100
          OsAlarmStaticAlarm = false
          OsAlarmAlarmUnit = MSEC
          OsAlarmAppModeRef = OSDEFAULTAPPMODE
      Al_Task_SchM_100ms_9
        OsAlarmAction
          OsAlarmActivateTask: OsAlarmActivateTaskRef=Task_SchM_100ms_9
        OsAlarmAutostart:
          OsAlarmAlarmTime = 1
          OsAlarmAutostartType = RELATIVE
          OsAlarmCycleTime = 100
          OsAlarmStaticAlarm = false
          OsAlarmAlarmUnit = MSEC
          OsAlarmAppModeRef = OSDEFAULTAPPMODE
      Al_Task_SchM_10ms_9
        OsAlarmAction
          OsAlarmActivateTask: OsAlarmActivateTaskRef=Task_SchM_10ms_9
        OsAlarmAutostart:
          OsAlarmAlarmTime = 1
          OsAlarmAutostartType = RELATIVE
          OsAlarmCycleTime = 2
          OsAlarmStaticAlarm = false
          OsAlarmAlarmUnit = MSEC
          OsAlarmAppModeRef = OSDEFAULTAPPMODE
      Al_Task_SchM_4ms_0
        OsAlarmAction
          OsAlarmActivateTask: OsAlarmActivateTaskRef=Task_SchM_4ms_0
        OsAlarmAutostart:
          OsAlarmAlarmTime = 1
          OsAlarmAutostartType = RELATIVE
          OsAlarmCycleTime = 4
          OsAlarmStaticAlarm = false
          OsAlarmAlarmUnit = MSEC
          OsAlarmAppModeRef = OSDEFAULTAPPMODE
      Rte_Al_TE_Task_100ms_8_0_100ms
        OsAlarmAction
          OsAlarmActivateTask: OsAlarmActivateTaskRef=Task_100ms_8
      Rte_Al_TE_Task_4ms_9_0_4ms
        OsAlarmAction
          OsAlarmActivateTask: OsAlarmActivateTaskRef=Task_4ms_9
    OSDEFAULTAPPMODE (OsAppMode): OsAppModeId=(unset)
    4 x OsApplication, all with OsApplicationMPUArea4Size=0, OsApplicationMPUArea4Access=0, OsApplicationMPUArea6Size=0, OsApplicationMPUArea6Access=0, OsApplicationMPUArea9Size=0, OsApplicationMPUArea9Access=0, OsApplicationMPUArea10Size=0, OsApplicationMPUArea10Access=0, OsApplicationMPUArea11Size=0, OsApplicationMPUArea11Access=0, OsApplicationMPUArea4Start=0, OsApplicationMPUArea6Start=0, OsApplicationMPUArea9Start=0, OsApplicationMPUArea10Start=0, OsApplicationMPUArea11Start=0:
      Ap_0: OsTrusted=true, OsAppGenerateStub=false, OsApplicationProtectionRegionSize=0, OsApplicationMPUArea8Size=0, OsApplicationMPUArea8Access=0, OsApplicationMPUArea8Start=0, OsAppAlarmRef=Al_Task_SchM_100ms_0, OsAppAlarmRef=Al_Task_SchM_4ms_0, OsAppIsrRef=Isr_MtrCtrl, OsAppIsrRef=Isr_ESMH, OsAppIsrRef=Isr_ESML, OsAppIsrRef=FlsTst_CrcIrq, OsAppTaskRef=Task_Bkgnd, OsAppTaskRef=Task_SchM_4ms_0, OsAppTaskRef=Task_SchM_100ms_0
        OsApplicationHooks: OsAppErrorHook=false, OsAppShutdownHook=false, OsAppStartupHook=false
        23 x OsApplicationTrustedFunction:
          OsApplicationTrustedFunction14: OsTrustedFunctionName=TWrapS_XcpWriteAp0, OsApplicationParams=void, OsApplicationReturnType=void
          OsApplicationTrustedFunction15: OsTrustedFunctionName=TWrapS_CallFblStart, OsApplicationParams=void, OsApplicationReturnType=void
          OsApplicationTrustedFunction16: OsTrustedFunctionName=TWrapS_Adc_Init, OsApplicationParams=void, OsApplicationReturnType=void
          OsApplicationTrustedFunction17: OsTrustedFunctionName=TWrapS_Adc2_Init1, OsApplicationParams=void, OsApplicationReturnType=void
          OsApplicationTrustedFunction18: OsTrustedFunctionName=TWrapS_PwmCdd_Init, OsApplicationParams=void, OsApplicationReturnType=void
          OsApplicationTrustedFunction19: OsTrustedFunctionName=TWrapS_StaMd_Init0, OsApplicationParams=void, OsApplicationReturnType=void
          OsApplicationTrustedFunction20: OsTrustedFunctionName=TWrapS_Wdg_TMS570LS3x_Init, OsApplicationParams=void, OsApplicationReturnType=void
          OsApplicationTrustedFunction21: OsTrustedFunctionName=TWrapS_WdgM_Init, OsApplicationParams=void, OsApplicationReturnType=void
          OsApplicationTrustedFunction22: OsTrustedFunctionName=TWrapS_NvMProxy_Init, OsApplicationParams=void, OsApplicationReturnType=void
          OsApplicationTrustedFunction23: OsTrustedFunctionName=TWrapS_FeeIf_Init, OsApplicationParams=void, OsApplicationReturnType=void
          OsApplicationTrustedFunction24: OsTrustedFunctionName=TWrapS_Fee_MainFunction, OsApplicationParams=void, OsApplicationReturnType=void
          OsApplicationTrustedFunction25: OsTrustedFunctionName=TWrapS_Fee_Read, OsApplicationParams=uint16 BlockNumber,uint16 BlockOffset,uint8* DataBufferPtr,uint16 Length, OsApplicationReturnType=Std_ReturnType
          OsApplicationTrustedFunction26: OsTrustedFunctionName=TWrapS_Fee_Write, OsApplicationParams=uint16 BlockNumber,uint8* DataBufferPtr, OsApplicationReturnType=Std_ReturnType
          OsApplicationTrustedFunction27: OsTrustedFunctionName=TWrapS_Fee_EraseImmediateBlock, OsApplicationParams=uint16 BlockNumber, OsApplicationReturnType=Std_ReturnType
          OsApplicationTrustedFunction28: OsTrustedFunctionName=TWrapS_Fee_InvalidateBlock, OsApplicationParams=uint16 BlockNumber, OsApplicationReturnType=Std_ReturnType
          OsApplicationTrustedFunction29: OsTrustedFunctionName=TWrapS_Fee_Cancel, OsApplicationParams=void, OsApplicationReturnType=void
          OsApplicationTrustedFunction30: OsTrustedFunctionName=TWrapS_Fee_GetStatus, OsApplicationParams=void, OsApplicationReturnType=uint8
          OsApplicationTrustedFunction31: OsTrustedFunctionName=TWrapS_Fee_GetJobResult, OsApplicationParams=void, OsApplicationReturnType=uint8
          OsApplicationTrustedFunction33: OsTrustedFunctionName=TWrapS_uDiagVIM_RednRpdShtdn, OsApplicationParams=void, OsApplicationReturnType=void
          OsApplicationTrustedFunction34: OsTrustedFunctionName=TWrapS_uDiagECC_RednRpdShtdn, OsApplicationParams=void, OsApplicationReturnType=void
          OsApplicationTrustedFunction: OsTrustedFunctionName=TWrapS_Dma_InvalidateSlowADCGroup, OsApplicationParams=void, OsApplicationReturnType=void
          OsApplicationTrustedFunction1: OsTrustedFunctionName=TWrapS_ProcessF0FF, OsApplicationParams=void, OsApplicationReturnType=void
          OsApplicationTrustedFunction2: OsTrustedFunctionName=TWrapS_TI_Fee_SuspendResumeErase, OsApplicationParams=uint8 Command, OsApplicationReturnType=void
      Ap_8: OsTrusted=false, OsAppGenerateStub=false, OsApplicationProtectionRegionSize=1024, OsApplicationMPUArea8Size=268435456, OsApplicationMPUArea8Access=4864, OsApplicationNonTrusted_Function=NtWrapS_XcpWriteAp8, OsApplicationMPUArea8Start=4026531840, OsAppAlarmRef=Rte_Al_TE_Task_2ms_8_0_2ms, OsAppAlarmRef=Rte_Al_TE_Task_100ms_8_0_100ms, OsAppTaskRef=Task_2ms_8, OsAppTaskRef=Task_Init_8, OsAppTaskRef=Task_Trns_8, OsAppTaskRef=Task_100ms_8
        OsApplicationHooks: OsAppErrorHook=false, OsAppShutdownHook=false, OsAppStartupHook=false
      Ap_9: OsTrusted=false, OsAppGenerateStub=true, OsApplicationProtectionRegionSize=16384, OsApplicationMPUArea8Size=268435456, OsApplicationMPUArea8Access=4864, OsApplicationNonTrusted_Function=NtWrapS_XcpWriteAp9, OsApplicationMPUArea8Start=4026531840, OsAppAlarmRef=Rte_Al_TE_Task_100ms_9_0_100ms, OsAppAlarmRef=Rte_Al_TE_Task_10ms_9_0_10ms, OsAppAlarmRef=Rte_Al_TE_Task_2ms_9_0_2ms, OsAppAlarmRef=Rte_Al_TE_Task_4ms_9_0_4ms, OsAppAlarmRef=Al_Task_SchM_100ms_9, OsAppAlarmRef=Al_Task_SchM_10ms_9, OsAppCounterRef=SystemTimer, OsAppIsrRef=CanIsr_0, OsAppIsrRef=Gpt_IsrInt0, OsAppResourceRef=RES_SCHEDULER, OsAppTaskRef=Task_100ms_9, OsAppTaskRef=Task_10ms_9, OsAppTaskRef=Task_2ms_9, OsAppTaskRef=Task_4ms_9, OsAppTaskRef=Task_Init_9, OsAppTaskRef=Task_SchM_100ms_9, OsAppTaskRef=Task_SchM_10ms_9, OsAppTaskRef=Task_SchM_Init_9, OsAppTaskRef=Task_Trns_9, OsAppTaskRef=Task_SchM_Trns_9
        OsApplicationHooks: OsAppErrorHook=false, OsAppShutdownHook=false, OsAppStartupHook=false
        78 x OsApplicationTrustedFunction, all with OsApplicationReturnType=Std_ReturnType:
          Rte_TrustedCall_Ap_ActivePull_SystemTime_DtrmnElapsedTime_mS_u32: OsTrustedFunctionName=Rte_TrustedCall_Ap_ActivePull_SystemTime_DtrmnElapsedTime_mS_u32, OsApplicationParams=UInt32 InitialTime, UInt32 *ElapsedTime
          Rte_TrustedCall_Ap_ActivePull_SystemTime_GetSystemTime_mS_u32: OsTrustedFunctionName=Rte_TrustedCall_Ap_ActivePull_SystemTime_GetSystemTime_mS_u32, OsApplicationParams=UInt32 *CurrentTime
          Rte_TrustedCall_Ap_AvgFricLrn_FltInjection_SCom_FltInjection: OsTrustedFunctionName=Rte_TrustedCall_Ap_AvgFricLrn_FltInjection_SCom_FltInjection, OsApplicationParams=Float *SignalPath_Uls_f32, FltInjectionLocType LocationKey_Cnt_enum
          Rte_TrustedCall_Ap_AvgFricLrn_SystemTime_DtrmnElapsedTime_mS_u32: OsTrustedFunctionName=Rte_TrustedCall_Ap_AvgFricLrn_SystemTime_DtrmnElapsedTime_mS_u32, OsApplicationParams=UInt32 InitialTime, UInt32 *ElapsedTime
          Rte_TrustedCall_Ap_AvgFricLrn_SystemTime_GetSystemTime_mS_u32: OsTrustedFunctionName=Rte_TrustedCall_Ap_AvgFricLrn_SystemTime_GetSystemTime_mS_u32, OsApplicationParams=UInt32 *CurrentTime
          Rte_TrustedCall_Ap_BVDiag_SystemTime_DtrmnElapsedTime_mS_u16: OsTrustedFunctionName=Rte_TrustedCall_Ap_BVDiag_SystemTime_DtrmnElapsedTime_mS_u16, OsApplicationParams=UInt32 InitialTime, UInt16 *ElapsedTime
          Rte_TrustedCall_Ap_BVDiag_SystemTime_GetSystemTime_mS_u32: OsTrustedFunctionName=Rte_TrustedCall_Ap_BVDiag_SystemTime_GetSystemTime_mS_u32, OsApplicationParams=UInt32 *CurrentTime
          Rte_TrustedCall_Ap_ChkPtAp8_ChkPtAp8_100msEnd_CP_CheckpointReached: OsTrustedFunctionName=Rte_TrustedCall_Ap_ChkPtAp8_ChkPtAp8_100msEnd_CP_CheckpointReached, OsApplicationParams=void
          Rte_TrustedCall_Ap_ChkPtAp8_ChkPtAp8_100msStart_CP_CheckpointReached: OsTrustedFunctionName=Rte_TrustedCall_Ap_ChkPtAp8_ChkPtAp8_100msStart_CP_CheckpointReached, OsApplicationParams=void
          Rte_TrustedCall_Ap_ChkPtAp8_ChkPtAp8_2msEnd_CP_CheckpointReached: OsTrustedFunctionName=Rte_TrustedCall_Ap_ChkPtAp8_ChkPtAp8_2msEnd_CP_CheckpointReached, OsApplicationParams=void
          Rte_TrustedCall_Ap_ChkPtAp8_ChkPtAp8_2msStart_CP_CheckpointReached: OsTrustedFunctionName=Rte_TrustedCall_Ap_ChkPtAp8_ChkPtAp8_2msStart_CP_CheckpointReached, OsApplicationParams=void
          Rte_TrustedCall_Ap_DiagSvc_AbsHwPos_SCom_CustClrTrim: OsTrustedFunctionName=Rte_TrustedCall_Ap_DiagSvc_AbsHwPos_SCom_CustClrTrim, OsApplicationParams=void
          Rte_TrustedCall_Ap_DiagSvc_AbsHwPos_SCom_CustSetTrim: OsTrustedFunctionName=Rte_TrustedCall_Ap_DiagSvc_AbsHwPos_SCom_CustSetTrim, OsApplicationParams=void
          Rte_TrustedCall_Ap_LrnEOT_SystemTime_DtrmnElapsedTime_mS_u16: OsTrustedFunctionName=Rte_TrustedCall_Ap_LrnEOT_SystemTime_DtrmnElapsedTime_mS_u16, OsApplicationParams=UInt32 InitialTime, UInt16 *ElapsedTime
          Rte_TrustedCall_Ap_LrnEOT_SystemTime_GetSystemTime_mS_u32: OsTrustedFunctionName=Rte_TrustedCall_Ap_LrnEOT_SystemTime_GetSystemTime_mS_u32, OsApplicationParams=UInt32 *CurrentTime
          Rte_TrustedCall_Ap_SrlComInput_SystemTime_DtrmnElapsedTime_mS_u16: OsTrustedFunctionName=Rte_TrustedCall_Ap_SrlComInput_SystemTime_DtrmnElapsedTime_mS_u16, OsApplicationParams=UInt32 InitialTime, UInt16 *ElapsedTime
          Rte_TrustedCall_Ap_SrlComInput_SystemTime_GetSystemTime_mS_u32: OsTrustedFunctionName=Rte_TrustedCall_Ap_SrlComInput_SystemTime_GetSystemTime_mS_u32, OsApplicationParams=UInt32 *CurrentTime
          Rte_TrustedCall_Ap_SrlComOutput_SystemTime_GetSystemTime_mS_u32: OsTrustedFunctionName=Rte_TrustedCall_Ap_SrlComOutput_SystemTime_GetSystemTime_mS_u32, OsApplicationParams=UInt32 *CurrentTime
          Rte_TrustedCall_Sa_BkCpPc_SystemTime_DtrmnElapsedTime_mS_u16: OsTrustedFunctionName=Rte_TrustedCall_Sa_BkCpPc_SystemTime_DtrmnElapsedTime_mS_u16, OsApplicationParams=UInt32 InitialTime, UInt16 *ElapsedTime
          Rte_TrustedCall_Sa_BkCpPc_SystemTime_GetSystemTime_mS_u32: OsTrustedFunctionName=Rte_TrustedCall_Sa_BkCpPc_SystemTime_GetSystemTime_mS_u32, OsApplicationParams=UInt32 *CurrentTime
          Rte_TrustedCall_Ap_AbsHwPos_EOLVehCntrOffset_GetErrorStatus: OsTrustedFunctionName=Rte_TrustedCall_Ap_AbsHwPos_EOLVehCntrOffset_GetErrorStatus, OsApplicationParams=NvM_RequestResultType *ErrorStatus
          Rte_TrustedCall_Ap_AbsHwPos_EOLVehCntrOffset_WriteBlock: OsTrustedFunctionName=Rte_TrustedCall_Ap_AbsHwPos_EOLVehCntrOffset_WriteBlock, OsApplicationParams=const NvM_DestPtr *DstPtr
          Rte_TrustedCall_Ap_ChkPtAp10_ChkPtAp10_100msEnd_CP_CheckpointReached: OsTrustedFunctionName=Rte_TrustedCall_Ap_ChkPtAp10_ChkPtAp10_100msEnd_CP_CheckpointReached, OsApplicationParams=void
          Rte_TrustedCall_Ap_ChkPtAp10_ChkPtAp10_100msStart_CP_CheckpointReached: OsTrustedFunctionName=Rte_TrustedCall_Ap_ChkPtAp10_ChkPtAp10_100msStart_CP_CheckpointReached, OsApplicationParams=void
          Rte_TrustedCall_Ap_ChkPtAp10_ChkPtAp10_10msEnd_CP_CheckpointReached: OsTrustedFunctionName=Rte_TrustedCall_Ap_ChkPtAp10_ChkPtAp10_10msEnd_CP_CheckpointReached, OsApplicationParams=void
          Rte_TrustedCall_Ap_ChkPtAp10_ChkPtAp10_10msStart_CP_CheckpointReached: OsTrustedFunctionName=Rte_TrustedCall_Ap_ChkPtAp10_ChkPtAp10_10msStart_CP_CheckpointReached, OsApplicationParams=void
          Rte_TrustedCall_Ap_ChkPtAp10_ChkPtAp10_2msEnd_CP_CheckpointReached: OsTrustedFunctionName=Rte_TrustedCall_Ap_ChkPtAp10_ChkPtAp10_2msEnd_CP_CheckpointReached, OsApplicationParams=void
          Rte_TrustedCall_Ap_ChkPtAp10_ChkPtAp10_2msStart_CP_CheckpointReached: OsTrustedFunctionName=Rte_TrustedCall_Ap_ChkPtAp10_ChkPtAp10_2msStart_CP_CheckpointReached, OsApplicationParams=void
          Rte_TrustedCall_Ap_ChkPtAp10_ChkPtAp10_4msEnd_CP_CheckpointReached: OsTrustedFunctionName=Rte_TrustedCall_Ap_ChkPtAp10_ChkPtAp10_4msEnd_CP_CheckpointReached, OsApplicationParams=void
          Rte_TrustedCall_Ap_ChkPtAp10_ChkPtAp10_4msStart_CP_CheckpointReached: OsTrustedFunctionName=Rte_TrustedCall_Ap_ChkPtAp10_ChkPtAp10_4msStart_CP_CheckpointReached, OsApplicationParams=void
          Rte_TrustedCall_Ap_CurrParamComp_EOLNomMtrParamBlk_WriteBlock: OsTrustedFunctionName=Rte_TrustedCall_Ap_CurrParamComp_EOLNomMtrParamBlk_WriteBlock, OsApplicationParams=const NvM_DestPtr *DstPtr
          Rte_TrustedCall_Ap_StaMd_CloseCheckData_GetErrorStatus: OsTrustedFunctionName=Rte_TrustedCall_Ap_StaMd_CloseCheckData_GetErrorStatus, OsApplicationParams=NvM_RequestResultType *ErrorStatus
          Rte_TrustedCall_Ap_StaMd_CloseCheckData_WriteBlock: OsTrustedFunctionName=Rte_TrustedCall_Ap_StaMd_CloseCheckData_WriteBlock, OsApplicationParams=const NvM_DestPtr *DstPtr
          Rte_TrustedCall_Ap_StaMd_TOD_OP_SET: OsTrustedFunctionName=Rte_TrustedCall_Ap_StaMd_TOD_OP_SET, OsApplicationParams=IoHwAb_BoolType signal
          Rte_TrustedCall_Ap_StaMd_TypeHData_WriteBlock: OsTrustedFunctionName=Rte_TrustedCall_Ap_StaMd_TypeHData_WriteBlock, OsApplicationParams=const NvM_DestPtr *DstPtr
          Rte_TrustedCall_Ap_TrqCanc_EOLCogTrqCanc_WriteBlock: OsTrustedFunctionName=Rte_TrustedCall_Ap_TrqCanc_EOLCogTrqCanc_WriteBlock, OsApplicationParams=const NvM_DestPtr *DstPtr
          Rte_TrustedCall_Ap_TrqCanc_EOLCogTrqRplComp_WriteBlock: OsTrustedFunctionName=Rte_TrustedCall_Ap_TrqCanc_EOLCogTrqRplComp_WriteBlock, OsApplicationParams=const NvM_DestPtr *DstPtr
          Rte_TrustedCall_Ap_TrqCmdScl_TrqCmdScl_WriteBlock: OsTrustedFunctionName=Rte_TrustedCall_Ap_TrqCmdScl_TrqCmdScl_WriteBlock, OsApplicationParams=const NvM_DestPtr *DstPtr
          Rte_TrustedCall_Sa_CDDInterface_CDDPorts_ApplyMtrElecMechPol: OsTrustedFunctionName=Rte_TrustedCall_Sa_CDDInterface_CDDPorts_ApplyMtrElecMechPol, OsApplicationParams=SInt8 MtrElecMechPol_Cnt_s8
          Rte_TrustedCall_Sa_CDDInterface_CDDPorts_ClearPhsReasSum: OsTrustedFunctionName=Rte_TrustedCall_Sa_CDDInterface_CDDPorts_ClearPhsReasSum, OsApplicationParams=UInt16 DataAccessBfr_Cnt_T_u16
          Rte_TrustedCall_Sa_CmMtrCurr_EOLCurrTempOffset_WriteBlock: OsTrustedFunctionName=Rte_TrustedCall_Sa_CmMtrCurr_EOLCurrTempOffset_WriteBlock, OsApplicationParams=const NvM_DestPtr *DstPtr
          Rte_TrustedCall_Sa_CmMtrCurr_EOLShCurrCal_SetRamBlockStatus: OsTrustedFunctionName=Rte_TrustedCall_Sa_CmMtrCurr_EOLShCurrCal_SetRamBlockStatus, OsApplicationParams=Boolean RamBlockStatus
          Rte_TrustedCall_Sa_CmMtrCurr_EOLShCurrCal_WriteBlock: OsTrustedFunctionName=Rte_TrustedCall_Sa_CmMtrCurr_EOLShCurrCal_WriteBlock, OsApplicationParams=const NvM_DestPtr *DstPtr
          Rte_TrustedCall_Sa_DigHwTrqSENT_NvM_DigHwTrqSENTTrim_Srv_GetErrorStatus: OsTrustedFunctionName=Rte_TrustedCall_Sa_DigHwTrqSENT_NvM_DigHwTrqSENTTrim_Srv_GetErrorStatus, OsApplicationParams=NvM_RequestResultType *ErrorStatus
          Rte_TrustedCall_Sa_DigHwTrqSENT_NvM_DigHwTrqSENTTrim_Srv_WriteBlock: OsTrustedFunctionName=Rte_TrustedCall_Sa_DigHwTrqSENT_NvM_DigHwTrqSENTTrim_Srv_WriteBlock, OsApplicationParams=const NvM_DestPtr *DstPtr
          Rte_TrustedCall_Sa_MtrDrvDiag_FetDrvReset_OP_SET: OsTrustedFunctionName=Rte_TrustedCall_Sa_MtrDrvDiag_FetDrvReset_OP_SET, OsApplicationParams=IoHwAb_BoolType signal
          Rte_TrustedCall_Sa_MtrDrvDiag_FetFlt1Data_OP_GET: OsTrustedFunctionName=Rte_TrustedCall_Sa_MtrDrvDiag_FetFlt1Data_OP_GET, OsApplicationParams=IoHwAb_BoolType *signal
          Rte_TrustedCall_Sa_MtrDrvDiag_FetFlt2Clk_OP_GET: OsTrustedFunctionName=Rte_TrustedCall_Sa_MtrDrvDiag_FetFlt2Clk_OP_GET, OsApplicationParams=IoHwAb_BoolType *signal
          Rte_TrustedCall_Sa_MtrDrvDiag_FetFlt2Clk_OP_SET: OsTrustedFunctionName=Rte_TrustedCall_Sa_MtrDrvDiag_FetFlt2Clk_OP_SET, OsApplicationParams=IoHwAb_BoolType signal
          Rte_TrustedCall_Sa_MtrDrvDiag_IoHwAbPortConfig_SetFetFlt2ToOutput: OsTrustedFunctionName=Rte_TrustedCall_Sa_MtrDrvDiag_IoHwAbPortConfig_SetFetFlt2ToOutput, OsApplicationParams=IoHwAb_BoolType signal
          Rte_TrustedCall_Sa_OvrVoltMon_phyOvrVoltFdbk_OP_GET: OsTrustedFunctionName=Rte_TrustedCall_Sa_OvrVoltMon_phyOvrVoltFdbk_OP_GET, OsApplicationParams=IoHwAb_BoolType *signal
          Rte_TrustedCall_Sa_ShtdnMech_FetDrvReset_OP_GET: OsTrustedFunctionName=Rte_TrustedCall_Sa_ShtdnMech_FetDrvReset_OP_GET, OsApplicationParams=IoHwAb_BoolType *signal
          Rte_TrustedCall_Sa_ShtdnMech_SysFault2_OP_GET: OsTrustedFunctionName=Rte_TrustedCall_Sa_ShtdnMech_SysFault2_OP_GET, OsApplicationParams=IoHwAb_BoolType *signal
          Rte_TrustedCall_Sa_ShtdnMech_SysFault3_OP_GET: OsTrustedFunctionName=Rte_TrustedCall_Sa_ShtdnMech_SysFault3_OP_GET, OsApplicationParams=IoHwAb_BoolType *signal
          Rte_TrustedCall_Sa_TmprlMon2_WdMonitor_OP_SET: OsTrustedFunctionName=Rte_TrustedCall_Sa_TmprlMon2_WdMonitor_OP_SET, OsApplicationParams=IoHwAb_BoolType signal
          Rte_TrustedCall_Sa_TmprlMon_FetDrvCntl_OP_GET: OsTrustedFunctionName=Rte_TrustedCall_Sa_TmprlMon_FetDrvCntl_OP_GET, OsApplicationParams=IoHwAb_BoolType *signal
          Rte_TrustedCall_Sa_TmprlMon_PwrSwitchEn_OP_GET: OsTrustedFunctionName=Rte_TrustedCall_Sa_TmprlMon_PwrSwitchEn_OP_GET, OsApplicationParams=IoHwAb_BoolType *signal
          Rte_TrustedCall_Sa_TmprlMon_SysFault2_OP_GET: OsTrustedFunctionName=Rte_TrustedCall_Sa_TmprlMon_SysFault2_OP_GET, OsApplicationParams=IoHwAb_BoolType *signal
          Rte_TrustedCall_Sa_TmprlMon_SysFault2_OP_SET: OsTrustedFunctionName=Rte_TrustedCall_Sa_TmprlMon_SysFault2_OP_SET, OsApplicationParams=IoHwAb_BoolType signal
          Rte_TrustedCall_Sa_TmprlMon_SysFault3_OP_GET: OsTrustedFunctionName=Rte_TrustedCall_Sa_TmprlMon_SysFault3_OP_GET, OsApplicationParams=IoHwAb_BoolType *signal
          Rte_TrustedCall_Sa_TmprlMon_SysFault3_OP_SET: OsTrustedFunctionName=Rte_TrustedCall_Sa_TmprlMon_SysFault3_OP_SET, OsApplicationParams=IoHwAb_BoolType signal
          Rte_TrustedCall_Sa_TmprlMon_WdMonitor_OP_SET: OsTrustedFunctionName=Rte_TrustedCall_Sa_TmprlMon_WdMonitor_OP_SET, OsApplicationParams=IoHwAb_BoolType signal
          Rte_TrustedCall_Sa_TmprlMon_WdReset_OP_SET: OsTrustedFunctionName=Rte_TrustedCall_Sa_TmprlMon_WdReset_OP_SET, OsApplicationParams=IoHwAb_BoolType signal
          Rte_TrustedCall_Ap_AstLmt_SteeringAsstDefeat_WriteBlock: OsTrustedFunctionName=Rte_TrustedCall_Ap_AstLmt_SteeringAsstDefeat_WriteBlock, OsApplicationParams=const NvM_DestPtr *DstPtr
          Rte_TrustedCall_Ap_Polarity_Polarity_WriteBlock: OsTrustedFunctionName=Rte_TrustedCall_Ap_Polarity_Polarity_WriteBlock, OsApplicationParams=const NvM_DestPtr *DstPtr
          Rte_TrustedCall_Ap_DiagSvc_VehDyn_SCom_ResetCenter: OsTrustedFunctionName=Rte_TrustedCall_Ap_DiagSvc_VehDyn_SCom_ResetCenter, OsApplicationParams=void
          Rte_TrustedCall_Ap_VehDyn_NVM_VehDynReset_Srv_WriteBlock: OsTrustedFunctionName=Rte_TrustedCall_Ap_VehDyn_NVM_VehDynReset_Srv_WriteBlock, OsApplicationParams=const NvM_DestPtr *DstPtr
          Rte_TrustedCall_Sa_DigColPs_EOLDigColPosCals_WriteBlock: OsTrustedFunctionName=Rte_TrustedCall_Sa_DigColPs_EOLDigColPosCals_WriteBlock, OsApplicationParams=const NvM_DestPtr *DstPtr
          Rte_TrustedCall_Ap_BatteryVoltage_OvervoltageData_SetRamBlockStatus: OsTrustedFunctionName=Rte_TrustedCall_Ap_BatteryVoltage_OvervoltageData_SetRamBlockStatus, OsApplicationParams=Boolean RamBlockStatus
          Rte_TrustedCall_Ap_BatteryVoltage_OvervoltageData_WriteBlock: OsTrustedFunctionName=Rte_TrustedCall_Ap_BatteryVoltage_OvervoltageData_WriteBlock, OsApplicationParams=const NvM_DestPtr *DstPtr
          Rte_TrustedCall_Ap_DiagSvc_DigColPs_SCom_CustClearTrim: OsTrustedFunctionName=Rte_TrustedCall_Ap_DiagSvc_DigColPs_SCom_CustClearTrim, OsApplicationParams=void
          Rte_TrustedCall_Ap_DiagSvc_DigColPs_SCom_CustSetTrim: OsTrustedFunctionName=Rte_TrustedCall_Ap_DiagSvc_DigColPs_SCom_CustSetTrim, OsApplicationParams=void
          Rte_TrustedCall_Ap_VehPwrMd_SystemTime_DtrmnElapsedTime_mS_u16: OsTrustedFunctionName=Rte_TrustedCall_Ap_VehPwrMd_SystemTime_DtrmnElapsedTime_mS_u16, OsApplicationParams=UInt32 InitialTime, UInt16 *ElapsedTime
          Rte_TrustedCall_Ap_VehPwrMd_SystemTime_GetSystemTime_mS_u32: OsTrustedFunctionName=Rte_TrustedCall_Ap_VehPwrMd_SystemTime_GetSystemTime_mS_u32, OsApplicationParams=UInt32 *CurrentTime
          Rte_TrustedCall_Ap_DiagSvc_SystemTime_DtrmnElapsedTime_mS_u32: OsTrustedFunctionName=Rte_TrustedCall_Ap_DiagSvc_SystemTime_DtrmnElapsedTime_mS_u32, OsApplicationParams=UInt32 InitialTime, UInt32 *ElapsedTime
          Rte_TrustedCall_Ap_DiagSvc_SystemTime_GetSystemTime_mS_u32: OsTrustedFunctionName=Rte_TrustedCall_Ap_DiagSvc_SystemTime_GetSystemTime_mS_u32, OsApplicationParams=UInt32 *CurrentTime
          Rte_TrustedCall_Ap_SrlComOutput_SystemTime_DtrmnElapsedTime_mS_u16: OsTrustedFunctionName=Rte_TrustedCall_Ap_SrlComOutput_SystemTime_DtrmnElapsedTime_mS_u16, OsApplicationParams=UInt32 InitialTime, UInt16 *ElapsedTime
          Rte_TrustedCall_Ap_DiagSvc_SystemTime_DtrmnElapsedTime_mS_u16: OsTrustedFunctionName=Rte_TrustedCall_Ap_DiagSvc_SystemTime_DtrmnElapsedTime_mS_u16, OsApplicationParams=UInt32 InitialTime, UInt16 *ElapsedTime
      Ap_10: OsTrusted=false, OsAppGenerateStub=false, OsApplicationProtectionRegionSize=8192, OsApplicationMPUArea8Size=268435456, OsApplicationMPUArea8Access=4864, OsApplicationNonTrusted_Function=NtWrapS_XcpWriteAp10, OsApplicationNonTrusted_Function=NtWrapS_AbsHwPos_SCom_CustClrTrim, OsApplicationNonTrusted_Function=NtWrapS_AbsHwPos_SCom_CustSetTrim, OsApplicationNonTrusted_Function=NtWrapS_AbsHwPos_SCom_NxtClearTrim, OsApplicationNonTrusted_Function=NtWrapS_AbsHwPos_SCom_NxtSetTrim, OsApplicationNonTrusted_Function=NtWrapS_AstLmt_Scom_ManualTrqCmd, OsApplicationNonTrusted_Function=NtWrapS_CmMtrCurr_SCom_CalGain, OsApplicationNonTrusted_Function=NtWrapS_CmMtrCurr_SCom_CalOffset, OsApplicationNonTrusted_Function=NtWrapS_CmMtrCurr_SCom_SetMtrCurrCals, OsApplicationNonTrusted_Function=NtWrapS_DigHwTrqSENT_SCom_ClrTrqTrim, OsApplicationNonTrusted_Function=NtWrapS_DigHwTrqSENT_SCom_SetTrqTrim, OsApplicationNonTrusted_Function=NtWrapS_DigHwTrqSENT_SCom_WriteData, OsApplicationNonTrusted_Function=NtWrapS_Polarity_SCom_SetPolarity, OsApplicationNonTrusted_Function=NtWrapS_SCom_EOLNomMtrParam_Set, OsApplicationNonTrusted_Function=NtWrapS_TrqCanc_Scom_SetCogTrqCal, OsApplicationNonTrusted_Function=NtWrapS_TrqCmdScl_SCom_Set, OsApplicationNonTrusted_Function=NtWrapS_VehDyn_SCom_ResetCenter, OsApplicationNonTrusted_Function=NtWrapS_DigColPs_SCom_CustSetTrim, OsApplicationNonTrusted_Function=NtWrapS_DigColPs_SCom_CustClearTrim, OsApplicationNonTrusted_Function=NtWrapS_DigColPs_SCom_NxtSetTrim, OsApplicationNonTrusted_Function=NtWrapS_DigColPs_SCom_NxtClearTrim, OsApplicationMPUArea8Start=4026531840, OsAppAlarmRef=Rte_Al_TE_Task_100ms_10_0_100ms, OsAppAlarmRef=Rte_Al_TE_Task_10ms_10_0_10ms, OsAppAlarmRef=Rte_Al_TE_Task_2ms_10_0_2ms, OsAppAlarmRef=Rte_Al_TE_Task_4ms_10_0_4ms, OsAppIsrRef=Isr_OvervoltThresh, OsAppIsrRef=Isr_I2c, OsAppTaskRef=Task_100ms_10, OsAppTaskRef=Task_10ms_10, OsAppTaskRef=Task_2ms_10, OsAppTaskRef=Task_4ms_10, OsAppTaskRef=Task_Init_10, OsAppTaskRef=Task_Trns_10
        OsApplicationHooks: OsAppErrorHook=false, OsAppShutdownHook=false, OsAppStartupHook=false
    SystemTimer (OsCounter): OsCounterMaxAllowedValue=2147483647, OsCounterMinCycle=1, OsCounterTicksPerBase=1, OsCounterType=SOFTWARE, OsSecondsPerTick=1234567890
    16 x OsEvent:
      Rte_Ev_Run_HwPwUp_HwPwUp_Trns1
      Rte_Ev_Run_ePWM2_ePWM2_Trns2
      Rte_Ev_Run_DiagMgr8_DiagMgr8_Trns
      Rte_Ev_Run_RteErrata8_RteErrata8_Trns
      Rte_Ev_MS_Task_Trns_10: OsEventMask=4
      Rte_Ev_MS_Task_Trns_9: OsEventMask=4
      Rte_Ev_OnEntry_Task_Trns_10_StaMd_SystemState_Mode_DISABLE
      Rte_Ev_OnEntry_Task_Trns_10_StaMd_SystemState_Mode_OFF
      Rte_Ev_OnEntry_Task_Trns_10_StaMd_SystemState_Mode_OPERATE
      Rte_Ev_OnEntry_Task_Trns_10_StaMd_SystemState_Mode_WARMINIT
      Rte_Ev_OnEntry_Task_Trns_9_StaMd9_SystemState9_Mode_DISABLE
      Rte_Ev_OnEntry_Task_Trns_9_StaMd9_SystemState9_Mode_OFF
      Rte_Ev_OnEntry_Task_Trns_9_StaMd9_SystemState9_Mode_OPERATE
      Rte_Ev_OnEntry_Task_Trns_9_StaMd9_SystemState9_Mode_WARMINIT
      Rte_Ev_OnExit_Task_Trns_9_StaMd9_SystemState9_Mode_OFF
      Rte_Ev_Run_DiagMgr10_DiagMgr10_Trns
    8 x OsIsr, all with OsIsrAnalysisPriority=0, OsIsrComputationTime=0, OsIsrPeriod=0, OsIsrDeadline=0, OsIsrProtectionRegionSize=0, OsIsrNonTrustFctStackSize=0:
      Isr_MtrCtrl: OsIsrCategory=CATEGORY_1, OsIsrEnableNesting=false, OsIsrInterruptTarget=IRQ, OsIsrInterruptSource=INTR40
        OsIsrInterruptPriority
          NON_AUTO: OsIsrInterruptPriority=2
        OsIsrUseSpecialFunctionName
          FALSE
      CanIsr_0: OsIsrCategory=CATEGORY_2, OsIsrEnableNesting=true, OsIsrInterruptTarget=IRQ, OsIsrInterruptSource=INTR16
        OsIsrInterruptPriority
          NON_AUTO: OsIsrInterruptPriority=16
        OsIsrUseSpecialFunctionName
          FALSE
      Isr_ESMH: OsIsrCategory=CATEGORY_1, OsIsrEnableNesting=false, OsIsrInterruptTarget=FIQ, OsIsrInterruptSource=INTR0
        OsIsrInterruptPriority
          NON_AUTO: OsIsrInterruptPriority=0
        OsIsrUseSpecialFunctionName
          FALSE
      Gpt_IsrInt0: OsIsrCategory=CATEGORY_2, OsIsrEnableNesting=true, OsIsrInterruptTarget=IRQ, OsIsrInterruptSource=INTR2
        OsIsrInterruptPriority
          NON_AUTO: OsIsrInterruptPriority=4
        OsIsrUseSpecialFunctionName
          FALSE
      Isr_ESML: OsIsrCategory=CATEGORY_2, OsIsrEnableNesting=false, OsIsrInterruptTarget=IRQ, OsIsrInterruptSource=INTR20
        OsIsrInterruptPriority
          NON_AUTO: OsIsrInterruptPriority=20
        OsIsrUseSpecialFunctionName
          FALSE
      FlsTst_CrcIrq: OsIsrCategory=CATEGORY_2, OsIsrEnableNesting=false, OsIsrInterruptTarget=IRQ, OsIsrInterruptSource=INTR19
        OsIsrInterruptPriority
          NON_AUTO: OsIsrInterruptPriority=19
        OsIsrUseSpecialFunctionName
          FALSE
      Isr_OvervoltThresh: OsIsrCategory=CATEGORY_2, OsIsrEnableNesting=true, OsIsrInterruptTarget=IRQ, OsIsrInterruptSource=INTR31
        OsIsrInterruptPriority
          NON_AUTO: OsIsrInterruptPriority=31
        OsIsrUseSpecialFunctionName
          FALSE
      Isr_I2c: OsIsrCategory=CATEGORY_2, OsIsrEnableNesting=false, OsIsrInterruptTarget=IRQ, OsIsrInterruptSource=INTR66
        OsIsrInterruptPriority
          NON_AUTO: OsIsrInterruptPriority=8
        OsIsrUseSpecialFunctionName
          FALSE
    OsOS:
      OsScalabilityClass = SC3
      OsStackMonitoring = true
      OsOSStackUsageMeasurement = AUTO
      OsStatus = EXTENDED
      OsUseGetServiceId = true
      OsUseParameterAccess = true
      OsUseResScheduler = true
      OsOSUseGeneratedFastAlarm = true
      OsOSThumbMode = true
      OsOSFPUSupport = true
      OsOSORTIDebugSupport = false
      OsOSTypeHeaderInclude = false
      OsOSCpuFrequency = 80
      OsOSAbortStackSize = 252
      OsOSAPIStackSize = 508
      OsOSTimerClockDivider = 160
      OsOSTickTime = 2000
      OsOSSupervisorStackSize = 508
      OsOSIRQMaxNesting = 6
      OsOSIRQStackOffset = 508
      OsOSUserConfigurationVersion = 0
      OsOSSystemTimer = UserDefined
      OsOSErrorInfoLevel = STANDARD
      OsOSOSInternalChecks = Additional
      OsOSCompiler = TI
      OsOSORTIDebugLevel = ORTI_20
      OsHooks: OsErrorHook=true, OsPostTaskHook=false, OsPreTaskHook=false, OsProtectionHook=true, OsShutdownHook=true, OsStartupHook=true
      OsOSSCHEDULE
        AUTO
      OsOSCC
        AUTO
      OsOSProtectionHookReaction
        Selected: OsOSSHUTDOWN=true
      OsOSSystemTimerIntPrio
        NON_AUTO: OsOSSystemTimerIntPrio=3
      OsOSMemoryProtection
        TRUE: OsOSMPUCodeRegionBase=0, OsOSMPUCodeRegionSize=786432, OsOSIRQHandlerStackSize=1020, OsOSOSDataSize=1024, OsOSGlobalSharedMemRegionSize=1024
      OsOSRESETHandler
        AUTO
      OsOSUDEFHandler
        NON_AUTO: OsOSUDEFHandler=_undefinst
      OsOSFIQHandler
        NON_AUTO: OsOSFIQHandler=_fiqhandler
      33 x OsOSPeripheralRegion:
        OS_MEM_AREA_GIOA
          Region:
            OsOSStartAddress = 4294425600
            OsOSEndAddress = 4294425855
            OsOSIdentifier = OS_MEM_AREA_GIOA
            OsOSACCESSING_APPLICATION = Ap_0
            OsOSACCESSING_APPLICATION = Ap_{8..10}
        OS_MEM_AREA_GIOB
          Region:
            OsOSStartAddress = 4294425600
            OsOSEndAddress = 4294425855
            OsOSIdentifier = OS_MEM_AREA_GIOB
            OsOSACCESSING_APPLICATION = Ap_0
            OsOSACCESSING_APPLICATION = Ap_{8..10}
        OS_MEM_AREA_CAN1
          Region:
            OsOSStartAddress = 4294433792
            OsOSEndAddress = 4294434303
            OsOSIdentifier = OS_MEM_AREA_CAN1
            OsOSACCESSING_APPLICATION = Ap_0
            OsOSACCESSING_APPLICATION = Ap_{8..10}
        OS_MEM_AREA_CAN2
          Region:
            OsOSStartAddress = 4294434304
            OsOSEndAddress = 4294434815
            OsOSIdentifier = OS_MEM_AREA_CAN2
            OsOSACCESSING_APPLICATION = Ap_0
            OsOSACCESSING_APPLICATION = Ap_{8..10}
        OS_MEM_AREA_CAN3
          Region:
            OsOSStartAddress = 4294434816
            OsOSEndAddress = 4294435327
            OsOSIdentifier = OS_MEM_AREA_CAN3
            OsOSACCESSING_APPLICATION = Ap_0
            OsOSACCESSING_APPLICATION = Ap_{8..10}
        OS_MEM_AREA_LIN
          Region:
            OsOSStartAddress = 4294435840
            OsOSEndAddress = 4294436095
            OsOSIdentifier = OS_MEM_AREA_LIN
            OsOSACCESSING_APPLICATION = Ap_0
            OsOSACCESSING_APPLICATION = Ap_{8..10}
        OS_MEM_AREA_SCI
          Region:
            OsOSStartAddress = 4294436096
            OsOSEndAddress = 4294436351
            OsOSIdentifier = OS_MEM_AREA_SCI
            OsOSACCESSING_APPLICATION = Ap_0
            OsOSACCESSING_APPLICATION = Ap_{8..10}
        OS_MEM_AREA_IIC
          Region:
            OsOSStartAddress = 4294431744
            OsOSEndAddress = 4294431999
            OsOSIdentifier = OS_MEM_AREA_IIC
            OsOSACCESSING_APPLICATION = Ap_0
            OsOSACCESSING_APPLICATION = Ap_{8..10}
        OS_MEM_AREA_SPI1
          Region:
            OsOSStartAddress = 4294439936
            OsOSEndAddress = 4294440447
            OsOSIdentifier = OS_MEM_AREA_SPI1
            OsOSACCESSING_APPLICATION = Ap_0
            OsOSACCESSING_APPLICATION = Ap_{8..10}
        OS_MEM_AREA_SPI2
          Region:
            OsOSStartAddress = 4294440448
            OsOSEndAddress = 4294440959
            OsOSIdentifier = OS_MEM_AREA_SPI2
            OsOSACCESSING_APPLICATION = Ap_0
            OsOSACCESSING_APPLICATION = Ap_{8..10}
        OS_MEM_AREA_SPI3
          Region:
            OsOSStartAddress = 4294440960
            OsOSEndAddress = 4294441471
            OsOSIdentifier = OS_MEM_AREA_SPI3
            OsOSACCESSING_APPLICATION = Ap_0
            OsOSACCESSING_APPLICATION = Ap_{8..10}
        OS_MEM_AREA_SPI4
          Region:
            OsOSStartAddress = 4294441472
            OsOSEndAddress = 4294441983
            OsOSIdentifier = OS_MEM_AREA_SPI4
            OsOSACCESSING_APPLICATION = Ap_0
            OsOSACCESSING_APPLICATION = Ap_{8..10}
        OS_MEM_AREA_SPI5
          Region:
            OsOSStartAddress = 4294441984
            OsOSEndAddress = 4294442495
            OsOSIdentifier = OS_MEM_AREA_SPI5
            OsOSACCESSING_APPLICATION = Ap_0
            OsOSACCESSING_APPLICATION = Ap_{8..10}
        OS_MEM_AREA_NHET1
          Region:
            OsOSStartAddress = 4294424576
            OsOSEndAddress = 4294424831
            OsOSIdentifier = OS_MEM_AREA_NHET1
            OsOSACCESSING_APPLICATION = Ap_0
            OsOSACCESSING_APPLICATION = Ap_{8..10}
        OS_MEM_AREA_NHET2
          Region:
            OsOSStartAddress = 4294424832
            OsOSEndAddress = 4294425087
            OsOSIdentifier = OS_MEM_AREA_NHET2
            OsOSACCESSING_APPLICATION = Ap_0
            OsOSACCESSING_APPLICATION = Ap_{8..10}
        OS_MEM_AREA_SYS
          Region:
            OsOSStartAddress = 4294967040
            OsOSEndAddress = 4294967295
            OsOSIdentifier = OS_MEM_AREA_SYS
            OsOSACCESSING_APPLICATION = Ap_0
            OsOSACCESSING_APPLICATION = Ap_{8..10}
        OS_MEM_AREA_ADC1
          Region:
            OsOSStartAddress = 4294426624
            OsOSEndAddress = 4294427135
            OsOSIdentifier = OS_MEM_AREA_ADC1
            OsOSACCESSING_APPLICATION = Ap_0
            OsOSACCESSING_APPLICATION = Ap_{8..10}
        OS_MEM_AREA_ADC2
          Region:
            OsOSStartAddress = 4294427136
            OsOSEndAddress = 4294427647
            OsOSIdentifier = OS_MEM_AREA_ADC2
            OsOSACCESSING_APPLICATION = Ap_0
            OsOSACCESSING_APPLICATION = Ap_{8..10}
        OS_MEM_AREA_RTP
          Region:
            OsOSStartAddress = 4294965760
            OsOSEndAddress = 4294966015
            OsOSIdentifier = OS_MEM_AREA_RTP
            OsOSACCESSING_APPLICATION = Ap_0
            OsOSACCESSING_APPLICATION = Ap_{8..10}
        OS_MEM_AREA_DMM
          Region:
            OsOSStartAddress = 4294964992
            OsOSEndAddress = 4294965247
            OsOSIdentifier = OS_MEM_AREA_DMM
            OsOSACCESSING_APPLICATION = Ap_0
            OsOSACCESSING_APPLICATION = Ap_{8..10}
        OS_MEM_AREA_IOMM
          Region:
            OsOSStartAddress = 4294961664
            OsOSEndAddress = 4294962175
            OsOSIdentifier = OS_MEM_AREA_IOMM
            OsOSACCESSING_APPLICATION = Ap_0
            OsOSACCESSING_APPLICATION = Ap_{8..10}
        OS_MEM_AREA_RTI
          Region:
            OsOSStartAddress = 4294966272
            OsOSEndAddress = 4294966527
            OsOSIdentifier = OS_MEM_AREA_RTI
            OsOSACCESSING_APPLICATION = Ap_0
            OsOSACCESSING_APPLICATION = Ap_{8..10}
        OS_MEM_AREA_ESMEPSR
          Region:
            OsOSStartAddress = 4294964516
            OsOSEndAddress = 4294964519
            OsOSIdentifier = OS_MEM_AREA_ESMEPSR
            OsOSACCESSING_APPLICATION = Ap_0
            OsOSACCESSING_APPLICATION = Ap_{8..10}
        OS_MEM_AREA_VIM
          Region:
            OsOSStartAddress = 4294966816
            OsOSEndAddress = 4294966859
            OsOSIdentifier = OS_MEM_AREA_VIM
            OsOSACCESSING_APPLICATION = Ap_0
            OsOSACCESSING_APPLICATION = Ap_{8..10}
        OS_MEM_AREA_ESMEKR
          Region:
            OsOSStartAddress = 4294964536
            OsOSEndAddress = 4294964545
            OsOSIdentifier = OS_MEM_AREA_ESMEKR
            OsOSACCESSING_APPLICATION = Ap_0
            OsOSACCESSING_APPLICATION = Ap_{8..10}
        OS_MEM_AREA_SPI_REG1
          Region:
            OsOSStartAddress = 4294439936
            OsOSEndAddress = 4294440447
            OsOSIdentifier = OS_MEM_AREA_SPI_REG1
            OsOSACCESSING_APPLICATION = Ap_0
            OsOSACCESSING_APPLICATION = Ap_{8..10}
        OS_MEM_AREA_SPI_REG3
          Region:
            OsOSStartAddress = 4294440960
            OsOSEndAddress = 4294441471
            OsOSIdentifier = OS_MEM_AREA_SPI_REG3
            OsOSACCESSING_APPLICATION = Ap_0
            OsOSACCESSING_APPLICATION = Ap_{8..10}
        OS_MEM_AREA_SPI_REG5
          Region:
            OsOSStartAddress = 4294441984
            OsOSEndAddress = 4294442495
            OsOSIdentifier = OS_MEM_AREA_SPI_REG5
            OsOSACCESSING_APPLICATION = Ap_0
            OsOSACCESSING_APPLICATION = Ap_{8..10}
        OS_MEM_AREA_SPI_RAM1
          Region:
            OsOSStartAddress = 4279107584
            OsOSEndAddress = 4279238655
            OsOSIdentifier = OS_MEM_AREA_SPI_RAM1
            OsOSACCESSING_APPLICATION = Ap_0
            OsOSACCESSING_APPLICATION = Ap_{8..10}
        OS_MEM_AREA_SPI_RAM3
          Region:
            OsOSStartAddress = 4278976512
            OsOSEndAddress = 4279107583
            OsOSIdentifier = OS_MEM_AREA_SPI_RAM3
            OsOSACCESSING_APPLICATION = Ap_0
            OsOSACCESSING_APPLICATION = Ap_{8..10}
        OS_MEM_AREA_SPI_RAM5
          Region:
            OsOSStartAddress = 4278845440
            OsOSEndAddress = 4278976511
            OsOSIdentifier = OS_MEM_AREA_SPI_RAM5
            OsOSACCESSING_APPLICATION = Ap_0
            OsOSACCESSING_APPLICATION = Ap_{8..10}
        OS_MEM_AREA_SYSECR
          Region:
            OsOSStartAddress = 4294967264
            OsOSEndAddress = 4294967267
            OsOSIdentifier = OS_MEM_AREA_SYSECR
            OsOSACCESSING_APPLICATION = Ap_0
            OsOSACCESSING_APPLICATION = Ap_{8..10}
        OS_MEM_AREA_FLASH
          Region:
            OsOSStartAddress = 4294471680
            OsOSEndAddress = 4294472708
            OsOSIdentifier = OS_MEM_AREA_FLASH
            OsOSACCESSING_APPLICATION = Ap_0
            OsOSACCESSING_APPLICATION = Ap_{8..10}
      OsOSTimingMeasurement
        FALSE
      OsOSAPIOptimization
        Manual:
          OsOSActivateTask = true
          OsOSTerminateTask = true
          OsOSChainTask = true
          OsOSSchedule = true
          OsOSGetTaskID = true
          OsOSGetTaskState = true
          OsOSDisableAllInterrupts = true
          OsOSEnableAllInterrupts = true
          OsOSSuspendOSInterrupts = true
          OsOSResumeOSInterrupts = true
          OsOSSuspendAllInterrupts = true
          OsOSResumeAllInterrupts = true
          OsOSGetResource = true
          OsOSReleaseResource = true
          OsOSSetEvent = true
          OsOSClearEvent = true
          OsOSGetEvent = true
          OsOSWaitEvent = true
          OsOSGetAlarmBase = true
          OsOSGetAlarm = true
          OsOSSetRelAlarm = true
          OsOSSetAbsAlarm = true
          OsOSCancelAlarm = true
          OsOSGetActiveApplicationMode = true
          OsOSIncrementCounter = true
          OsOSStartCOM = true
          OsOSStopCOM = true
          OsOSSendMessage = true
          OsOSReceiveMessage = true
          OsOSGetMessageStatus = true
          OsOSInitMessage = true
          OsOSGetCOMApplicationMode = true
          OsOSStartScheduleTableAbs = true
          OsOSStartScheduleTableRel = true
          OsOSStopScheduleTable = true
          OsOSNextScheduleTable = true
          OsOSGetScheduleTableStatus = true
          OsOSStartScheduleTableSynchron = true
          OsOSSyncScheduleTable = true
          OsOSSetScheduleTableAsync = true
          OsOSGetApplicationID = true
          OsOSGetISRID = true
          OsOSCallTrustedFunction = true
          OsOSCallNonTrustedFunction = true
          OsOSCheckISRMemoryAccess = true
          OsOSCheckTaskMemoryAccess = true
          OsOSCheckObjectAccess = true
          OsOSCheckObjectOwnership = true
          OsOSTerminateApplication = true
          OsOSGetTaskMaxExecutionTime = true
          OsOSGetISRMaxExecutionTime = true
          OsOSGetTaskMaxBlockingTime = true
          OsOSGetISRMaxBlockingTime = true
          OsOSGetTaskMinInterArrivalTime = true
          OsOSGetISRMinInterArrivalTime = true
    RES_SCHEDULER (OsResource): OsResourceProperty=STANDARD
    23 x OsTask, all with OsTaskActivation=1, OsTaskSchedule=FULL, OsTaskComputationTime=0, OsTaskPeriod=0, OsTaskDeadline=0, OsTaskProtectionRegionSize=0:
      Task_SchM_10ms_9: OsTaskPriority=40, OsTaskTYPE=EXTENDED, OsTaskNotUsingSchedule=false, OsTaskStackSize=2044, OsTaskNonTrustFctStackSize=252, OsTaskAccessingApplication=Ap_0, OsTaskAccessingApplication=Ap_9
      Task_Bkgnd: OsTaskPriority=0, OsTaskTYPE=BASIC, OsTaskNotUsingSchedule=true, OsTaskStackSize=1020, OsTaskNonTrustFctStackSize=0
        OsTaskAutostart: OsTaskAppModeRef=OSDEFAULTAPPMODE
      Task_SchM_4ms_0: OsTaskPriority=80, OsTaskTYPE=BASIC, OsTaskNotUsingSchedule=false, OsTaskStackSize=1020, OsTaskNonTrustFctStackSize=0
      Task_SchM_Init_9: OsTaskPriority=1, OsTaskTYPE=BASIC, OsTaskNotUsingSchedule=false, OsTaskStackSize=2044, OsTaskNonTrustFctStackSize=508, OsTaskAccessingApplication=Ap_0
        OsTaskAutostart: OsTaskAppModeRef=OSDEFAULTAPPMODE
      Task_100ms_10: OsTaskPriority=32, OsTaskTYPE=BASIC, OsTaskNotUsingSchedule=false, OsTaskStackSize=1020, OsTaskNonTrustFctStackSize=0, OsTaskAccessingApplication=Ap_0, OsTaskAccessingApplication=Ap_8, OsTaskAccessingApplication=Ap_9
      Task_100ms_9: OsTaskPriority=30, OsTaskTYPE=BASIC, OsTaskNotUsingSchedule=false, OsTaskStackSize=1020, OsTaskNonTrustFctStackSize=0, OsTaskAccessingApplication=Ap_0, OsTaskAccessingApplication=Ap_8, OsTaskAccessingApplication=Ap_9, OsTaskAccessingApplication=Ap_10
      Task_10ms_10: OsTaskPriority=42, OsTaskTYPE=BASIC, OsTaskNotUsingSchedule=false, OsTaskStackSize=1020, OsTaskNonTrustFctStackSize=0, OsTaskAccessingApplication=Ap_0, OsTaskAccessingApplication=Ap_8, OsTaskAccessingApplication=Ap_9
      Task_10ms_9: OsTaskPriority=41, OsTaskTYPE=BASIC, OsTaskNotUsingSchedule=false, OsTaskStackSize=1020, OsTaskNonTrustFctStackSize=508, OsTaskAccessingApplication=Ap_0, OsTaskAccessingApplication=Ap_9, OsTaskAccessingApplication=Ap_10
      Task_2ms_10: OsTaskPriority=62, OsTaskTYPE=BASIC, OsTaskNotUsingSchedule=false, OsTaskStackSize=1020, OsTaskNonTrustFctStackSize=508, OsTaskAccessingApplication=Ap_0, OsTaskAccessingApplication=Ap_8, OsTaskAccessingApplication=Ap_9
      Task_2ms_8: OsTaskPriority=61, OsTaskTYPE=BASIC, OsTaskNotUsingSchedule=false, OsTaskStackSize=1020, OsTaskNonTrustFctStackSize=0, OsTaskAccessingApplication=Ap_0, OsTaskAccessingApplication=Ap_9, OsTaskAccessingApplication=Ap_10
      Task_2ms_9: OsTaskPriority=60, OsTaskTYPE=BASIC, OsTaskNotUsingSchedule=false, OsTaskStackSize=1020, OsTaskNonTrustFctStackSize=0, OsTaskAccessingApplication=Ap_0, OsTaskAccessingApplication=Ap_8, OsTaskAccessingApplication=Ap_9, OsTaskAccessingApplication=Ap_10
      Task_4ms_10: OsTaskPriority=52, OsTaskTYPE=BASIC, OsTaskNotUsingSchedule=false, OsTaskStackSize=1020, OsTaskNonTrustFctStackSize=0, OsTaskAccessingApplication=Ap_0, OsTaskAccessingApplication=Ap_9
      Task_4ms_9: OsTaskPriority=50, OsTaskTYPE=BASIC, OsTaskNotUsingSchedule=false, OsTaskStackSize=1020, OsTaskNonTrustFctStackSize=0, OsTaskAccessingApplication=Ap_0, OsTaskAccessingApplication=Ap_9, OsTaskAccessingApplication=Ap_10
      Task_Init_10: OsTaskPriority=72, OsTaskTYPE=BASIC, OsTaskNotUsingSchedule=false, OsTaskStackSize=1020, OsTaskNonTrustFctStackSize=0, OsTaskAccessingApplication=Ap_0, OsTaskAccessingApplication=Ap_8, OsTaskAccessingApplication=Ap_9
      Task_Init_8: OsTaskPriority=71, OsTaskTYPE=BASIC, OsTaskNotUsingSchedule=false, OsTaskStackSize=1020, OsTaskNonTrustFctStackSize=0, OsTaskAccessingApplication=Ap_0, OsTaskAccessingApplication=Ap_9, OsTaskAccessingApplication=Ap_10
      Task_Init_9: OsTaskPriority=70, OsTaskTYPE=BASIC, OsTaskNotUsingSchedule=false, OsTaskStackSize=1020, OsTaskNonTrustFctStackSize=0, OsTaskAccessingApplication=Ap_0, OsTaskAccessingApplication=Ap_8, OsTaskAccessingApplication=Ap_9, OsTaskAccessingApplication=Ap_10
      Task_Trns_10: OsTaskPriority=12, OsTaskTYPE=EXTENDED, OsTaskNotUsingSchedule=false, OsTaskStackSize=1020, OsTaskNonTrustFctStackSize=0, OsTaskAccessingApplication=Ap_0, OsTaskAccessingApplication=Ap_8, OsTaskAccessingApplication=Ap_9, OsTaskEventRef=Rte_Ev_Run_HwPwUp_HwPwUp_Trns1, OsTaskEventRef=Rte_Ev_Run_ePWM2_ePWM2_Trns2, OsTaskEventRef=Rte_Ev_MS_Task_Trns_10, OsTaskEventRef=Rte_Ev_OnEntry_Task_Trns_10_StaMd_SystemState_Mode_DISABLE, OsTaskEventRef=Rte_Ev_OnEntry_Task_Trns_10_StaMd_SystemState_Mode_OFF, OsTaskEventRef=Rte_Ev_OnEntry_Task_Trns_10_StaMd_SystemState_Mode_OPERATE, OsTaskEventRef=Rte_Ev_OnEntry_Task_Trns_10_StaMd_SystemState_Mode_WARMINIT, OsTaskEventRef=Rte_Ev_Run_DiagMgr10_DiagMgr10_Trns
      Task_SchM_100ms_0: OsTaskPriority=2, OsTaskTYPE=BASIC, OsTaskNotUsingSchedule=false, OsTaskStackSize=1020, OsTaskNonTrustFctStackSize=0, OsTaskAccessingApplication=Ap_0
      Task_SchM_100ms_9: OsTaskPriority=3, OsTaskTYPE=BASIC, OsTaskNotUsingSchedule=false, OsTaskStackSize=1020, OsTaskNonTrustFctStackSize=0, OsTaskAccessingApplication=Ap_0
      Task_Trns_8: OsTaskPriority=11, OsTaskTYPE=EXTENDED, OsTaskNotUsingSchedule=false, OsTaskStackSize=508, OsTaskNonTrustFctStackSize=0, OsTaskAccessingApplication=Ap_0, OsTaskAccessingApplication=Ap_9, OsTaskAccessingApplication=Ap_10, OsTaskEventRef=Rte_Ev_Run_DiagMgr8_DiagMgr8_Trns, OsTaskEventRef=Rte_Ev_Run_RteErrata8_RteErrata8_Trns
      Task_100ms_8: OsTaskPriority=31, OsTaskTYPE=BASIC, OsTaskNotUsingSchedule=false, OsTaskStackSize=1020, OsTaskNonTrustFctStackSize=0, OsTaskAccessingApplication=Ap_0, OsTaskAccessingApplication=Ap_9, OsTaskAccessingApplication=Ap_10
      Task_Trns_9: OsTaskPriority=10, OsTaskTYPE=EXTENDED, OsTaskNotUsingSchedule=false, OsTaskStackSize=508, OsTaskNonTrustFctStackSize=0, OsTaskAccessingApplication=Ap_0, OsTaskAccessingApplication=Ap_9, OsTaskAccessingApplication=Ap_10, OsTaskEventRef=Rte_Ev_MS_Task_Trns_9, OsTaskEventRef=Rte_Ev_OnEntry_Task_Trns_9_StaMd9_SystemState9_Mode_DISABLE, OsTaskEventRef=Rte_Ev_OnEntry_Task_Trns_9_StaMd9_SystemState9_Mode_OFF, OsTaskEventRef=Rte_Ev_OnEntry_Task_Trns_9_StaMd9_SystemState9_Mode_OPERATE, OsTaskEventRef=Rte_Ev_OnEntry_Task_Trns_9_StaMd9_SystemState9_Mode_WARMINIT, OsTaskEventRef=Rte_Ev_OnExit_Task_Trns_9_StaMd9_SystemState9_Mode_OFF
      Task_SchM_Trns_9: OsTaskPriority=13, OsTaskTYPE=BASIC, OsTaskNotUsingSchedule=false, OsTaskStackSize=508, OsTaskNonTrustFctStackSize=0, OsTaskAccessingApplication=Ap_0, OsTaskAccessingApplication=Ap_9, OsTaskAccessingApplication=Ap_10
    OsImplementationInformation: OsVectorOilVersion=3.2, OsVectorImplementationName=TMS570LS3x.i32, OsBswmdStyleVersion=2
    OsCom:
      OsComErrorHook = false
      OsComUseGetServiceId = false
      OsComUseParameterAccess = false
      OsComStartComExtension = false
      OsComUseCOM = false
      OsComStatus = COMSTANDARD
    VectorCommonData: BswmdVersion=5.06.00
  module config Rte: implementation-config-variant=VARIANT-PRE-COMPILE, module-description=Rte_Impl
    68 x ComponentTypeCalibration, all with CalibrationSupportEnabled=false:
      Ap_AbsHwPos: ComponentTypeRef=Ap_AbsHwPos
      Ap_ActivePull: ComponentTypeRef=Ap_ActivePull
      Ap_ApXcp: ComponentTypeRef=Ap_ApXcp
      Ap_Assist: ComponentTypeRef=Ap_Assist
      Ap_AssistFirewall: ComponentTypeRef=Ap_AssistFirewall
      Ap_AstLmt: ComponentTypeRef=Ap_AstLmt
      Ap_AvgFricLrn: ComponentTypeRef=Ap_AvgFricLrn
      Ap_BVDiag: ComponentTypeRef=Ap_BVDiag
      Ap_BatteryVoltage: ComponentTypeRef=Ap_BatteryVoltage
      Ap_ChkPtAp10: ComponentTypeRef=Ap_ChkPtAp10
      Ap_ChkPtAp8: ComponentTypeRef=Ap_ChkPtAp8
      Ap_ChkPtAp9: ComponentTypeRef=Ap_ChkPtAp9
      Ap_ComplErr: ComponentTypeRef=Ap_ComplErr
      Ap_CtrldDisShtdn: ComponentTypeRef=Ap_CtrldDisShtdn
      Ap_CurrCmd: ComponentTypeRef=Ap_CurrCmd
      Ap_CurrParamComp: ComponentTypeRef=Ap_CurrParamComp
      Ap_Damping: ComponentTypeRef=Ap_Damping
      Ap_DampingFirewall: ComponentTypeRef=Ap_DampingFirewall
      Ap_DemIf: ComponentTypeRef=Ap_DemIf
      Ap_DiagMgr10: ComponentTypeRef=Ap_DiagMgr10
      Ap_DiagMgr8: ComponentTypeRef=Ap_DiagMgr8
      Ap_DiagMgr9: ComponentTypeRef=Ap_DiagMgr9
      Ap_DiagSvc: ComponentTypeRef=Ap_DiagSvc
      Ap_DigPhsReasDiag: ComponentTypeRef=Ap_DigPhsReasDiag
      Ap_EOTActuatorMng: ComponentTypeRef=Ap_EOTActuatorMng
      Ap_ElePwr: ComponentTypeRef=Ap_ElePwr
      Ap_EtDmpFw: ComponentTypeRef=Ap_EtDmpFw
      Ap_FltInjection: ComponentTypeRef=Ap_FltInjection
      Ap_FrqDepDmpnInrtCmp: ComponentTypeRef=Ap_FrqDepDmpnInrtCmp
      Ap_Gsod: ComponentTypeRef=Ap_Gsod
      Ap_HiLoadStall: ComponentTypeRef=Ap_HiLoadStall
      Ap_HighFreqAssist: ComponentTypeRef=Ap_HighFreqAssist
      Ap_HwPwUp: ComponentTypeRef=Ap_HwPwUp
      Ap_HystComp: ComponentTypeRef=Ap_HystComp
      Ap_LmtCod: ComponentTypeRef=Ap_LmtCod
      Ap_LrnEOT: ComponentTypeRef=Ap_LrnEOT
      Ap_MtrTempEst: ComponentTypeRef=Ap_MtrTempEst
      NtWrap: ComponentTypeRef=NtWrap
      Ap_PICurrCntrl: ComponentTypeRef=Ap_PICurrCntrl
      Ap_PeakCurrEst: ComponentTypeRef=Ap_PeakCurrEst
      Ap_Polarity: ComponentTypeRef=Ap_Polarity
      Ap_PwrLmtFuncCr: ComponentTypeRef=Ap_PwrLmtFuncCr
      Ap_QuadDet: ComponentTypeRef=Ap_QuadDet
      Ap_Return: ComponentTypeRef=Ap_Return
      Ap_ReturnFirewall: ComponentTypeRef=Ap_ReturnFirewall
      RteErrata10: ComponentTypeRef=RteErrata10
      RteErrata8: ComponentTypeRef=RteErrata8
      RteErrata9: ComponentTypeRef=RteErrata9
      Ap_SignlCondn: ComponentTypeRef=Ap_SignlCondn
      Ap_SrlComInput: ComponentTypeRef=Ap_SrlComInput
      Ap_SrlComOutput: ComponentTypeRef=Ap_SrlComOutput
      Ap_StOpCtrl: ComponentTypeRef=Ap_StOpCtrl
      Ap_StaMd: ComponentTypeRef=Ap_StaMd
      Ap_StaMd8: ComponentTypeRef=Ap_StaMd8
      Ap_StaMd9: ComponentTypeRef=Ap_StaMd9
      Ap_StabilityComp: ComponentTypeRef=Ap_StabilityComp
      Ap_StabilityComp2: ComponentTypeRef=Ap_StabilityComp2
      Ap_Sweep: ComponentTypeRef=Ap_Sweep
      Ap_Sweep2: ComponentTypeRef=Ap_Sweep2
      Ap_ThrmlDutyCycle: ComponentTypeRef=Ap_ThrmlDutyCycle
      Ap_TqRsDg: ComponentTypeRef=Ap_TqRsDg
      Ap_TrqCanc: ComponentTypeRef=Ap_TrqCanc
      Ap_TrqCmdScl: ComponentTypeRef=Ap_TrqCmdScl
      Ap_TuningSelAuth: ComponentTypeRef=Ap_TuningSelAuth
      Ap_VehDyn: ComponentTypeRef=Ap_VehDyn
      Ap_VehPwrMd: ComponentTypeRef=Ap_VehPwrMd
      Ap_VehSpdLmt: ComponentTypeRef=Ap_VehSpdLmt
      Ap_ePWM2: ComponentTypeRef=Ap_ePWM2
    RteGeneration:
      RteCalibrationSupport = NONE
      RteGenerationMode = (unset)
      RteMeasurementSupport = true
      RteOptimizationMode = MEMORY
      RteVfbTrace = 0
      RteXcpEventSupport = false
      RteA2LVersion = V151
    94 x SwComponentInstance:
      AbsHwPos_Ap_AbsHwPos_ECU_Composition: ImplementationRef=Ap_AbsHwPos_Implementation, SoftwareComponentInstanceRef=AbsHwPos
        MAP_Rte_NvmBlock_AbsHwPos_EOLVehCntrOffset (NVRamAllocation): SwNvRamMappingReference=AbsHwPos.EOLVehCntrOffsetBlock, NvmBlockRef=Rte_NvmBlock_AbsHwPos_EOLVehCntrOffset
        5 x RunnableEntityMapping, all with ActivationOffset=0, RteCyclicTriggerImplementation=Auto:
          Task_2ms_10_15_Timer0: PositionInTask=15, RTEEventRef=TMT_AbsHwPos_Per2, MappedToTaskRef=Task_2ms_10
          Task_Init_10_22_Timer0: PositionInTask=22, RTEEventRef=AbsHwPos_Init1_InitEvent, MappedToTaskRef=Task_Init_10
          Task_2ms_10_13_Timer0: PositionInTask=13, RTEEventRef=TMT_AbsHwPos_Per1, MappedToTaskRef=Task_2ms_10
          Task_4ms_10_5_Timer0: PositionInTask=5, RTEEventRef=TMT_AbsHwPos_Per3, MappedToTaskRef=Task_4ms_10
          Task_10ms_10_3_Timer0: PositionInTask=3, RTEEventRef=TMT_AbsHwPos_Per4, MappedToTaskRef=Task_10ms_10
      ActivePull_Ap_ActivePull_ECU_Composition: ImplementationRef=Ap_ActivePull_Implementation, SoftwareComponentInstanceRef=ActivePull
        5 x RunnableEntityMapping, all with ActivationOffset=0, RteCyclicTriggerImplementation=Auto:
          Task_Init_9_7_Timer0: PositionInTask=7, RTEEventRef=ActivePull_Init1_InitEvent, MappedToTaskRef=Task_Init_9
          Task_100ms_9_3_Timer0: PositionInTask=3, RTEEventRef=TMT_ActivePull_Per3, MappedToTaskRef=Task_100ms_9
          Task_2ms_9_2_Timer0: PositionInTask=2, RTEEventRef=TMT_ActivePull_Per2, MappedToTaskRef=Task_2ms_9
          Task_2ms_9_1_Timer0: PositionInTask=1, RTEEventRef=TMT_ActivePull_Per1, MappedToTaskRef=Task_2ms_9
          Task_Trns_9_4_TrigModeSwitch0: PositionInTask=4, RTEEventRef=MST_ActivePull_Trns1_0, MappedToTaskRef=Task_Trns_9
      ApXcp_Ap_ApXcp_ECU_Composition: ImplementationRef=Ap_ApXcp_Implementation, SoftwareComponentInstanceRef=ApXcp
        Task_10ms_9_5_Timer0 (RunnableEntityMapping): ActivationOffset=0, PositionInTask=5, RteCyclicTriggerImplementation=Auto, RTEEventRef=TMT_ApXcp_Per1, MappedToTaskRef=Task_10ms_9
        Task_2ms_9_9_Timer0 (RunnableEntityMapping): ActivationOffset=0, PositionInTask=9, RteCyclicTriggerImplementation=Auto, RTEEventRef=TMT_DAQ_2msTL, MappedToTaskRef=Task_2ms_9
      Assist_Ap_Assist_ECU_Composition: ImplementationRef=Ap_Assist_Implementation, SoftwareComponentInstanceRef=Assist
        Task_2ms_10_21_Timer0 (RunnableEntityMapping): ActivationOffset=0, PositionInTask=21, RteCyclicTriggerImplementation=Auto, RTEEventRef=TMT_Assist_Per1, MappedToTaskRef=Task_2ms_10
      AssistFirewall_Ap_AssistFirewall_ECU_Composition: ImplementationRef=Ap_AssistFirewall_Implementation, SoftwareComponentInstanceRef=AssistFirewall
        Task_2ms_10_26_Timer0 (RunnableEntityMapping): ActivationOffset=0, PositionInTask=26, RteCyclicTriggerImplementation=Auto, RTEEventRef=TMT_AssistFirewall_Per1, MappedToTaskRef=Task_2ms_10
        Task_Init_10_27_Timer0 (RunnableEntityMapping): ActivationOffset=0, PositionInTask=27, RteCyclicTriggerImplementation=Auto, RTEEventRef=AssistFirewall_Init1_InitEvent, MappedToTaskRef=Task_Init_10
      AstLmt_Ap_AstLmt_ECU_Composition: ImplementationRef=Ap_AstLmt_Implementation, SoftwareComponentInstanceRef=AstLmt
        MAP_Rte_NvmBlock_AstLmt_SteerAsstDefeat (NVRamAllocation): SwNvRamMappingReference=AstLmt.SteeringAsstDefeat, NvmBlockRef=Rte_NvmBlock_AstLmt_SteerAsstDefeat
        Task_Init_10_28_Timer0 (RunnableEntityMapping): ActivationOffset=0, PositionInTask=28, RteCyclicTriggerImplementation=Auto, RTEEventRef=AstLmt_InitEvent, MappedToTaskRef=Task_Init_10
        Task_2ms_10_31_Timer0 (RunnableEntityMapping): ActivationOffset=0, PositionInTask=31, RteCyclicTriggerImplementation=Auto, RTEEventRef=TMT_AstLmt_Per1, MappedToTaskRef=Task_2ms_10
      AvgFricLrn_Ap_AvgFricLrn_ECU_Composition: ImplementationRef=Ap_AvgFricLrn_Implementation, SoftwareComponentInstanceRef=AvgFricLrn
        MAP_Rte_NvmBlock_AvgFricLrn_AvgFricLrnData (NVRamAllocation): SwNvRamMappingReference=AvgFricLrn.AvgFricLrnBlk, NvmBlockRef=Rte_NvmBlock_AvgFricLrn_AvgFricLrnData
        3 x RunnableEntityMapping, all with ActivationOffset=0, RteCyclicTriggerImplementation=Auto:
          Task_Init_9_6_Timer0: PositionInTask=6, RTEEventRef=AvgFricLrn_Init1_InitEvent, MappedToTaskRef=Task_Init_9
          Task_10ms_9_3_Timer0: PositionInTask=3, RTEEventRef=TMT_AvgFricLrn_Per1, MappedToTaskRef=Task_10ms_9
          Task_Trns_9_5_TrigModeSwitch0: PositionInTask=5, RTEEventRef=MST_AvgFricLrn_Trns1_0, MappedToTaskRef=Task_Trns_9
      BVDiag_Ap_BVDiag_ECU_Composition: ImplementationRef=Ap_BVDiag_Implementation, SoftwareComponentInstanceRef=BVDiag
        Task_10ms_9_6_Timer0 (RunnableEntityMapping): ActivationOffset=0, PositionInTask=6, RteCyclicTriggerImplementation=Auto, RTEEventRef=TMT_BVDiag_Per1, MappedToTaskRef=Task_10ms_9
      BatteryVoltage_Ap_BatteryVoltage_ECU_Composition: ImplementationRef=Ap_BatteryVoltage_Implementation, SoftwareComponentInstanceRef=BatteryVoltage
        MAP_Rte_NvmBlock_BatteryVoltage_OvervoltageData (NVRamAllocation): SwNvRamMappingReference=BatteryVoltage.OvervoltageBlock, NvmBlockRef=Rte_NvmBlock_BatteryVoltage_OvervoltageData
        3 x RunnableEntityMapping, all with ActivationOffset=0, RteCyclicTriggerImplementation=Auto:
          Task_4ms_10_4_Timer0: PositionInTask=4, RTEEventRef=TMT_BatteryVoltage_Per2, MappedToTaskRef=Task_4ms_10
          Task_2ms_10_17_Timer0: PositionInTask=17, RTEEventRef=TMT_BatteryVoltage_Per1, MappedToTaskRef=Task_2ms_10
          Task_Init_10_30_Timer0: PositionInTask=30, RTEEventRef=BatteryVoltage_Init1_InitEvent, MappedToTaskRef=Task_Init_10
      BkCpPc_Sa_BkCpPc_ECU_Composition: ImplementationRef=Sa_BkCpPc_Implementation, SoftwareComponentInstanceRef=BkCpPc
        3 x RunnableEntityMapping, all with ActivationOffset=0, RteCyclicTriggerImplementation=Auto:
          Task_Trns_9_3_TrigModeSwitch0: PositionInTask=3, RTEEventRef=MST_BkCpPc_Trns1_0, MappedToTaskRef=Task_Trns_9
          Task_Trns_9_2_TrigModeSwitch0: PositionInTask=2, RTEEventRef=MST_BkCpPc_Trns2_0, MappedToTaskRef=Task_Trns_9
          Task_2ms_9_6_Timer0: PositionInTask=6, RTEEventRef=TMT_BkCpPc_Per1, MappedToTaskRef=Task_2ms_9
      CDD_CDD_ECU_Composition: ImplementationRef=CDD_Implementation, ServiceComponentPrototypeRef=CDD
        Task_SchM_10ms_9_5_Timer0 (RunnableEntityMapping): ActivationOffset=0, PositionInTask=5, RteCyclicTriggerImplementation=Auto, RTEEventRef=TMT_Cdd_DummyFunction, MappedToTaskRef=Task_SchM_10ms_9
      CDDInterface_Sa_CDDInterface_ECU_Composition: ImplementationRef=Sa_CDDInterface_Implementation, SoftwareComponentInstanceRef=CDDInterface
        5 x RunnableEntityMapping, all with ActivationOffset=0, RteCyclicTriggerImplementation=Auto:
          Task_Init_10_32_Timer0: PositionInTask=32, RTEEventRef=CDDInterface_Init2_InitEvent, MappedToTaskRef=Task_Init_10
          Task_Init_10_0_Timer0: PositionInTask=0, RTEEventRef=CDDInterface_Init1_InitEvent, MappedToTaskRef=Task_Init_10
          Task_10ms_10_2_Timer0: PositionInTask=2, RTEEventRef=TMT_CDDInterface_Per4, MappedToTaskRef=Task_10ms_10
          Task_2ms_10_44_Timer0: PositionInTask=44, RTEEventRef=TMT_CDDInterface_Per2, MappedToTaskRef=Task_2ms_10
          Task_2ms_10_4_Timer0: PositionInTask=4, RTEEventRef=TMT_CDDInterface_Per1, MappedToTaskRef=Task_2ms_10
      ChkPtAp10_Ap_ChkPtAp10_ECU_Composition: ImplementationRef=Ap_ChkPtAp10_Implementation, SoftwareComponentInstanceRef=ChkPtAp10
        8 x RunnableEntityMapping, all with ActivationOffset=0, RteCyclicTriggerImplementation=Auto:
          Task_10ms_10_0_Timer0: PositionInTask=0, RTEEventRef=TMT_ChkPtAp10_10msStart_Per, MappedToTaskRef=Task_10ms_10
          Task_2ms_10_62_Timer0: PositionInTask=62, RTEEventRef=TMT_ChkPtAp10_2msEnd_Per, MappedToTaskRef=Task_2ms_10
          Task_4ms_10_0_Timer0: PositionInTask=0, RTEEventRef=TMT_ChkPtAp10_4msStart_Per, MappedToTaskRef=Task_4ms_10
          Task_10ms_10_10_Timer0: PositionInTask=10, RTEEventRef=TMT_ChkPtAp10_10msEnd_Per, MappedToTaskRef=Task_10ms_10
          Task_4ms_10_6_Timer0: PositionInTask=6, RTEEventRef=TMT_ChkPtAp10_4msEnd_Per, MappedToTaskRef=Task_4ms_10
          Task_2ms_10_0_Timer0: PositionInTask=0, RTEEventRef=TMT_ChkPtAp10_2msStart_Per, MappedToTaskRef=Task_2ms_10
          Task_100ms_10_9_Timer0: PositionInTask=9, RTEEventRef=TMT_ChkPtAp10_100msEnd_Per, MappedToTaskRef=Task_100ms_10
          Task_100ms_10_0_Timer0: PositionInTask=0, RTEEventRef=TMT_ChkPtAp10_100msStart_Per, MappedToTaskRef=Task_100ms_10
      ChkPtAp8_Ap_ChkPtAp8_ECU_Composition: ImplementationRef=Ap_ChkPtAp8_Implementation, SoftwareComponentInstanceRef=ChkPtAp8
        4 x RunnableEntityMapping, all with ActivationOffset=0, RteCyclicTriggerImplementation=Auto:
          Task_2ms_8_5_Timer0: PositionInTask=5, RTEEventRef=TMT_ChkPtAp8_2msEnd_Per, MappedToTaskRef=Task_2ms_8
          Task_2ms_8_0_Timer0: PositionInTask=0, RTEEventRef=TMT_ChkPtAp8_2msStart_Per, MappedToTaskRef=Task_2ms_8
          Task_100ms_8_0_Timer0: PositionInTask=0, RTEEventRef=TMT_ChkPtAp8_100msStart_Per, MappedToTaskRef=Task_100ms_8
          Task_100ms_8_2_Timer0: PositionInTask=2, RTEEventRef=TMT_ChkPtAp8_100msEnd_Per, MappedToTaskRef=Task_100ms_8
      ChkPtAp9_Ap_ChkPtAp9_ECU_Composition: ImplementationRef=Ap_ChkPtAp9_Implementation, SoftwareComponentInstanceRef=ChkPtAp9
        8 x RunnableEntityMapping, all with ActivationOffset=0, RteCyclicTriggerImplementation=Auto:
          Task_2ms_9_0_Timer0: PositionInTask=0, RTEEventRef=TMT_ChkPtAp9_2msStart_Per, MappedToTaskRef=Task_2ms_9
          Task_4ms_9_1_Timer0: PositionInTask=1, RTEEventRef=TMT_ChkPtAp9_4msEnd_Per, MappedToTaskRef=Task_4ms_9
          Task_10ms_9_0_Timer0: PositionInTask=0, RTEEventRef=TMT_ChkPtAp9_10msStart_Per, MappedToTaskRef=Task_10ms_9
          Task_4ms_9_0_Timer0: PositionInTask=0, RTEEventRef=TMT_ChkPtAp9_4msStart_Per, MappedToTaskRef=Task_4ms_9
          Task_100ms_9_7_Timer0: PositionInTask=7, RTEEventRef=TMT_ChkPtAp9_100msEnd_Per, MappedToTaskRef=Task_100ms_9
          Task_100ms_9_0_Timer0: PositionInTask=0, RTEEventRef=TMT_ChkPtAp9_100msStart_Per, MappedToTaskRef=Task_100ms_9
          Task_10ms_9_9_Timer0: PositionInTask=9, RTEEventRef=TMT_ChkPtAp9_10msEnd_Per, MappedToTaskRef=Task_10ms_9
          Task_2ms_9_10_Timer0: PositionInTask=10, RTEEventRef=TMT_ChkPtAp9_2msEnd_Per, MappedToTaskRef=Task_2ms_9
      CmMtrCurr_Sa_CmMtrCurr_ECU_Composition: ImplementationRef=Sa_CmMtrCurr_Implementation, SoftwareComponentInstanceRef=CmMtrCurr
        MAP_Rte_NvmBlock_CmMtrCurr_CurrTempOffset (NVRamAllocation): SwNvRamMappingReference=CmMtrCurr.CurrTempOffsetBlk, NvmBlockRef=Rte_NvmBlock_CmMtrCurr_CurrTempOffset
        MAP_Rte_NvmBlock_CmMtrCurr_ShCurrCal (NVRamAllocation): SwNvRamMappingReference=CmMtrCurr.ShCurrCalBlk, NvmBlockRef=Rte_NvmBlock_CmMtrCurr_ShCurrCal
        4 x RunnableEntityMapping, all with ActivationOffset=0, RteCyclicTriggerImplementation=Auto:
          Task_2ms_10_37_Timer0: PositionInTask=37, RTEEventRef=TMT_CmMtrCurr_Per3, MappedToTaskRef=Task_2ms_10
          Task_2ms_10_36_Timer0: PositionInTask=36, RTEEventRef=TMT_CmMtrCurr_Per2, MappedToTaskRef=Task_2ms_10
          Task_100ms_10_4_Timer0: PositionInTask=4, RTEEventRef=TMT_CmMtrCurr_Per1, MappedToTaskRef=Task_100ms_10
          Task_Init_10_8_Timer0: PositionInTask=8, RTEEventRef=CmMtrCurr_InitEvent, MappedToTaskRef=Task_Init_10
      ComM_ComM_ECU_Composition: ImplementationRef=ComM_Implementation, ServiceComponentPrototypeRef=ComM
        Task_SchM_10ms_9_1_Timer0 (RunnableEntityMapping): ActivationOffset=0, PositionInTask=1, RteCyclicTriggerImplementation=Auto, RTEEventRef=TMT_ComM_MainFunction_0, MappedToTaskRef=Task_SchM_10ms_9
      ComplErr_Ap_ComplErr_ECU_Composition: ImplementationRef=Ap_ComplErr_Implementation, SoftwareComponentInstanceRef=ComplErr
        Task_2ms_10_12_Timer0 (RunnableEntityMapping): ActivationOffset=0, PositionInTask=12, RteCyclicTriggerImplementation=Auto, RTEEventRef=TMT_ComplErr_Per1, MappedToTaskRef=Task_2ms_10
      CtrlTemp_Sa_CtrlTemp_ECU_Composition: ImplementationRef=Sa_CtrlTemp_Implementation, SoftwareComponentInstanceRef=CtrlTemp
        3 x RunnableEntityMapping, all with ActivationOffset=0, RteCyclicTriggerImplementation=Auto:
          Task_100ms_9_1_Timer0: PositionInTask=1, RTEEventRef=TMT_CtrlTemp_Per2, MappedToTaskRef=Task_100ms_9
          Task_Init_9_2_Timer0: PositionInTask=2, RTEEventRef=CtrlTemp_Init1_InitEvent, MappedToTaskRef=Task_Init_9
          Task_2ms_9_4_Timer0: PositionInTask=4, RTEEventRef=TMT_CtrlTemp_Per1, MappedToTaskRef=Task_2ms_9
      CtrldDisShtdn_Ap_CtrldDisShtdn_ECU_Composition: ImplementationRef=Ap_CtrldDisShtdn_Implementation, SoftwareComponentInstanceRef=CtrldDisShtdn
        Task_2ms_10_33_Timer0 (RunnableEntityMapping): ActivationOffset=0, PositionInTask=33, RteCyclicTriggerImplementation=Auto, RTEEventRef=TMT_CtrldDisShtdn_Per1, MappedToTaskRef=Task_2ms_10
      CurrCmd_Ap_CurrCmd_ECU_Composition: ImplementationRef=Ap_CurrCmd_Implementation, SoftwareComponentInstanceRef=CurrCmd
        Task_2ms_10_40_Timer0 (RunnableEntityMapping): ActivationOffset=0, PositionInTask=40, RteCyclicTriggerImplementation=Auto, RTEEventRef=TMT_CurrCmd_Per1, MappedToTaskRef=Task_2ms_10
        Task_Init_10_9_Timer0 (RunnableEntityMapping): ActivationOffset=0, PositionInTask=9, RteCyclicTriggerImplementation=Auto, RTEEventRef=CurrCmd_InitEvent, MappedToTaskRef=Task_Init_10
      CurrParamComp_Ap_CurrParamComp_ECU_Composition: ImplementationRef=Ap_CurrParamComp_Implementation, SoftwareComponentInstanceRef=CurrParamComp
        MAP_Rte_NvmBlock_CurrParamComp_EOLNomMtrParam (NVRamAllocation): SwNvRamMappingReference=CurrParamComp.EOLNomMtrParamBlk, NvmBlockRef=Rte_NvmBlock_CurrParamComp_EOLNomMtrParam
        3 x RunnableEntityMapping, all with ActivationOffset=0, RteCyclicTriggerImplementation=Auto:
          Task_100ms_10_2_Timer0: PositionInTask=2, RTEEventRef=TMT_CurrParamComp_Per2, MappedToTaskRef=Task_100ms_10
          Task_2ms_10_43_Timer0: PositionInTask=43, RTEEventRef=TMT_CurrParamComp_Per1, MappedToTaskRef=Task_2ms_10
          Task_Init_10_10_Timer0: PositionInTask=10, RTEEventRef=CurrParamComp_InitEvent, MappedToTaskRef=Task_Init_10
      Damping_Ap_Damping_ECU_Composition: ImplementationRef=Ap_Damping_Implementation, SoftwareComponentInstanceRef=Damping
        Task_2ms_10_24_Timer0 (RunnableEntityMapping): ActivationOffset=0, PositionInTask=24, RteCyclicTriggerImplementation=Auto, RTEEventRef=TMT_Damping_Per1, MappedToTaskRef=Task_2ms_10
        Task_Init_10_15_Timer0 (RunnableEntityMapping): ActivationOffset=0, PositionInTask=15, RteCyclicTriggerImplementation=Auto, RTEEventRef=Damping_Init1_InitEvent, MappedToTaskRef=Task_Init_10
      DampingFirewall_Ap_DampingFirewall_ECU_Composition: ImplementationRef=Ap_DampingFirewall_Implementation, SoftwareComponentInstanceRef=DampingFirewall
        Task_Init_10_17_Timer0 (RunnableEntityMapping):
          ActivationOffset = 0
          PositionInTask = 17
          RteCyclicTriggerImplementation = Auto
          RTEEventRef = DampingFirewall_Init1_InitEvent
          MappedToTaskRef = Task_Init_10
        Task_2ms_10_28_Timer0 (RunnableEntityMapping): ActivationOffset=0, PositionInTask=28, RteCyclicTriggerImplementation=Auto, RTEEventRef=TMT_DampingFirewall_Per1, MappedToTaskRef=Task_2ms_10
      Dcm_Dcm_ECU_Composition: ImplementationRef=Dcm_Implementation, ServiceComponentPrototypeRef=Dcm
        Task_SchM_10ms_9_0_Timer0 (RunnableEntityMapping): ActivationOffset=0, PositionInTask=0, RteCyclicTriggerImplementation=Auto, RTEEventRef=TMT_Dcm_MainFunction, MappedToTaskRef=Task_SchM_10ms_9
      DemIf_Ap_DemIf_ECU_Composition: ImplementationRef=Ap_DemIf_Implementation, SoftwareComponentInstanceRef=DemIf
        Task_SchM_10ms_9_4_Timer0 (RunnableEntityMapping): ActivationOffset=0, PositionInTask=4, RteCyclicTriggerImplementation=Auto, RTEEventRef=TMT_DemIf_DummyFunction, MappedToTaskRef=Task_SchM_10ms_9
      DiagMgr10_Ap_DiagMgr10_ECU_Composition: ImplementationRef=Ap_DiagMgr10_Implementation, SoftwareComponentInstanceRef=DiagMgr10
        4 x RunnableEntityMapping, all with ActivationOffset=0, RteCyclicTriggerImplementation=Auto:
          Task_Init_10_1_Timer0: PositionInTask=1, RTEEventRef=DiagMgr10_InitEvent, MappedToTaskRef=Task_Init_10
          Task_2ms_10_60_Timer0: PositionInTask=60, RTEEventRef=TMT_DiagMgr_Per1, MappedToTaskRef=Task_2ms_10
          Task_100ms_10_8_Timer0: PositionInTask=8, RTEEventRef=TMT_DiagMgr10_Per, MappedToTaskRef=Task_100ms_10
          Task_Trns_10_0_TrigModeSwitch0: PositionInTask=0, RTEEventRef=MST_DiagMgr10_Trns_0, MappedToTaskRef=Task_Trns_10
      DiagMgr8_Ap_DiagMgr8_ECU_Composition: ImplementationRef=Ap_DiagMgr8_Implementation, SoftwareComponentInstanceRef=DiagMgr8
        3 x RunnableEntityMapping, all with ActivationOffset=0, RteCyclicTriggerImplementation=Auto:
          Task_Trns_8_0_TrigModeSwitch0: PositionInTask=0, RTEEventRef=MST_DiagMgr8_Trns_0, MappedToTaskRef=Task_Trns_8
          Task_Init_8_0_Timer0: PositionInTask=0, RTEEventRef=DiagMgr8_InitEvent, MappedToTaskRef=Task_Init_8
          Task_100ms_8_1_Timer0: PositionInTask=1, RTEEventRef=TMT_DiagMgr8_Per, MappedToTaskRef=Task_100ms_8
      DiagMgr9_Ap_DiagMgr9_ECU_Composition: ImplementationRef=Ap_DiagMgr9_Implementation, SoftwareComponentInstanceRef=DiagMgr9
        6 x RunnableEntityMapping, all with ActivationOffset=0, RteCyclicTriggerImplementation=Auto:
          Task_100ms_9_6_Timer0: PositionInTask=6, RTEEventRef=TMT_DiagMgr_Per2, MappedToTaskRef=Task_100ms_9
          Task_Trns_9_0_TrigModeSwitch0: PositionInTask=0, RTEEventRef=MST_DiagMgr9_Trns_0, MappedToTaskRef=Task_Trns_9
          Task_Trns_9_1_TrigModeSwitch0: PositionInTask=1, RTEEventRef=MST_DiagMgr_Trns1_0, MappedToTaskRef=Task_Trns_9
          Task_Init_9_0_Timer0: PositionInTask=0, RTEEventRef=DiagMgr9_InitEvent, MappedToTaskRef=Task_Init_9
          Task_100ms_9_5_Timer0: PositionInTask=5, RTEEventRef=TMT_DiagMgr9_Per, MappedToTaskRef=Task_100ms_9
          Task_Init_9_1_Timer0: PositionInTask=1, RTEEventRef=DiagMgr_Init1_InitEvent, MappedToTaskRef=Task_Init_9
      DiagSvc_Ap_DiagSvc_ECU_Composition: ImplementationRef=Ap_DiagSvc_Implementation, SoftwareComponentInstanceRef=DiagSvc
        19 x NVRamAllocation:
          MAP_Rte_NvmBlock_DiagSvc_FirstDTCDetectMins: SwNvRamMappingReference=DiagSvc.FirstDTCDetectMins, NvmBlockRef=Rte_NvmBlock_DiagSvc_FirstDTCDetectMins
          MAP_Rte_NvmBlock_DiagSvc_EraseRoutineStatus: SwNvRamMappingReference=DiagSvc.EraseRoutineStatus, NvmBlockRef=Rte_NvmBlock_DiagSvc_EraseRoutineStatus
          MAP_Rte_NvmBlock_DiagSvc_TotalOdometer: SwNvRamMappingReference=DiagSvc.TotalOdometer, NvmBlockRef=Rte_NvmBlock_DiagSvc_TotalOdometer
          MAP_Rte_NvmBlock_DiagSvc_VINOriginal: SwNvRamMappingReference=DiagSvc.VINOriginal, NvmBlockRef=Rte_NvmBlock_DiagSvc_VINOriginal
          MAP_Rte_NvmBlock_DiagSvc_VINCurrent: SwNvRamMappingReference=DiagSvc.VINCurrent, NvmBlockRef=Rte_NvmBlock_DiagSvc_VINCurrent
          MAP_Rte_NvmBlock_DiagSvc_OdometerFlashProg: SwNvRamMappingReference=DiagSvc.OdometerFlashProg, NvmBlockRef=Rte_NvmBlock_DiagSvc_OdometerFlashProg
          MAP_Rte_NvmBlock_DiagSvc_ECUSerialNumber: SwNvRamMappingReference=DiagSvc.ECUSerialNumber, NvmBlockRef=Rte_NvmBlock_DiagSvc_ECUSerialNumber
          MAP_Rte_NvmBlock_DiagSvc_ECUSparePartNo: SwNvRamMappingReference=DiagSvc.ECUSparePartNo, NvmBlockRef=Rte_NvmBlock_DiagSvc_ECUSparePartNo
          MAP_Rte_NvmBlock_DiagSvc_CalSwFingerPrint: SwNvRamMappingReference=DiagSvc.CalSwFingerPrint, NvmBlockRef=Rte_NvmBlock_DiagSvc_CalSwFingerPrint
          MAP_Rte_NvmBlock_DiagSvc_ProxiCounter: SwNvRamMappingReference=DiagSvc.ProxiCounter, NvmBlockRef=Rte_NvmBlock_DiagSvc_ProxiCounter
          MAP_Rte_NvmBlock_DiagSvc_FirstDTCDetectSecs: SwNvRamMappingReference=DiagSvc.FirstDTCDetectSecs, NvmBlockRef=Rte_NvmBlock_DiagSvc_FirstDTCDetectSecs
          MAP_Rte_NvmBlock_DiagSvc_TuningSetSelectData: SwNvRamMappingReference=DiagSvc.TuningSetSelect, NvmBlockRef=Rte_NvmBlock_DiagSvc_TuningSetSelectData
          MAP_Rte_NvmBlock_DiagSvc_ProgAttemptsCounter: SwNvRamMappingReference=DiagSvc.ProgrammingAttemptCounter, NvmBlockRef=Rte_NvmBlock_DiagSvc_ProgAttemptsCounter
          MAP_Rte_NvmBlock_DiagSvc_ECULifeTimeMins: SwNvRamMappingReference=DiagSvc.ECULifeTimeMins, NvmBlockRef=Rte_NvmBlock_DiagSvc_ECULifeTimeMins
          MAP_Rte_NvmBlock_DiagSvc_ProgrammingStatus: SwNvRamMappingReference=DiagSvc.ProgrammingStatus, NvmBlockRef=Rte_NvmBlock_DiagSvc_ProgrammingStatus
          MAP_Rte_NvmBlock_DiagSvc_ProxiConfigurationData: SwNvRamMappingReference=DiagSvc.ProxiConfiguration, NvmBlockRef=Rte_NvmBlock_DiagSvc_ProxiConfigurationData
          MAP_Rte_NvmBlock_DiagSvc_BootSwFingerPrint: SwNvRamMappingReference=DiagSvc.BootSwFingerPrint, NvmBlockRef=Rte_NvmBlock_DiagSvc_BootSwFingerPrint
          MAP_Rte_NvmBlock_DiagSvc_EOLConfigData: SwNvRamMappingReference=DiagSvc.EOLConfiguration, NvmBlockRef=Rte_NvmBlock_DiagSvc_EOLConfigData
          MAP_Rte_NvmBlock_DiagSvc_AppSwFingerPrint: SwNvRamMappingReference=DiagSvc.AppSwFingerPrint, NvmBlockRef=Rte_NvmBlock_DiagSvc_AppSwFingerPrint
        3 x RunnableEntityMapping, all with ActivationOffset=0, RteCyclicTriggerImplementation=Auto:
          Task_Trns_9_6_TrigModeSwitch0: PositionInTask=6, RTEEventRef=MST_DiagSvc_Trns1_0, MappedToTaskRef=Task_Trns_9
          Task_10ms_9_8_Timer0: PositionInTask=8, RTEEventRef=TMT_DiagSvc_Per1, MappedToTaskRef=Task_10ms_9
          Task_Init_9_9_Timer0: PositionInTask=9, RTEEventRef=DiagSvc_Init1_InitEvent, MappedToTaskRef=Task_Init_9
      DigHwTrqSENT_Sa_DigHwTrqSENT_ECU_Composition: ImplementationRef=Sa_DigHwTrqSENT_Implementation, SoftwareComponentInstanceRef=DigHwTrqSENT
        MAP_Rte_NvmBlock_DigHwTrqSENT_DigTrqTrim (NVRamAllocation): SwNvRamMappingReference=DigHwTrqSENT.DigHwTrqSENTTrim, NvmBlockRef=Rte_NvmBlock_DigHwTrqSENT_DigTrqTrim
        4 x RunnableEntityMapping, all with ActivationOffset=0, RteCyclicTriggerImplementation=Auto:
          Task_4ms_10_3_Timer0: PositionInTask=3, RTEEventRef=TMT_DigHwTrqSENT_Per2, MappedToTaskRef=Task_4ms_10
          Task_Init_10_20_Timer0: PositionInTask=20, RTEEventRef=DigHwTrqSENT_Init1_InitEvent, MappedToTaskRef=Task_Init_10
          Task_2ms_10_8_Timer0: PositionInTask=8, RTEEventRef=TMT_DigHwTrqSENT_Per1, MappedToTaskRef=Task_2ms_10
          Task_100ms_10_5_Timer0: PositionInTask=5, RTEEventRef=TMT_DigHwTrqSENT_Per3, MappedToTaskRef=Task_100ms_10
      DigMSB_Sa_DigMSB_ECU_Composition: ImplementationRef=Sa_DigMSB_Implementation, SoftwareComponentInstanceRef=DigMSB
        MAP_Rte_NvmBlock_DigMSB_DigMSBEOLData (NVRamAllocation): SwNvRamMappingReference=DigMSB.DigMSBEOLBlk, NvmBlockRef=Rte_NvmBlock_DigMSB_DigMSBEOLData
        3 x RunnableEntityMapping, all with ActivationOffset=0, RteCyclicTriggerImplementation=Auto:
          Task_2ms_10_6_Timer0: PositionInTask=6, RTEEventRef=TMT_DigMSB_Per2, MappedToTaskRef=Task_2ms_10
          Task_100ms_10_1_Timer0: PositionInTask=1, RTEEventRef=TMT_DigMSB_Per3, MappedToTaskRef=Task_100ms_10
          Task_Init_10_23_Timer0: PositionInTask=23, RTEEventRef=DigMSB_InitEvent, MappedToTaskRef=Task_Init_10
      DigPhsReasDiag_Ap_DigPhsReasDiag_ECU_Composition: ImplementationRef=Ap_DigPhsReasDiag_Implementation, SoftwareComponentInstanceRef=DigPhsReasDiag
        3 x RunnableEntityMapping, all with ActivationOffset=0, RteCyclicTriggerImplementation=Auto:
          Task_Trns_10_9_TrigModeSwitch0: PositionInTask=9, RTEEventRef=MST_DigPhsReasDiag_Trans1_0, MappedToTaskRef=Task_Trns_10
          Task_2ms_10_53_Timer0: PositionInTask=53, RTEEventRef=TMT_DigPhsReasDiag_Per1, MappedToTaskRef=Task_2ms_10
          Task_Init_10_7_Timer0: PositionInTask=7, RTEEventRef=DigPhsReasDiag_InitEvent, MappedToTaskRef=Task_Init_10
      EOTActuatorMng_Ap_EOTActuatorMng_ECU_Composition: ImplementationRef=Ap_EOTActuatorMng_Implementation, SoftwareComponentInstanceRef=EOTActuatorMng
        Task_2ms_10_20_Timer0 (RunnableEntityMapping): ActivationOffset=0, PositionInTask=20, RteCyclicTriggerImplementation=Auto, RTEEventRef=TMT_EOTActuatorMng_Per1, MappedToTaskRef=Task_2ms_10
      ElePwr_Ap_ElePwr_ECU_Composition: ImplementationRef=Ap_ElePwr_Implementation, SoftwareComponentInstanceRef=ElePwr
        Task_10ms_9_7_Timer0 (RunnableEntityMapping): ActivationOffset=0, PositionInTask=7, RteCyclicTriggerImplementation=Auto, RTEEventRef=TMT_ElePwr_Per1, MappedToTaskRef=Task_10ms_9
      EtDmpFw_Ap_EtDmpFw_ECU_Composition: ImplementationRef=Ap_EtDmpFw_Implementation, SoftwareComponentInstanceRef=EtDmpFw
        Task_2ms_10_55_Timer0 (RunnableEntityMapping): ActivationOffset=0, PositionInTask=55, RteCyclicTriggerImplementation=Auto, RTEEventRef=TMT_EtDmpFw_Per1, MappedToTaskRef=Task_2ms_10
      FltInjection_Ap_FltInjection_ECU_Composition: ImplementationRef=Ap_FltInjection_Implementation, SoftwareComponentInstanceRef=FltInjection
        Task_2ms_10_59_Timer0 (RunnableEntityMapping): ActivationOffset=0, PositionInTask=59, RteCyclicTriggerImplementation=Auto, RTEEventRef=TMT_FltInjection_Per1, MappedToTaskRef=Task_2ms_10
      FrqDepDmpnInrtCmp_Ap_FrqDepDmpnInrtCmp_ECU_Composition: ImplementationRef=Ap_FrqDepDmpnInrtCmp_Implementation, SoftwareComponentInstanceRef=FrqDepDmpnInrtCmp
        Task_Init_10_14_Timer0 (RunnableEntityMapping): ActivationOffset=0, PositionInTask=14, RteCyclicTriggerImplementation=Auto, RTEEventRef=FrqDepDmpnInrtCmp_InitEvent, MappedToTaskRef=Task_Init_10
        Task_2ms_10_25_Timer0 (RunnableEntityMapping): ActivationOffset=0, PositionInTask=25, RteCyclicTriggerImplementation=Auto, RTEEventRef=TMT_FrqDepDmpnInrtCmp_Per1, MappedToTaskRef=Task_2ms_10
      Gsod_Ap_Gsod_ECU_Composition: ImplementationRef=Ap_Gsod_Implementation, SoftwareComponentInstanceRef=Gsod
        Task_2ms_10_58_Timer0 (RunnableEntityMapping): ActivationOffset=0, PositionInTask=58, RteCyclicTriggerImplementation=Auto, RTEEventRef=TMT_Gsod_Per1, MappedToTaskRef=Task_2ms_10
      HiLoadStall_Ap_HiLoadStall_ECU_Composition: ImplementationRef=Ap_HiLoadStall_Implementation, SoftwareComponentInstanceRef=HiLoadStall
        Task_2ms_9_5_Timer0 (RunnableEntityMapping): ActivationOffset=0, PositionInTask=5, RteCyclicTriggerImplementation=Auto, RTEEventRef=TMT_HiLoadStall_Per1, MappedToTaskRef=Task_2ms_9
      HighFreqAssist_Ap_HighFreqAssist_ECU_Composition: ImplementationRef=Ap_HighFreqAssist_Implementation, SoftwareComponentInstanceRef=HighFreqAssist
        Task_2ms_10_23_Timer0 (RunnableEntityMapping): ActivationOffset=0, PositionInTask=23, RteCyclicTriggerImplementation=Auto, RTEEventRef=TMT_HighFreqAssist_Per1, MappedToTaskRef=Task_2ms_10
      HwPwUp_Ap_HwPwUp_ECU_Composition: ImplementationRef=Ap_HwPwUp_Implementation, SoftwareComponentInstanceRef=HwPwUp
        4 x RunnableEntityMapping, all with ActivationOffset=0, RteCyclicTriggerImplementation=Auto:
          Task_Trns_10_2_TrigModeSwitch1: PositionInTask=2, RTEEventRef=MST_HwPwUp_Trns1_1, MappedToTaskRef=Task_Trns_10
          Task_Trns_10_2_TrigModeSwitch0: PositionInTask=2, RTEEventRef=MST_HwPwUp_Trns1_0, MappedToTaskRef=Task_Trns_10
          Task_2ms_10_48_Timer0: PositionInTask=48, RTEEventRef=TMT_HwPwUp_Per1, MappedToTaskRef=Task_2ms_10
          Task_Trns_10_6_TrigModeSwitch0: PositionInTask=6, RTEEventRef=MST_HwPwUp_Trns2_0, MappedToTaskRef=Task_Trns_10
      HystComp_Ap_HystComp_ECU_Composition: ImplementationRef=Ap_HystComp_Implementation, SoftwareComponentInstanceRef=HystComp
        Task_2ms_10_22_Timer0 (RunnableEntityMapping): ActivationOffset=0, PositionInTask=22, RteCyclicTriggerImplementation=Auto, RTEEventRef=TMT_HystComp_Per1, MappedToTaskRef=Task_2ms_10
        Task_Init_10_13_Timer0 (RunnableEntityMapping): ActivationOffset=0, PositionInTask=13, RteCyclicTriggerImplementation=Auto, RTEEventRef=HystComp_Init1_InitEvent, MappedToTaskRef=Task_Init_10
      IoHwAbsDigSig_IoHwAbstraction_ECU_Composition: ImplementationRef=IoHwAbstraction_Implementation, SoftwareComponentInstanceRef=IoHwAbsDigSig
        Task_SchM_10ms_9_2_Timer0 (RunnableEntityMapping): ActivationOffset=0, PositionInTask=2, RteCyclicTriggerImplementation=Auto, RTEEventRef=TMT_IoHwAb_Dummy, MappedToTaskRef=Task_SchM_10ms_9
      IoHwAbstractionUsr_IoHwAbstractionUsr_ECU_Composition: ImplementationRef=IoHwAbstractionUsr_Implementation, SoftwareComponentInstanceRef=IoHwAbstractionUsr
        3 x RunnableEntityMapping, all with ActivationOffset=0, RteCyclicTriggerImplementation=Auto:
          Task_2ms_10_3_Timer0: PositionInTask=3, RTEEventRef=TMT_IoHwAb_StartAdc, MappedToTaskRef=Task_2ms_10
          Task_Init_10_5_Timer0: PositionInTask=5, RTEEventRef=IoHwAb_InitEvent, MappedToTaskRef=Task_Init_10
          Task_2ms_10_16_Timer0: PositionInTask=16, RTEEventRef=TMT_IoHwAb_ReadAdc, MappedToTaskRef=Task_2ms_10
      LmtCod_Ap_LmtCod_ECU_Composition: ImplementationRef=Ap_LmtCod_Implementation, SoftwareComponentInstanceRef=LmtCod
        Task_2ms_10_30_Timer0 (RunnableEntityMapping): ActivationOffset=0, PositionInTask=30, RteCyclicTriggerImplementation=Auto, RTEEventRef=TMT_LmtCod_Per1, MappedToTaskRef=Task_2ms_10
      LrnEOT_Ap_LrnEOT_ECU_Composition: ImplementationRef=Ap_LrnEOT_Implementation, SoftwareComponentInstanceRef=LrnEOT
        MAP_Rte_NvmBlock_LrnEOT_LearnedEOT (NVRamAllocation): SwNvRamMappingReference=LrnEOT.EOTLearnedBlk, NvmBlockRef=Rte_NvmBlock_LrnEOT_LearnedEOT
        Task_Init_9_8_Timer0 (RunnableEntityMapping): ActivationOffset=0, PositionInTask=8, RteCyclicTriggerImplementation=Auto, RTEEventRef=LrnEOT_Init1_InitEvent, MappedToTaskRef=Task_Init_9
        Task_10ms_9_4_Timer0 (RunnableEntityMapping): ActivationOffset=0, PositionInTask=4, RteCyclicTriggerImplementation=Auto, RTEEventRef=TMT_LrnEOT_Per1, MappedToTaskRef=Task_10ms_9
      MtrDrvDiag_Sa_MtrDrvDiag_ECU_Composition: ImplementationRef=Sa_MtrDrvDiag_Implementation, SoftwareComponentInstanceRef=MtrDrvDiag
        3 x RunnableEntityMapping, all with ActivationOffset=0, RteCyclicTriggerImplementation=Auto:
          Task_2ms_10_50_Timer0: PositionInTask=50, RTEEventRef=TMT_MtrDrvDiag_Per2, MappedToTaskRef=Task_2ms_10
          Task_Trns_10_4_TrigModeSwitch0: PositionInTask=4, RTEEventRef=MST_MtrDrvDiag_Trns1_0, MappedToTaskRef=Task_Trns_10
          Task_2ms_10_49_Timer0: PositionInTask=49, RTEEventRef=TMT_MtrDrvDiag_Per1, MappedToTaskRef=Task_2ms_10
      MtrTempEst_Ap_MtrTempEst_ECU_Composition: ImplementationRef=Ap_MtrTempEst_Implementation, SoftwareComponentInstanceRef=MtrTempEst
        Task_Init_9_3_Timer0 (RunnableEntityMapping): ActivationOffset=0, PositionInTask=3, RteCyclicTriggerImplementation=Auto, RTEEventRef=MtrTempEst_Init1_InitEvent, MappedToTaskRef=Task_Init_9
        Task_100ms_9_2_Timer0 (RunnableEntityMapping): ActivationOffset=0, PositionInTask=2, RteCyclicTriggerImplementation=Auto, RTEEventRef=TMT_MtrTempEst_Per1, MappedToTaskRef=Task_100ms_9
      MtrVel_Sa_MtrVel_ECU_Composition: ImplementationRef=Sa_MtrVel_Implementation, SoftwareComponentInstanceRef=MtrVel
        3 x RunnableEntityMapping, all with ActivationOffset=0, RteCyclicTriggerImplementation=Auto:
          Task_2ms_10_10_Timer0: PositionInTask=10, RTEEventRef=TMT_MtrVel_Per2, MappedToTaskRef=Task_2ms_10
          Task_2ms_10_11_Timer0: PositionInTask=11, RTEEventRef=TMT_MtrVel_Per1, MappedToTaskRef=Task_2ms_10
          Task_Init_10_24_Timer0: PositionInTask=24, RTEEventRef=MtrVel_InitEvent, MappedToTaskRef=Task_Init_10
      MtrVel2_Sa_MtrVel2_ECU_Composition: ImplementationRef=Sa_MtrVel2_Implementation, SoftwareComponentInstanceRef=MtrVel2
        3 x RunnableEntityMapping, all with ActivationOffset=0, RteCyclicTriggerImplementation=Auto:
          Task_2ms_8_3_Timer0: PositionInTask=3, RTEEventRef=TMT_MtrVel2_Per2, MappedToTaskRef=Task_2ms_8
          Task_2ms_8_2_Timer0: PositionInTask=2, RTEEventRef=TMT_MtrVel2_Per1, MappedToTaskRef=Task_2ms_8
          Task_Init_8_2_Timer0: PositionInTask=2, RTEEventRef=MtrVel2_InitEvent, MappedToTaskRef=Task_Init_8
      MtrVel3_Sa_MtrVel3_ECU_Composition: ImplementationRef=Sa_MtrVel3_Implementation, SoftwareComponentInstanceRef=MtrVel3
        Task_Init_10_25_Timer0 (RunnableEntityMapping): ActivationOffset=0, PositionInTask=25, RteCyclicTriggerImplementation=Auto, RTEEventRef=MtrVel3_InitEvent, MappedToTaskRef=Task_Init_10
      NexteerLibs_NexteerLibs_ECU_Composition: ImplementationRef=NexteerLibs_Implementation, ServiceComponentPrototypeRef=NexteerLibs
        Task_2ms_10_1_Timer0 (RunnableEntityMapping): ActivationOffset=0, PositionInTask=1, RteCyclicTriggerImplementation=Auto, RTEEventRef=TMT_SystemTime_Per1, MappedToTaskRef=Task_2ms_10
      Nhet1_Cd_Nhet1_ECU_Composition: ImplementationRef=Cd_Nhet1_Implementation, SoftwareComponentInstanceRef=Nhet1
        Task_2ms_10_5_Timer0 (RunnableEntityMapping): ActivationOffset=0, PositionInTask=5, RteCyclicTriggerImplementation=Auto, RTEEventRef=TMT_Nhet1_Per1, MappedToTaskRef=Task_2ms_10
        Task_2ms_10_7_Timer0 (RunnableEntityMapping): ActivationOffset=0, PositionInTask=7, RteCyclicTriggerImplementation=Auto, RTEEventRef=TMT_Nhet1_Per2, MappedToTaskRef=Task_2ms_10
      NtWrap_NtWrap_ECU_Composition: ImplementationRef=NtWrap_Implementation, SoftwareComponentInstanceRef=NtWrap
        Task_100ms_10_7_Timer0 (RunnableEntityMapping): ActivationOffset=0, PositionInTask=7, RteCyclicTriggerImplementation=Auto, RTEEventRef=TMT_NtWrap_Per1, MappedToTaskRef=Task_100ms_10
      NvM_NvM_ECU_Composition: ImplementationRef=NvM_Implementation, ServiceComponentPrototypeRef=NvM
        Task_SchM_10ms_9_7_Timer0 (RunnableEntityMapping): ActivationOffset=0, PositionInTask=7, RteCyclicTriggerImplementation=Auto, RTEEventRef=TMT_NvM_MainFunction, MappedToTaskRef=Task_SchM_10ms_9
      NvMProxy_NvMProxy_ECU_Composition: ImplementationRef=NvMProxy_Implementation, ServiceComponentPrototypeRef=NvMProxy
        Task_SchM_10ms_9_6_Timer0 (RunnableEntityMapping): ActivationOffset=0, PositionInTask=6, RteCyclicTriggerImplementation=Auto, RTEEventRef=TMT_NvMProxy_MainFunction, MappedToTaskRef=Task_SchM_10ms_9
      OvrVoltMon_Sa_OvrVoltMon_ECU_Composition: ImplementationRef=Sa_OvrVoltMon_Implementation, SoftwareComponentInstanceRef=OvrVoltMon
        Task_2ms_10_57_Timer0 (RunnableEntityMapping): ActivationOffset=0, PositionInTask=57, RteCyclicTriggerImplementation=Auto, RTEEventRef=TMT_OvrVoltMon_Per1, MappedToTaskRef=Task_2ms_10
      PICurrCntrl_Ap_PICurrCntrl_ECU_Composition: ImplementationRef=Ap_PICurrCntrl_Implementation, SoftwareComponentInstanceRef=PICurrCntrl
        Task_2ms_10_42_Timer0 (RunnableEntityMapping): ActivationOffset=0, PositionInTask=42, RteCyclicTriggerImplementation=Auto, RTEEventRef=TMT_PICurrCntrl_Per2, MappedToTaskRef=Task_2ms_10
        Task_Init_10_11_Timer0 (RunnableEntityMapping): ActivationOffset=0, PositionInTask=11, RteCyclicTriggerImplementation=Auto, RTEEventRef=PICurrCntrl_InitEvent, MappedToTaskRef=Task_Init_10
      PeakCurrEst_Ap_PeakCurrEst_ECU_Composition: ImplementationRef=Ap_PeakCurrEst_Implementation, SoftwareComponentInstanceRef=PeakCurrEst
        Task_100ms_10_3_Timer0 (RunnableEntityMapping): ActivationOffset=0, PositionInTask=3, RteCyclicTriggerImplementation=Auto, RTEEventRef=TMT_PeakCurrEst_Per2, MappedToTaskRef=Task_100ms_10
        Task_2ms_10_54_Timer0 (RunnableEntityMapping): ActivationOffset=0, PositionInTask=54, RteCyclicTriggerImplementation=Auto, RTEEventRef=TMT_PeakCurrEst_Per1, MappedToTaskRef=Task_2ms_10
      Polarity_Ap_Polarity_ECU_Composition: ImplementationRef=Ap_Polarity_Implementation, SoftwareComponentInstanceRef=Polarity
        MAP_Rte_NvmBlock_Polarity_Polarity_Cnt_Str (NVRamAllocation): SwNvRamMappingReference=Polarity.PolarityBlock, NvmBlockRef=Rte_NvmBlock_Polarity_Polarity_Cnt_Str
        Task_10ms_10_7_Timer0 (RunnableEntityMapping): ActivationOffset=0, PositionInTask=7, RteCyclicTriggerImplementation=Auto, RTEEventRef=TMT_Polarity_Per1, MappedToTaskRef=Task_10ms_10
        Task_Init_10_3_Timer0 (RunnableEntityMapping): ActivationOffset=0, PositionInTask=3, RteCyclicTriggerImplementation=Auto, RTEEventRef=Polarity_Init1_InitEvent, MappedToTaskRef=Task_Init_10
      PwrLmtFuncCr_Ap_PwrLmtFuncCr_ECU_Composition: ImplementationRef=Ap_PwrLmtFuncCr_Implementation, SoftwareComponentInstanceRef=PwrLmtFuncCr
        3 x RunnableEntityMapping, all with ActivationOffset=0, RteCyclicTriggerImplementation=Auto:
          Task_2ms_10_34_Timer0: PositionInTask=34, RTEEventRef=TMT_PwrLmtFuncCr_Per1, MappedToTaskRef=Task_2ms_10
          Task_Init_10_19_Timer0: PositionInTask=19, RTEEventRef=PwrLmtFuncCr_Init1_InitEvent, MappedToTaskRef=Task_Init_10
          Task_10ms_10_4_Timer0: PositionInTask=4, RTEEventRef=TMT_PwrLmtFuncCr_Per2, MappedToTaskRef=Task_10ms_10
      QuadDet_Ap_QuadDet_ECU_Composition: ImplementationRef=Ap_QuadDet_Implementation, SoftwareComponentInstanceRef=QuadDet
        Task_2ms_10_39_Timer0 (RunnableEntityMapping): ActivationOffset=0, PositionInTask=39, RteCyclicTriggerImplementation=Auto, RTEEventRef=TMT_QuadDet_Per1, MappedToTaskRef=Task_2ms_10
      Return_Ap_Return_ECU_Composition: ImplementationRef=Ap_Return_Implementation, SoftwareComponentInstanceRef=Return
        Task_2ms_10_18_Timer0 (RunnableEntityMapping): ActivationOffset=0, PositionInTask=18, RteCyclicTriggerImplementation=Auto, RTEEventRef=TMT_Return_Per1, MappedToTaskRef=Task_2ms_10
      ReturnFirewall_Ap_ReturnFirewall_ECU_Composition: ImplementationRef=Ap_ReturnFirewall_Implementation, SoftwareComponentInstanceRef=ReturnFirewall
        Task_2ms_10_19_Timer0 (RunnableEntityMapping): ActivationOffset=0, PositionInTask=19, RteCyclicTriggerImplementation=Auto, RTEEventRef=TMT_ReturnFirewall_Per1, MappedToTaskRef=Task_2ms_10
      RteErrata_RteErrata10_ECU_Composition: ImplementationRef=RteErrata10_Implementation, SoftwareComponentInstanceRef=RteErrata
        4 x RunnableEntityMapping, all with ActivationOffset=0, PositionInTask=11, RteCyclicTriggerImplementation=Auto, MappedToTaskRef=Task_Trns_10:
          Task_Trns_10_11_TrigModeSwitch3: RTEEventRef=MST_RteErrata10_Trns_3
          Task_Trns_10_11_TrigModeSwitch2: RTEEventRef=MST_RteErrata10_Trns_2
          Task_Trns_10_11_TrigModeSwitch1: RTEEventRef=MST_RteErrata10_Trns_1
          Task_Trns_10_11_TrigModeSwitch0: RTEEventRef=MST_RteErrata10_Trns_0
      RteErrata8_RteErrata8_ECU_Composition: ImplementationRef=RteErrata8_Implementation, SoftwareComponentInstanceRef=RteErrata8
        4 x RunnableEntityMapping, all with ActivationOffset=0, PositionInTask=1, RteCyclicTriggerImplementation=Auto, MappedToTaskRef=Task_Trns_8:
          Task_Trns_8_1_TrigModeSwitch3: RTEEventRef=MST_RteErrata8_Trns_3
          Task_Trns_8_1_TrigModeSwitch2: RTEEventRef=MST_RteErrata8_Trns_2
          Task_Trns_8_1_TrigModeSwitch1: RTEEventRef=MST_RteErrata8_Trns_1
          Task_Trns_8_1_TrigModeSwitch0: RTEEventRef=MST_RteErrata8_Trns_0
      RteErrata9_RteErrata9_ECU_Composition: ImplementationRef=RteErrata9_Implementation, SoftwareComponentInstanceRef=RteErrata9
        4 x RunnableEntityMapping, all with ActivationOffset=0, PositionInTask=7, RteCyclicTriggerImplementation=Auto, MappedToTaskRef=Task_Trns_9:
          Task_Trns_9_7_TrigModeSwitch3: RTEEventRef=MST_RteErrata9_Trns_3
          Task_Trns_9_7_TrigModeSwitch2: RTEEventRef=MST_RteErrata9_Trns_2
          Task_Trns_9_7_TrigModeSwitch1: RTEEventRef=MST_RteErrata9_Trns_1
          Task_Trns_9_7_TrigModeSwitch0: RTEEventRef=MST_RteErrata9_Trns_0
      Sa_DigColPs_Sa_DigColPs_ECU_Composition: ImplementationRef=Sa_DigColPs_Implementation, SoftwareComponentInstanceRef=Sa_DigColPs
        MAP_Rte_NvmBlock_Sa_DigColPs_DigColPsEOL (NVRamAllocation): SwNvRamMappingReference=Sa_DigColPs.DigColPosSnsrEOLBlk, NvmBlockRef=Rte_NvmBlock_Sa_DigColPs_DigColPsEOL
        3 x RunnableEntityMapping, all with ActivationOffset=0, RteCyclicTriggerImplementation=Auto:
          Task_2ms_10_52_Timer0: PositionInTask=52, RTEEventRef=TMT_DigColPs_Per1, MappedToTaskRef=Task_2ms_10
          Task_4ms_10_1_Timer0: PositionInTask=1, RTEEventRef=TMT_DigColPs_Per2, MappedToTaskRef=Task_4ms_10
          Task_Init_10_26_Timer0: PositionInTask=26, RTEEventRef=DigColPs_Init1_InitEvent, MappedToTaskRef=Task_Init_10
      ShtdnMech_Sa_ShtdnMech_ECU_Composition: ImplementationRef=Sa_ShtdnMech_Implementation, SoftwareComponentInstanceRef=ShtdnMech
        Task_10ms_10_9_Timer0 (RunnableEntityMapping): ActivationOffset=0, PositionInTask=9, RteCyclicTriggerImplementation=Auto, RTEEventRef=TMT_ShtdnMech_Per1, MappedToTaskRef=Task_10ms_10
      SignlCondn_Ap_SignlCondn_ECU_Composition: ImplementationRef=Ap_SignlCondn_Implementation, SoftwareComponentInstanceRef=SignlCondn
        Task_2ms_10_56_Timer0 (RunnableEntityMapping): ActivationOffset=0, PositionInTask=56, RteCyclicTriggerImplementation=Auto, RTEEventRef=TMT_SignlCondn_Per1, MappedToTaskRef=Task_2ms_10
      SrlComInput_Ap_SrlComInput_ECU_Composition: ImplementationRef=Ap_SrlComInput_Implementation, SoftwareComponentInstanceRef=SrlComInput
        Task_10ms_9_1_Timer0 (RunnableEntityMapping): ActivationOffset=0, PositionInTask=1, RteCyclicTriggerImplementation=Auto, RTEEventRef=TMT_SrlComInput_Per1, MappedToTaskRef=Task_10ms_9
        Task_Init_9_10_Timer0 (RunnableEntityMapping): ActivationOffset=0, PositionInTask=10, RteCyclicTriggerImplementation=Auto, RTEEventRef=SrlComInput_InitEvent, MappedToTaskRef=Task_Init_9
      SrlComOutput_Ap_SrlComOutput_ECU_Composition: ImplementationRef=Ap_SrlComOutput_Implementation, SoftwareComponentInstanceRef=SrlComOutput
        Task_10ms_9_2_Timer0 (RunnableEntityMapping): ActivationOffset=0, PositionInTask=2, RteCyclicTriggerImplementation=Auto, RTEEventRef=TMT_SrlComOutput_Per1, MappedToTaskRef=Task_10ms_9
      StOpCtrl_Ap_StOpCtrl_ECU_Composition: ImplementationRef=Ap_StOpCtrl_Implementation, SoftwareComponentInstanceRef=StOpCtrl
        Task_2ms_10_29_Timer0 (RunnableEntityMapping): ActivationOffset=0, PositionInTask=29, RteCyclicTriggerImplementation=Auto, RTEEventRef=TMT_StOpCtrl_Per1, MappedToTaskRef=Task_2ms_10
      StaMd_Ap_StaMd_ECU_Composition: ImplementationRef=Ap_StaMd_Implementation, SoftwareComponentInstanceRef=StaMd
        StaMds_MilestoneRqst_WARMINIT_ExclArea (ExclusiveAreaImplementation): ExclusiveAreaImplMechanism=INTERRUPT_BLOCKING, ExclusiveAreaRef=StaMds_MilestoneRqst_WARMINIT_ExclArea
        3 x RunnableEntityMapping, all with ActivationOffset=0, RteCyclicTriggerImplementation=Auto:
          Task_Init_10_2_Timer0: PositionInTask=2, RTEEventRef=StaMd_Init1_InitEvent, MappedToTaskRef=Task_Init_10
          Task_Trns_10_8_TrigModeSwitch0: PositionInTask=8, RTEEventRef=MST_StaMd_Trns1_0, MappedToTaskRef=Task_Trns_10
          Task_2ms_10_61_Timer0: PositionInTask=61, RTEEventRef=TMT_StaMd_Per1, MappedToTaskRef=Task_2ms_10
      StaMd8_Ap_StaMd8_ECU_Composition: ImplementationRef=Ap_StaMd8_Implementation, SoftwareComponentInstanceRef=StaMd8
        StaMds8_MilestoneRqst_WARMINIT_ExclArea (ExclusiveAreaImplementation): ExclusiveAreaImplMechanism=INTERRUPT_BLOCKING, ExclusiveAreaRef=StaMds8_MilestoneRqst_WARMINIT_ExclArea
        Task_2ms_8_4_Timer0 (RunnableEntityMapping): ActivationOffset=0, PositionInTask=4, RteCyclicTriggerImplementation=Auto, RTEEventRef=TMT_StaMd8_Per1, MappedToTaskRef=Task_2ms_8
      StaMd9_Ap_StaMd9_ECU_Composition: ImplementationRef=Ap_StaMd9_Implementation, SoftwareComponentInstanceRef=StaMd9
        StaMds9_MilestoneRqst_WARMINIT_ExclArea (ExclusiveAreaImplementation): ExclusiveAreaImplMechanism=INTERRUPT_BLOCKING, ExclusiveAreaRef=StaMds9_MilestoneRqst_WARMINIT_ExclArea
        Task_2ms_9_8_Timer0 (RunnableEntityMapping): ActivationOffset=0, PositionInTask=8, RteCyclicTriggerImplementation=Auto, RTEEventRef=TMT_StaMd9_Per1, MappedToTaskRef=Task_2ms_9
        Task_SchM_Trns_9_0_Timer0 (RunnableEntityMapping): ActivationOffset=0, PositionInTask=0, RteCyclicTriggerImplementation=Auto, RTEEventRef=TMT_StaMd9_Trns_DemShutdown, MappedToTaskRef=Task_SchM_Trns_9
      StabilityComp_Ap_StabilityComp_ECU_Composition: ImplementationRef=Ap_StabilityComp_Implementation, SoftwareComponentInstanceRef=StabilityComp
        Task_Init_10_18_Timer0 (RunnableEntityMapping): ActivationOffset=0, PositionInTask=18, RteCyclicTriggerImplementation=Auto, RTEEventRef=StabilityComp_Init1_InitEvent, MappedToTaskRef=Task_Init_10
        Task_2ms_10_27_Timer0 (RunnableEntityMapping): ActivationOffset=0, PositionInTask=27, RteCyclicTriggerImplementation=Auto, RTEEventRef=TMT_StabilityComp_Per1, MappedToTaskRef=Task_2ms_10
      StabilityComp2_Ap_StabilityComp2_ECU_Composition: ImplementationRef=Ap_StabilityComp2_Implementation, SoftwareComponentInstanceRef=StabilityComp2
        Task_2ms_8_1_Timer0 (RunnableEntityMapping): ActivationOffset=0, PositionInTask=1, RteCyclicTriggerImplementation=Auto, RTEEventRef=TMT_StabilityComp2_Per1, MappedToTaskRef=Task_2ms_8
        Task_Init_8_1_Timer0 (RunnableEntityMapping): ActivationOffset=0, PositionInTask=1, RteCyclicTriggerImplementation=Auto, RTEEventRef=StabilityComp2_Init1_InitEvent, MappedToTaskRef=Task_Init_8
      Sweep_Ap_Sweep_ECU_Composition: ImplementationRef=Ap_Sweep_Implementation, SoftwareComponentInstanceRef=Sweep
        Task_Init_10_29_Timer0 (RunnableEntityMapping): ActivationOffset=0, PositionInTask=29, RteCyclicTriggerImplementation=Auto, RTEEventRef=Sweep_InitEvent, MappedToTaskRef=Task_Init_10
        Task_2ms_10_9_Timer0 (RunnableEntityMapping): ActivationOffset=0, PositionInTask=9, RteCyclicTriggerImplementation=Auto, RTEEventRef=TMT_Sweep_Per1, MappedToTaskRef=Task_2ms_10
      Sweep2_Ap_Sweep2_ECU_Composition: ImplementationRef=Ap_Sweep2_Implementation, SoftwareComponentInstanceRef=Sweep2
        Task_2ms_10_32_Timer0 (RunnableEntityMapping): ActivationOffset=0, PositionInTask=32, RteCyclicTriggerImplementation=Auto, RTEEventRef=TMT_Sweep2_Per1, MappedToTaskRef=Task_2ms_10
      ThrmlDutyCycle_Ap_ThrmlDutyCycle_ECU_Composition: ImplementationRef=Ap_ThrmlDutyCycle_Implementation, SoftwareComponentInstanceRef=ThrmlDutyCycle
        MAP_Rte_NvmBlock_ThrmlDutyCycle_ThrmlDutyCycle_FltStVal (NVRamAllocation): SwNvRamMappingReference=ThrmlDutyCycle.ThrmlDutyCycle_FltStVar, NvmBlockRef=Rte_NvmBlock_ThrmlDutyCycle_ThrmlDutyCycle_FltStVal
        Task_100ms_9_4_Timer0 (RunnableEntityMapping): ActivationOffset=0, PositionInTask=4, RteCyclicTriggerImplementation=Auto, RTEEventRef=TMT_ThrmlDutyCycle_Per1, MappedToTaskRef=Task_100ms_9
        Task_Init_9_5_Timer0 (RunnableEntityMapping): ActivationOffset=0, PositionInTask=5, RteCyclicTriggerImplementation=Auto, RTEEventRef=ThrmlDutyCycle_Init1_InitEvent, MappedToTaskRef=Task_Init_9
      TmprlMon_Sa_TmprlMon_ECU_Composition: ImplementationRef=Sa_TmprlMon_Implementation, SoftwareComponentInstanceRef=TmprlMon
        5 x RunnableEntityMapping, all with ActivationOffset=0, RteCyclicTriggerImplementation=Auto:
          Task_2ms_10_46_Timer0: PositionInTask=46, RTEEventRef=TMT_TmprlMon_Per2, MappedToTaskRef=Task_2ms_10
          Task_2ms_10_2_Timer0: PositionInTask=2, RTEEventRef=TMT_TmprlMon_Per1, MappedToTaskRef=Task_2ms_10
          Task_10ms_10_8_Timer0: PositionInTask=8, RTEEventRef=TMT_TmprlMon_Per3, MappedToTaskRef=Task_10ms_10
          Task_Trns_10_5_TrigModeSwitch0: PositionInTask=5, RTEEventRef=MST_TmprlMon_Trns2_0, MappedToTaskRef=Task_Trns_10
          Task_Trns_10_3_TrigModeSwitch0: PositionInTask=3, RTEEventRef=MST_TmprlMon_Trns1_0, MappedToTaskRef=Task_Trns_10
      TmprlMon2_Sa_TmprlMon2_ECU_Composition: ImplementationRef=Sa_TmprlMon2_Implementation, SoftwareComponentInstanceRef=TmprlMon2
        Task_2ms_10_45_Timer0 (RunnableEntityMapping): ActivationOffset=0, PositionInTask=45, RteCyclicTriggerImplementation=Auto, RTEEventRef=TMT_TmprlMon2_Per1, MappedToTaskRef=Task_2ms_10
      TqRsDg_Ap_TqRsDg_ECU_Composition: ImplementationRef=Ap_TqRsDg_Implementation, SoftwareComponentInstanceRef=TqRsDg
        Task_Init_10_16_Timer0 (RunnableEntityMapping): ActivationOffset=0, PositionInTask=16, RteCyclicTriggerImplementation=Auto, RTEEventRef=TqRsDg_Init1_InitEvent, MappedToTaskRef=Task_Init_10
        Task_2ms_10_38_Timer0 (RunnableEntityMapping): ActivationOffset=0, PositionInTask=38, RteCyclicTriggerImplementation=Auto, RTEEventRef=TMT_TqRsDg_Per1, MappedToTaskRef=Task_2ms_10
      TrqCanc_Ap_TrqCanc_ECU_Composition: ImplementationRef=Ap_TrqCanc_Implementation, SoftwareComponentInstanceRef=TrqCanc
        MAP_Rte_NvmBlock_TrqCanc_CogTrqCal (NVRamAllocation): SwNvRamMappingReference=TrqCanc.CogTrqCalBlk, NvmBlockRef=Rte_NvmBlock_TrqCanc_CogTrqCal
        MAP_Rte_NvmBlock_TrqCanc_CogTrqRplComp (NVRamAllocation): SwNvRamMappingReference=TrqCanc.CogTrqRplCompBlk, NvmBlockRef=Rte_NvmBlock_TrqCanc_CogTrqRplComp
        Task_2ms_10_41_Timer0 (RunnableEntityMapping): ActivationOffset=0, PositionInTask=41, RteCyclicTriggerImplementation=Auto, RTEEventRef=TMT_TrqCanc_Per1, MappedToTaskRef=Task_2ms_10
        Task_Init_10_12_Timer0 (RunnableEntityMapping): ActivationOffset=0, PositionInTask=12, RteCyclicTriggerImplementation=Auto, RTEEventRef=TrqCanc_InitEvent, MappedToTaskRef=Task_Init_10
      TrqCmdScl_Ap_TrqCmdScl_ECU_Composition: ImplementationRef=Ap_TrqCmdScl_Implementation, SoftwareComponentInstanceRef=TrqCmdScl
        MAP_Rte_NvmBlock_TrqCmdScl_TorqueCmdSF_Uls_f32 (NVRamAllocation): SwNvRamMappingReference=TrqCmdScl.TorqueCmdSF_EOLData, NvmBlockRef=Rte_NvmBlock_TrqCmdScl_TorqueCmdSF_Uls_f32
        Task_2ms_10_35_Timer0 (RunnableEntityMapping): ActivationOffset=0, PositionInTask=35, RteCyclicTriggerImplementation=Auto, RTEEventRef=TMT_TrqCmdScl_Per1, MappedToTaskRef=Task_2ms_10
      TuningSelAuth_Ap_TuningSelAuth_ECU_Composition: ImplementationRef=Ap_TuningSelAuth_Implementation, SoftwareComponentInstanceRef=TuningSelAuth
        Task_10ms_10_1_Timer0 (RunnableEntityMapping): ActivationOffset=0, PositionInTask=1, RteCyclicTriggerImplementation=Auto, RTEEventRef=TMT_TuningSelAuth_Per1, MappedToTaskRef=Task_10ms_10
        Task_Init_10_6_Timer0 (RunnableEntityMapping): ActivationOffset=0, PositionInTask=6, RteCyclicTriggerImplementation=Auto, RTEEventRef=TuningSelAuth_Init1_InitEvent, MappedToTaskRef=Task_Init_10
      VehDyn_Ap_VehDyn_ECU_Composition: ImplementationRef=Ap_VehDyn_Implementation, SoftwareComponentInstanceRef=VehDyn
        MAP_Rte_NvmBlock_VehDyn_MotPosReset (NVRamAllocation): SwNvRamMappingReference=VehDyn.VehDynReset, NvmBlockRef=Rte_NvmBlock_VehDyn_MotPosReset
        3 x RunnableEntityMapping, all with ActivationOffset=0, RteCyclicTriggerImplementation=Auto:
          Task_Trns_10_7_TrigModeSwitch0: PositionInTask=7, RTEEventRef=MST_VehDyn_Trns1_0, MappedToTaskRef=Task_Trns_10
          Task_2ms_10_14_Timer0: PositionInTask=14, RTEEventRef=TMT_VehDyn_Per1, MappedToTaskRef=Task_2ms_10
          Task_Init_10_21_Timer0: PositionInTask=21, RTEEventRef=VehDyn_Init1_InitEvent, MappedToTaskRef=Task_Init_10
      VehPwrMd_Ap_VehPwrMd_ECU_Composition: ImplementationRef=Ap_VehPwrMd_Implementation, SoftwareComponentInstanceRef=VehPwrMd
        Task_2ms_9_7_Timer0 (RunnableEntityMapping): ActivationOffset=0, PositionInTask=7, RteCyclicTriggerImplementation=Auto, RTEEventRef=TMT_VehPwrMd_Per1, MappedToTaskRef=Task_2ms_9
        Task_Init_9_4_Timer0 (RunnableEntityMapping): ActivationOffset=0, PositionInTask=4, RteCyclicTriggerImplementation=Auto, RTEEventRef=VehPwrMd_Init1_InitEvent, MappedToTaskRef=Task_Init_9
      VehSpdLmt_Ap_VehSpdLmt_ECU_Composition: ImplementationRef=Ap_VehSpdLmt_Implementation, SoftwareComponentInstanceRef=VehSpdLmt
        Task_2ms_9_3_Timer0 (RunnableEntityMapping): ActivationOffset=0, PositionInTask=3, RteCyclicTriggerImplementation=Auto, RTEEventRef=TMT_VehSpdLmt_Per1, MappedToTaskRef=Task_2ms_9
      WdgM_WdgM_ECU_Composition: ImplementationRef=WdgM_Implementation, ServiceComponentPrototypeRef=WdgM
        Task_SchM_10ms_9_3_Timer0 (RunnableEntityMapping): ActivationOffset=0, PositionInTask=3, RteCyclicTriggerImplementation=Auto, RTEEventRef=TMT_MainFunction, MappedToTaskRef=Task_SchM_10ms_9
      ePWM2_Ap_ePWM2_ECU_Composition: ImplementationRef=Ap_ePWM2_Implementation, SoftwareComponentInstanceRef=ePWM2
        3 x RunnableEntityMapping, all with ActivationOffset=0, RteCyclicTriggerImplementation=Auto:
          Task_Trns_10_1_TrigModeSwitch0: PositionInTask=1, RTEEventRef=MST_ePWM2_Trns2_0, MappedToTaskRef=Task_Trns_10
          Task_2ms_10_47_Timer0: PositionInTask=47, RTEEventRef=TMT_ePWM2_Per1, MappedToTaskRef=Task_2ms_10
          Task_Trns_10_10_TrigModeSwitch0: PositionInTask=10, RTEEventRef=MST_ePWM2_Trns1_0, MappedToTaskRef=Task_Trns_10
      uDiag_Cd_uDiag_ECU_Composition: ImplementationRef=Cd_uDiag_Implementation, SoftwareComponentInstanceRef=uDiag
        7 x RunnableEntityMapping, all with ActivationOffset=0, RteCyclicTriggerImplementation=Auto:
          Task_10ms_10_6_Timer0: PositionInTask=6, RTEEventRef=TMT_uDiagVIM_Per, MappedToTaskRef=Task_10ms_10
          Task_Init_10_4_Timer0: PositionInTask=4, RTEEventRef=uDiagResetHandler_InitEvent, MappedToTaskRef=Task_Init_10
          Task_Init_10_31_Timer0: PositionInTask=31, RTEEventRef=uDiagPeriphStartup_InitEvent, MappedToTaskRef=Task_Init_10
          Task_10ms_10_5_Timer0: PositionInTask=5, RTEEventRef=TMT_uDiagECC_Per, MappedToTaskRef=Task_10ms_10
          Task_4ms_10_2_Timer0: PositionInTask=2, RTEEventRef=TMT_uDiagLossOfExec_Per3, MappedToTaskRef=Task_4ms_10
          Task_100ms_10_6_Timer0: PositionInTask=6, RTEEventRef=TMT_uDiagStaticRegs_Per, MappedToTaskRef=Task_100ms_10
          Task_2ms_10_51_Timer0: PositionInTask=51, RTEEventRef=TMT_uDiagLossOfExec_Per2, MappedToTaskRef=Task_2ms_10
  module config GenyBaseEnv: module-description=GenyBaseEnv_Impl
    GenyBaseEnvGeneral: GenyBaseEnvUserConfigFile=, ProjectType=0, NumberOfSubProjects=1
  module config Xcp: module-description=Xcp_Impl
    XcpGeneral:
      XcpUseAsrFileNames = true
      XcpStationIdentifier = 
      XcpCommandParameterCheck = true
      XcpEventCodes = false
      XcpBootloaderDownload = false
      XcpEnableCalibration = true
      XcpMemoryWriteProtection = true
      XcpMemoryReadProtection = true
      XcpControl = false
      XcpGetDataPointer = false
      XcpOpenCommandInterface = false
      XcpDevelopmentErrorDetection = false
      XcpUserConfigFile = ..\..\..\Tools\AsrProject\Config\User\Xcp_User.cfg
      XcpEEPROMReadAccess = false
      XcpEEPROMWriteAccess = false
      XcpServiceRequestMessage = false
      XcpPrintf = false
      XcpSynchronousDataAquisition = true
      XcpSendQueue = true
      XcpSendQueueOverflowFirst = false
      XcpMemorySize = 512
      XcpPrescaler = true
      XcpOverrunIndication = true
      XcpWriteDAQMultiple = true
      XcpDAQODTMessageHeader = false
      XcpResumeMode = false
      XcpGeneralInfo = true
      XcpResolutionInfo = true
      XcpSynchronousDataStimulation = false
      XcpNumberofODTsforSTIM = 255
      XcpEventInfo = true
      XcpGetDAQEventInfo = true
      XcpDAQTimestamp = true
      XcpFixedTimestamp = false
      XcpTimestampTicksPerUnit = 1
      XcpCommunicationModeInfo = true
      XcpSeedKey = false
      XcpModifyBits = false
      XcpShortDownload = true
      XcpUserDefinedCommand = true
      XcpGetIdGeneric = false
      XcpTransportLayerCommand = false
      XcpBlockUpload = true
      XcpBlockDownload = true
      XcpMIN_STForBlockDownload = 40
      XcpChecksum = false
      XcpCustomCRC = false
      XcpAUTOSARCRCModuleSupport = false
      XcpCRCBlockSize = 256
      XcpPageSwitching = false
      XcpGeneralPagingInfo = true
      XcpCopyPage = false
      XcpFreezeMode = false
      XcpProgramming = true
      XcpProgrammingWriteProtection = false
      XcpMinStPgm = 0
      XcpProcessorAndSectorInfo = false
      Xcp_ReadCCConfig = false
      Xcp_ExtAddrReadCCConfig = 253
      XcpGenericMeasurement = false
      XcpAmdRuntimeMeasurement = false
      XcpSessionStatusAPI = false
      XcpVersionInfoApi = false
      XcpVxSupport = false
      XcpTimestampUnit = DAQ_TIMESTAMP_UNIT_1US
      XcpCRCCalculationMethod = ADD_12
      XcpTimeStampSize = TIMESTAMP_SIZE_WORD
      XcpMainFunctionPeriod = 0.005
    XcpSector_0__ (XcpSector): XcpStartAddress=0, XcpEndAddress=0
    XcpEvent_0 (XcpEvent): XcpEventId=0, XcpName=2ms_DAQ, XcpCycleTime=2, XcpEventInfoUnit=DAQ_TIMESTAMP_UNIT_1MS, XcpDAQ=true, XcpSTIM=false
  module config CanXcp: implementation-config-variant=VARIANT-PRE-COMPILE, module-description=CanXcp_Impl
    CanXcpGeneral:
      CanXcpProdErrorDetect = true
      CanXcpDevErrorDetect = false
      CanXcpAmdRuntimeMeasurement = false
      CanXcpVersionInfoApi = false
      CanXcpStartAddress = 0
      CanXcpUsePduInfoType = false
      CanXcpVariableDlc = false
      CanXcpMultiConnectionProtection = false
      CanXcpUserConfigFile = 
      CanXcpConfigurationVariant = (unset)
      CCAN (CanXcpChannelConfig): CanXcpComMChannelRef=ComM/CCAN
    CanXcp_Config (CanXcpConfig): CanXcpEcuMConfigurationRef=EcuMConfiguration
      CCAN (CanXcpChannel)
        XcpSlave__CCAN (CanXcpPdu)
          CanXcpPduDirection
            CanXcpTxPdu: CanXcpPduRef=CanIfInitConfiguration/XcpSlave__CCAN
        XcpMaster__CCAN (CanXcpPdu)
          CanXcpPduDirection
            CanXcpRxPdu: CanXcpPduRef=CanIfInitConfiguration/XcpMaster__CCAN
